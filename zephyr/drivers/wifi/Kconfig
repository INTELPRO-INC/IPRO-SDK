## zephyr/drivers/wifi/Kconfig
```kconfig
# Copyright (c) 2026 INTELPRO
# SPDX-License-Identifier: Apache-2.0

menuconfig WIFI_IPRO
	bool "IPRO6S Wi-Fi 6 station driver"
	default y
	depends on DT_HAS_INTELPRO_IPRO_WIFI_ENABLED
	depends on WIFI && NET_L2_ETHERNET
	select IPRO_WIFI
	select WIFI_USE_NATIVE_NETWORKING
	help
	  Zephyr network interface over the SDK Wi-Fi 6 stack: scan, connect,
	  disconnect and status through the wifi_mgmt API, Ethernet frames
	  through the fhost. STA only for now.

if WIFI_IPRO

config WIFI_IPRO_INIT_PRIORITY
	int "Interface init priority"
	default 80

config WIFI_IPRO_SHELL_BENCH
	bool "wifi_ipro cpubench micro-benchmark"
	help
	  The flash vs RAM code-fetch micro-benchmark (wifi_ipro cpubench). It
	  keeps about 5 KB of code and buffers in RAM, so it is off unless a
	  bench build asks for it.

config WIFI_IPRO_TCP_TRACE
	bool "TCP timing trace at the driver (wifi_ipro tcptrace)"
	help
	  Records every IPv4/TCP frame crossing the driver (time, direction,
	  seq, ack, length, flags) into a RAM ring. The first received data
	  segment below the highest sequence seen (a retransmission or a
	  reordered frame) freezes the ring a little later, so the dump shows
	  the ACK timing around it. `wifi_ipro tcptrace arm`, run the load,
	  then `wifi_ipro tcptrace`. Bench only: the rings take about 3 KB of
	  RAM, more than samples/wifi_sta has left; build it with
	  -DCONFIG_NET_TCP_MAX_SEND_WINDOW_SIZE=16384 -DCONFIG_NET_BUF_TX_COUNT=18.

config WIFI_IPRO_TCP_TRACE_ENTRIES
	int "TCP trace ring entries (20 bytes each)"
	depends on WIFI_IPRO_TCP_TRACE
	default 96

config WIFI_IPRO_TCP_TRACE_POST
	int "Entries kept after the trigger"
	depends on WIFI_IPRO_TCP_TRACE
	default 32

config WIFI_IPRO_TCP_TRACE_MAC_ENTRIES
	int "MAC reorder-check trace entries (12 bytes each)"
	depends on WIFI_IPRO_TCP_TRACE
	default 96
	help
	  Every data MPDU of a Block Ack session as the MAC's reorder check
	  saw it (SN, offset from the window start, verdict), on the same
	  clock as the TCP ring, so the dump shows whether a late TCP segment
	  also came late on the air (a later SN) or was reordered on board.

endif
```

## zephyr/dts/bindings/adc/intelpro,ipro-adc.yaml
```yaml
# Copyright (c) 2026 INTELPRO
# SPDX-License-Identifier: Apache-2.0

description: |
  IPRO7 GPADC. Channel ids: 0-11 analog pads (GPIO8, 15, 17, 11, 12, 14, 7,
  9, 18, 19, 20, 21 in that order; mux the pad to IPRO7_FUN_ANALOG), 12/13
  DAC A/B output, 14/15 temperature sensor, 16 Vref, 17 DC test, 18 VBAT/2,
  19-22 SenVP3..0, 23 GND. Single-ended, PGA gain 1, internal reference.

compatible: "intelpro,ipro-adc"

include: [adc-controller.yaml, pinctrl-device.yaml]

properties:
  interrupts:
    required: true

  vref-mv:
    type: int
    default: 3200
    enum: [2000, 3200]
    description: Internal reference (full-scale) in millivolts.

  clock-divider:
    type: int
    default: 7
    description: |
      ADC clock divider from the 32 MHz XCLK (ADC_CLK_Type index: 0 = /1,
      1 = /4, 2 = /8, 3 = /12, 4 = /16, 5 = /20, 6 = /24, 7 = /32). The
      default /32 gives 1 MHz, the rate the SDK's own ADC tests use.

  "#io-channel-cells":
    const: 1

io-channel-cells:
  - input
```

## zephyr/dts/bindings/audio/intelpro,ipro-pdm.yaml
```yaml
# Copyright (c) 2026 INTELPRO
# SPDX-License-Identifier: Apache-2.0

description: |
  IPRO7 PDM microphone input through the AUADC block. Pins are GPIO
  numbers muxed by the SDK HAL itself (function PDM; roles follow pad
  parity: even = PDM_CLK, odd = PDM_DIN): 0/1, 2/3, 8/7 on the EVB headers,
  18/19 on the IPRO7AI EVK (the two XTAL32K / AON "MSB" pads, which the HAL
  reclaims from the always-on block first).

compatible: "intelpro,ipro-pdm"

include: base.yaml

properties:
  clk-pin:
    type: int
    required: true
    enum: [0, 2, 8, 18]

  data-pin:
    type: int
    required: true
    enum: [1, 3, 7, 19]

  channel:
    type: string
    default: "left"
    enum: ["left", "right"]
    description: Which PDM channel (clock edge) the microphone drives.
```

## zephyr/dts/bindings/bluetooth/intelpro,ipro-bt-hci.yaml
```yaml
# Copyright (c) 2026 INTELPRO
# SPDX-License-Identifier: Apache-2.0

description: |
  IPRO7 BLE controller (RivieraWaves-derived, shipped as a prebuilt archive in
  components/wireless/bluetooth/ipro_ble_controller/lib) exposed to the Zephyr
  Bluetooth host as an HCI driver. The H4 byte stream flows through the
  controller's in-memory HCI transport (hcitl); no UART is involved.

  Register base is the BLE core block (BZ_PHY/BLE @0x30002000); interrupts
  are the BLE and BZ_PHY lines.

compatible: "intelpro,ipro-bt-hci"

include: [bt-hci.yaml, base.yaml]

properties:
  reg:
    required: true

  interrupts:
    required: true

  interrupt-names:
    required: true

  clocks:
    required: true

  bt-hci-name:
    default: "IPRO7 BLE controller"

  bt-hci-bus:
    default: "virtual"
```

## zephyr/dts/bindings/clock/intelpro,ipro-glb-clock.yaml
```yaml
# Copyright (c) 2026 INTELPRO
# SPDX-License-Identifier: Apache-2.0

description: |
  IPRO7 GLB peripheral clock gate / reset controller. Consumers reference a
  clock with one cell: the GLB_AHB_CLOCK_* identifier from
  <zephyr/dt-bindings/clock/ipro7-clock.h>.

  Enabling a clock ungates the AHB clock (GLB_PER_Clock_UnGate); the rate
  query resolves through the SDK clock tree (Clock_Peripheral_Clock_Get)
  for the peripherals that have a dedicated functional clock.

compatible: "intelpro,ipro-glb-clock"

include: [clock-controller.yaml, base.yaml]

properties:
  reg:
    required: true

  "#clock-cells":
    const: 1

clock-cells:
  - id
```

## zephyr/dts/bindings/counter/intelpro,ipro-counter.yaml
```yaml
# Copyright (c) 2026 INTELPRO
# SPDX-License-Identifier: Apache-2.0

description: |
  One channel of the IPRO7 TIMER block as a Zephyr counter: 32-bit,
  counting up, two alarm channels (comparators 0/1) and comparator 2 as
  the top value. Driven through the SDK LL (drv_timer.c).

compatible: "intelpro,ipro-counter"

include: base.yaml

properties:
  channel:
    type: int
    required: true
    enum: [0, 1]
    description: TIMER channel (0 or 1).
```

## zephyr/dts/bindings/counter/intelpro,ipro-rtc.yaml
```yaml
# Copyright (c) 2026 INTELPRO
# SPDX-License-Identifier: Apache-2.0

description: |
  IPRO HBN RTC as a Zephyr counter: free-running 40-bit counter on the
  32 kHz low-power clock (runs through PDS/HBN sleep), one alarm through
  the HBN_OUT0 interrupt. Presented as a 32-bit counter (low word).

compatible: "intelpro,ipro-rtc"

include: base.yaml

properties:
  interrupts:
    required: true

  clock-frequency:
    type: int
    default: 32768
    description: Nominal low-power clock rate in Hz (RC32K trimmed or XTAL32K).
```

## zephyr/dts/bindings/counter/intelpro,ipro-timer.yaml
```yaml
# Copyright (c) 2026 INTELPRO
# SPDX-License-Identifier: Apache-2.0

description: |
  IPRO7 general-purpose timer block (TIMER0 @0x30010000): two 32-bit
  channels, each with three comparators, preload (auto-reload) or free-run
  counting, clocked from XTAL/32 = 1 MHz by the clock-control driver. Child
  nodes (intelpro,ipro-counter) expose each channel as a Zephyr counter.

compatible: "intelpro,ipro-timer"

include: base.yaml

properties:
  reg:
    required: true

  interrupts:
    required: true

  clocks:
    required: true
```

## zephyr/dts/bindings/dac/intelpro,ipro-dac.yaml
```yaml
# Copyright (c) 2026 INTELPRO
# SPDX-License-Identifier: Apache-2.0

description: |
  IPRO7 GPDAC: two 10-bit channels, A (channel 0) on GPIO23 and B (channel 1)
  on GPIO22 (mux the pad to IPRO7_FUN_ANALOG for an external output); the
  outputs are also readable on ADC channels 12/13.

compatible: "intelpro,ipro-dac"

include: [dac-controller.yaml, pinctrl-device.yaml]

properties:
  clock-divider:
    type: int
    default: 62
    description: GPDAC clock = 32 MHz XCLK / (clock-divider + 1).

  "#io-channel-cells":
    const: 1

io-channel-cells:
  - output
```

## zephyr/dts/bindings/dma/intelpro,ipro-dma.yaml
```yaml
# Copyright (c) 2026 INTELPRO
# SPDX-License-Identifier: Apache-2.0

description: |
  IPRO7 DMA controller (DMA0 @0x30082000): 8 channels, linked-list
  descriptors, memory<->memory and memory<->peripheral with 32 request
  lines. Driven through the SDK HAL (hal_dma.c: dma_setConfig /
  dma_channel_attach / dma_reload / dma_channel_start).

  Consumer cells: <channel slot> where channel is 0-7 and slot the
  IPRO7_DMA_REQ_* request line from <zephyr/dt-bindings/dma/ipro7-dma.h>.

compatible: "intelpro,ipro-dma"

include: dma-controller.yaml

properties:
  reg:
    required: true

  interrupts:
    required: true

  clocks:
    required: true

  "#dma-cells":
    const: 2

dma-cells:
  - channel
  - slot
```

## zephyr/dts/bindings/flash_controller/intelpro,ipro-flash-controller.yaml
```yaml
# Copyright (c) 2026 INTELPRO
# SPDX-License-Identifier: Apache-2.0

description: |
  IPRO7 serial flash controller (SF_CTRL @0x30081000) with its XIP window.
  Read/write/erase go through the SDK HAL (hal_flash.c -> XIP_SFlash_*
  helpers, executed from OCRAM with interrupts masked and XIP paused).
  The child flash node describes the PHYSICAL flash; the running image sees
  the active firmware partition through the XIP window at 0x13000000
  (boot2 programs the remap), which is why the linker takes its base from
  CONFIG_FLASH_BASE_ADDRESS instead of the flash node.

compatible: "intelpro,ipro-flash-controller"

include: [flash-controller.yaml, base.yaml]

properties:
  reg:
    required: true
```

## zephyr/dts/bindings/gpio/intelpro,ipro-gpio.yaml
```yaml
# Copyright (c) 2026 INTELPRO
# SPDX-License-Identifier: Apache-2.0

description: |
  IPRO7 GPIO port. The SoC has 42 pads controlled through the GLB block.
  Zephyr ports are 32 bits wide, so the pads are split in two controller
  nodes: gpio0 (pads 0-31) and gpio1 (pads 32-41). Both share the single
  GPIO_INT0 interrupt line. Pin configuration, level access and interrupt
  control go through the SDK HAL/LL (hal_gpio.c / drv_gpio.c).

compatible: "intelpro,ipro-gpio"

include: [gpio-controller.yaml, base.yaml]

properties:
  reg:
    required: true

  interrupts:
    required: true

  pin-offset:
    type: int
    required: true
    description: Pad number of bit 0 of this port (0 or 32).

  ngpios:
    required: true

  "#gpio-cells":
    const: 2

gpio-cells:
  - pin
  - flags
```

## zephyr/dts/bindings/i2c/intelpro,ipro-i2c.yaml
```yaml
# Copyright (c) 2026 INTELPRO
# SPDX-License-Identifier: Apache-2.0

description: |
  IPRO7 I2C controller (I2C0 @0x3000E000 function 6, I2C1 @0x30019000
  function 25). Controller mode only, standard/fast mode. The hardware
  transaction model is <address> [sub-address 0-2 bytes] <data...>, so a
  Zephyr write+restart+read pair with a 1- or 2-byte write is executed as one
  hardware transaction; longer sequences are split at message boundaries.
  Pads are muxed in pairs (even pad SCL, odd pad SDA).

compatible: "intelpro,ipro-i2c"

include: [i2c-controller.yaml, pinctrl-device.yaml]

properties:
  reg:
    required: true

  interrupts:
    required: true

  clocks:
    required: true

  scl-gpios:
    type: phandle-array
    description: |
      SCL pad as a GPIO (same pad as the pinctrl entry). With sda-gpios it
      enables the stuck-bus check before every transfer (-EBUSY while either
      line is held low; the controller hangs the APB otherwise) and
      i2c_recover_bus(). The pad's input buffer stays on under the I2C mux,
      so the level is readable without re-muxing.

  sda-gpios:
    type: phandle-array
    description: SDA pad as a GPIO, see scl-gpios.
```

## zephyr/dts/bindings/i2s/intelpro,ipro-i2s.yaml
```yaml
# Copyright (c) 2026 INTELPRO
# SPDX-License-Identifier: Apache-2.0

description: |
  IPRO7 I2S. TX and RX each need a DMA channel: dmas = <&dma0 ch
  IPRO7_DMA_REQ_I2S_TX>, <&dma0 ch IPRO7_DMA_REQ_I2S_RX>; dma-names = "tx",
  "rx". Pads through pinctrl (IPRO7_FUN_I2S).

compatible: "intelpro,ipro-i2s"

include: [i2s-controller.yaml, pinctrl-device.yaml]

properties:
  reg:
    required: true

  interrupts:
    required: true

  clocks:
    required: true

  dmas:
    required: true

  dma-names:
    required: true
```

## zephyr/dts/bindings/ieee802154/intelpro,ipro-ieee802154.yaml
```yaml
# Copyright (c) 2026 INTELPRO
# SPDX-License-Identifier: Apache-2.0

description: |
  IPRO7 IEEE 802.15.4 radio (M154 MAC @0x3C000000 + shared 2.4 GHz RF).
  Driven through the SDK unified radio driver
  (components/wireless/ieee802154: ieee802154.c over the lmac154 lower MAC)
  and the IPRO7 RF component. Hardware auto-ACK, frame filtering, CSMA-CA,
  frame-pending table, energy detection, CCA and hardware timestamps.

compatible: "intelpro,ipro-ieee802154"

include: base.yaml

properties:
  reg:
    required: true

  interrupts:
    required: true

  interrupt-names:
    required: true

  clocks:
    required: true

  tx-power:
    type: int
    default: 0
    description: Initial TX power in dBm (-20 .. 20).

  cca-threshold:
    type: int
    default: -75
    description: CCA energy threshold in dBm.
```

## zephyr/dts/bindings/interrupt-controller/intelpro,ipro-eclic.yaml
```yaml
# Copyright (c) 2026 INTELPRO
# SPDX-License-Identifier: Apache-2.0

description: |
  Nuclei ECLIC of the INTELPRO IPRO7. The controller has no "reg": its base
  address (IREGION + 0x20000) is read from the MIRGB_INFO CSR at boot by the
  SoC code, which is also how the vendor SDK and boot ROM find it.

  Interrupt specifier cells: <irq priority>. irq is the ECLIC line number
  (0-18 core local, 19+ external, see bsp/drivers/ipro7_soc/regs/ipro7.h);
  priority is the ECLIC level (higher preempts lower).

compatible: "intelpro,ipro-eclic"

include: [interrupt-controller.yaml, base.yaml]

properties:
  "#interrupt-cells":
    const: 2

  "#address-cells":
    const: 0

interrupt-cells:
  - irq
  - priority
```

## zephyr/dts/bindings/pinctrl/intelpro,ipro-pinctrl.yaml
```yaml
# Copyright (c) 2026 INTELPRO
# SPDX-License-Identifier: Apache-2.0

description: |
  IPRO7 pin controller (GLB GPIO_CFGCTL registers).

  Each child of the pinctrl node is a state; each grandchild is a group
  of pins sharing the same electrical configuration:

    &pinctrl {
        uart0_default: uart0_default {
            group1 {
                pinmux = <IPRO7_PINMUX_UART(20, UART0_TXD)>,
                         <IPRO7_PINMUX_UART(21, UART0_RXD)>;
                bias-pull-up;
                input-schmitt-enable;
            };
        };
    };

  pinmux entries are built with the IPRO7_PINMUX* macros from
  <zephyr/dt-bindings/pinctrl/ipro7-pinctrl.h>: pad number, GLB function
  (GPIO_FUN_*), and for UART pads the signal function routed to the pad's
  slot (pad % 12).

compatible: "intelpro,ipro-pinctrl"

include: base.yaml

properties:
  reg:
    required: true

child-binding:
  description: IPRO7 pin controller state
  child-binding:
    description: IPRO7 pin group
    include:
      - name: pincfg-node.yaml
        property-allowlist:
          - bias-disable
          - bias-pull-up
          - bias-pull-down
          - drive-strength
          - input-schmitt-enable
          - input-enable
          - output-enable
          - output-high
          - output-low
    properties:
      pinmux:
        required: true
        type: array
        description: IPRO7_PINMUX() encoded pad/function pairs.
      drive-strength:
        type: int
        default: 0
        enum: [0, 1, 2, 3]
        description: GLB pad drive strength code (0 = weakest, 3 = strongest).
```
