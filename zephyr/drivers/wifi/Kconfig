## zephyr/dts/bindings/pwm/intelpro,ipro-pwm.yaml
```yaml
# Copyright (c) 2026 INTELPRO
# SPDX-License-Identifier: Apache-2.0

description: |
  IPRO7 PWM block (@0x3000F000, pad function 8, channel = pad % 5). One
  16-bit period and clock divider shared by four channels, each with its own
  low/high thresholds and polarity. Driven through the SDK LL (drv_pwm.c).

  Because the period is shared, every channel of the block must be requested
  with the same period; the driver refuses a conflicting period on a second
  channel while the first is active.

  pwm cells: <channel period flags>.

compatible: "intelpro,ipro-pwm"

include: [pwm-controller.yaml, pinctrl-device.yaml, base.yaml]

properties:
  reg:
    required: true

  interrupts:
    required: true

  clocks:
    required: true

  "#pwm-cells":
    const: 3

  clock-source:
    type: string
    default: "xclk"
    enum: ["xclk", "bclk", "32k"]
    description: PWM counter clock (XCLK 32 MHz, BCLK 96 MHz, or the 32 kHz clock).

  clock-divider:
    type: int
    default: 1
    description: Counter clock divider (1-65535) applied to clock-source.

pwm-cells:
  - channel
  - period
  - flags
```

## zephyr/dts/bindings/riscv/intelpro,ipro6s.yaml
```yaml
# Copyright (c) 2026 INTELPRO
# SPDX-License-Identifier: Apache-2.0

description: INTELPRO IPRO6S SoC (Nuclei N300 RV32IMAFC + Zb* + ECLIC)

compatible: "intelpro,ipro6s"

include: [base.yaml]
```

## zephyr/dts/bindings/riscv/intelpro,ipro7.yaml
```yaml
# Copyright (c) 2026 INTELPRO
# SPDX-License-Identifier: Apache-2.0

description: INTELPRO IPRO7 SoC (Nuclei N300 RV32IMAFC + Zb* + ECLIC)

compatible: "intelpro,ipro7"

include: [base.yaml]
```

## zephyr/dts/bindings/rng/intelpro,ipro-trng.yaml
```yaml
# Copyright (c) 2026 INTELPRO
# SPDX-License-Identifier: Apache-2.0

description: |
  IPRO7 true random number generator inside the security engine
  (SEC_ENG @0x30080000). Exposed as a Zephyr entropy device through the SDK
  HAL (hal_sec_trng.c / drv_sec_eng.c).

compatible: "intelpro,ipro-trng"

include: base.yaml

properties:
  reg:
    required: true

  interrupts:
    required: true

  clocks:
    required: true
```

## zephyr/dts/bindings/serial/intelpro,ipro-uart.yaml
```yaml
# Copyright (c) 2026 INTELPRO
# SPDX-License-Identifier: Apache-2.0

description: |
  IPRO7 UART. Two instances (UART0 @0x3000B000, UART1 @0x3000C000), 16-byte
  TX/RX FIFOs, RX timeout interrupt, RTS/CTS. Driven through the SDK LL
  layer (bsp/drivers/ipro7_soc/std_drv/drv_uart.c).

  Pin routing is two-level on this SoC: the pad is put in UART alternate
  function and the UART "signal slot" (pin % 12) is mapped to UART0/UART1
  TXD/RXD/RTS/CTS through GLB_UART_Fun_Sel. Both are described by the
  pinctrl pinmux entries (IPRO7_PINMUX_UART).

compatible: "intelpro,ipro-uart"

include: [uart-controller.yaml, pinctrl-device.yaml]

properties:
  reg:
    required: true

  interrupts:
    required: true

  clocks:
    required: true

  rx-timeout-bits:
    type: int
    default: 100
    description: |
      RX timeout in bit periods before the RTO interrupt fires when the
      FIFO holds fewer bytes than the threshold (SDK default 100).

  dmas:
    description: |
      TX and RX DMA channels for the async API: <&dma0 channel
      IPRO7_DMA_REQ_UARTn_TX>, <&dma0 channel IPRO7_DMA_REQ_UARTn_RX>.

  dma-names:
    description: '"tx", "rx" in the order of dmas.'
```

## zephyr/dts/bindings/spi/intelpro,ipro-spi.yaml
```yaml
# Copyright (c) 2026 INTELPRO
# SPDX-License-Identifier: Apache-2.0

description: |
  IPRO7 SPI controller (SPI0 @0x3000D000 function 4, SPI1 @0x3001E000
  function 26). Master mode, 8/16/24/32-bit frames, CPOL/CPHA, 4-entry FIFOs.
  Driven through the SDK HAL (hal_spi.c: spi_setConfig/spi_init/
  spi_transmit_receive over drv_spi.c).

  Pads are muxed in groups of four (pad % 4: 0 MOSI, 1 MISO, 2 SS, 3 SCLK,
  MOSI/MISO swapped when swap-mosi-miso is set - the EVB default).

compatible: "intelpro,ipro-spi"

include: [spi-controller.yaml, pinctrl-device.yaml]

properties:
  reg:
    required: true

  interrupts:
    required: true

  clocks:
    required: true

  swap-mosi-miso:
    type: boolean
    description: Swap the MOSI and MISO pad functions (GLB_Swap_SPI_0_MOSI_With_MISO).

  deglitch-count:
    type: int
    default: 0
    description: Input de-glitch filter length in SPI clocks (0 = off).

  dmas:
    description: |
      Optional TX DMA channel: <&dma0 channel IPRO7_DMA_REQ_SPIn_TX>. Transmit-only
      transfers of CONFIG_SPI_IPRO_DMA_MIN_BYTES or more (display frames) then run
      by DMA instead of the polled FIFO path.

  dma-names:
    description: '"tx".'
```

## zephyr/dts/bindings/timer/intelpro,ipro-systimer.yaml
```yaml
# Copyright (c) 2026 INTELPRO
# SPDX-License-Identifier: Apache-2.0

description: |
  Nuclei private system timer (mtime/mtimecmp) of the IPRO7, used as the
  Zephyr system clock. Located at run time (IREGION + 0x30000) like the
  ECLIC; counts at /cpus timebase-frequency.

compatible: "intelpro,ipro-systimer"

include: base.yaml

properties:
  interrupts-extended:
    required: true
```
