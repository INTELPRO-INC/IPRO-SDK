## CMakeLists.txt
```
# Copyright (c) 2026 INTELPRO
# SPDX-License-Identifier: Apache-2.0
cmake_minimum_required(VERSION 3.20.0)
find_package(Zephyr REQUIRED HINTS $ENV{ZEPHYR_BASE})
project(ipro_ieee802154_shell)
target_sources(app PRIVATE src/main.c)
```

## sample.yaml
```
sample:
  name: IPRO7 IEEE 802.15.4 shell
  description: Zephyr net + ieee802154 shell over the IPRO7 M154 radio
tests:
  sample.ipro.ieee802154_shell:
    platform_allow: ipro7_evb
    integration_platforms:
      - ipro7_evb
    tags: ipro ieee802154
    build_only: true
```

## prj.conf
```kconfig
CONFIG_NETWORKING=y
CONFIG_NET_L2_IEEE802154=y
CONFIG_NET_L2_IEEE802154_SHELL=y
CONFIG_IEEE802154=y
CONFIG_NET_IPV6=y
CONFIG_NET_UDP=y
CONFIG_NET_SHELL=y
CONFIG_NET_LOG=y
CONFIG_SHELL=y
CONFIG_LOG=y
CONFIG_LOG_MODE_IMMEDIATE=y
CONFIG_ENTROPY_GENERATOR=y
CONFIG_MAIN_STACK_SIZE=4096
CONFIG_COMMON_LIBC_MALLOC_ARENA_SIZE=4096
```

## csl.conf
```kconfig
# Sleepy end device with CSL (SSED): add on top of ot.conf
CONFIG_OPENTHREAD_CSL_RECEIVER=y
# CSL again after a reset (OpenThread keeps the period in RAM only)
CONFIG_IEEE802154_IPRO_OT_CSL_PERIOD_US=500000
CONFIG_IEEE802154_IPRO_OT_CSL_TIMEOUT_S=20
# HAL frame trace (ipro154 trace): protocol verification without a sniffer
CONFIG_IEEE802154_IPRO_FRAME_TRACE=y
CONFIG_IEEE802154_IPRO_FRAME_TRACE_AT_BOOT=y
```

## ot.conf
```kconfig
# Extra fragment for zephyr/samples/net/openthread/shell on ipro7_evb
CONFIG_ENTROPY_GENERATOR=y
CONFIG_COMMON_LIBC_MALLOC_ARENA_SIZE=16384
CONFIG_MAIN_STACK_SIZE=4096
CONFIG_IEEE802154_IPRO_RX_STACK_SIZE=2048

# Thread 1.4 (the lab border router is 1.4) and the OT CLI ping sender
CONFIG_OPENTHREAD_THREAD_VERSION_1_4=y
CONFIG_OPENTHREAD_PING_SENDER=y

# Radio timestamps and timed TX on the MAC symbol clock (CSL transmitter/receiver)
CONFIG_NET_PKT_TIMESTAMP=y
CONFIG_NET_PKT_TXTIME=y

# The radio driver secures frames (CCM*) and schedules CSL from the system workqueue
CONFIG_SYSTEM_WORKQUEUE_STACK_SIZE=4096
CONFIG_OPENTHREAD_THREAD_STACK_SIZE=6144
# The radio driver secures frames (CCM*) on the OpenThread radio workqueue
CONFIG_OPENTHREAD_RADIO_WORKQUEUE_STACK_SIZE=2048

# Bench IPRO7 EVBs: RF crystal trim to within ~6 ppm of the nRF52840 / RT582
# references (ROM default 85 is ~+60 ppm; `ipro154 xtal` / `ipro154 cfo`).
# Not for the IPRO7AI Reef, which wants 95.
CONFIG_SOC_IPRO7_XTAL_CAPCODE=165
```

## app.overlay
```dts
/* Enable the radio and make it the default 802.15.4 device (OpenThread). */
/ {
	chosen {
		zephyr,ieee802154 = &ieee802154;
	};
};

&ieee802154 {
	status = "okay";
};
```

## src/main.c
```c
/*
 * Copyright (c) 2026 INTELPRO
 * SPDX-License-Identifier: Apache-2.0
 *
 * Bring-up shell for the IPRO7 802.15.4 radio: use `ieee802154 set_chan`,
 * `ieee802154 set_pan_id`, `ieee802154 set_short_addr`, `net iface` and
 * `net ping` between two boards.
 */

#include <zephyr/kernel.h>
#include <zephyr/net/net_if.h>
#include <zephyr/sys/printk.h>

int main(void)
{
	struct net_if *iface = net_if_get_first_by_type(&NET_L2_GET_NAME(IEEE802154));

	printk("IPRO7 802.15.4 shell; iface %p %s\n", iface,
	       iface != NULL ? (net_if_is_up(iface) ? "up" : "down") : "missing");
	return 0;
}
```
