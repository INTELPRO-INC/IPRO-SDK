## CMakeLists.txt
```
# Copyright (c) 2026 INTELPRO
# SPDX-License-Identifier: Apache-2.0
cmake_minimum_required(VERSION 3.20.0)
find_package(Zephyr REQUIRED HINTS $ENV{ZEPHYR_BASE})
project(ipro7ai_evk_demo)
target_sources(app PRIVATE src/main.c src/lcd.c src/audio.c src/cmds.c)
target_sources_ifdef(CONFIG_EVK_DEMO_CAMERA app PRIVATE src/cam.c)
```

## Kconfig
```
# Copyright (c) 2026 INTELPRO
# SPDX-License-Identifier: Apache-2.0
mainmenu "IPRO7AI EVK demo"

config EVK_DEMO_CAMERA
	bool "Camera preview (SC101IOT -> ISP -> LCD)"
	default n

source "Kconfig.zephyr"
```

## sample.yaml
```
sample:
  name: IPRO7AI EVK demo (LCD, microphone, speaker, camera)
tests:
  sample.ipro.evk_demo:
    platform_allow:
      - ipro7ai_evk
    integration_platforms:
      - ipro7ai_evk
    tags:
      - ipro
      - evk
    harness: console
    harness_config:
      type: one_line
      regex:
        - "evk demo ready"
```

## prj.conf
```kconfig
CONFIG_GPIO=y
CONFIG_I2C=y
CONFIG_SPI=y
CONFIG_DISPLAY=y
CONFIG_DMA=y
CONFIG_DAC=y
CONFIG_DAC_IPRO_STREAM=y
CONFIG_AUDIO=y
CONFIG_AUDIO_DMIC=y
CONFIG_SHELL=y
CONFIG_SHELL_STACK_SIZE=4096
CONFIG_MAIN_STACK_SIZE=4096
CONFIG_SYSTEM_WORKQUEUE_STACK_SIZE=2048
CONFIG_HEAP_MEM_POOL_SIZE=8192
CONFIG_LOG=y
CONFIG_LOG_MODE_MINIMAL=y
CONFIG_CBPRINTF_FP_SUPPORT=y
CONFIG_IPRO_CAMERA=y
CONFIG_EVK_DEMO_CAMERA=y
```

## app.overlay
```dts
/* IPRO7AI EVK demo: DMA for the DAC stream, PDM microphone, DAC pad. */
#include <zephyr/dt-bindings/dma/ipro7-dma.h>

&dma0 {
	status = "okay";
};

&pdm0 {
	status = "okay";
};

&dac0 {
	status = "okay";
};
```

## src/main.c
```c
/*
 * Copyright (c) 2026 INTELPRO
 * SPDX-License-Identifier: Apache-2.0
 *
 * IPRO7AI EVK demo on Zephyr: LCD, PDM microphone, speaker (GPDAC) and the
 * SC101IOT camera, driven from the shell ("evk ..."). See README.md.
 */
#include "demo.h"
#include <zephyr/sys/printk.h>

int main(void)
{
	int r;

	r = lcd_init();
	printk("evk demo: lcd %d (%ux%u)\n", r, lcd_width(), lcd_height());
	if (r == 0) {
		(void)lcd_bars();
	}
	r = audio_init();
	printk("evk demo: audio %d (mic pdm0 GPIO18/19, speaker GPDAC-A GPIO23, enable GPIO22)\n", r);
#ifdef CONFIG_EVK_DEMO_CAMERA
	r = cam_init();
	printk("evk demo: camera %d\n", r);
#endif
	printk("evk demo ready - type 'evk' for the commands\n");
	return 0;
}
```

## src/audio.c
```c
/*
 * Copyright (c) 2026 INTELPRO
 * SPDX-License-Identifier: Apache-2.0
 *
 * Microphone (PDM IM69D129 on GPIO18/19 through the DMIC driver) and
 * speaker (GPDAC channel A -> TPA2037D1 class-D, enable on GPIO22) for the
 * EVK demo: level meter, record to PSRAM, playback, tone, live loopback.
 */
#include "demo.h"
#include <zephyr/device.h>
#include <zephyr/audio/dmic.h>
#include <zephyr/drivers/dac.h>
#include <zephyr/drivers/gpio.h>
#include <zephyr/sys/ring_buffer.h>
#include <ipro_zephyr/ipro_dac_stream.h>
#include <string.h>
#include <math.h>

#define RATE            16000          /* nominal; the AUADC really runs 15875 Hz */
#define BLOCK_SAMPLES   320            /* 20 ms */
#define BLOCK_BYTES     (BLOCK_SAMPLES * 2)
#define DAC_SEG         320
#define REC_SECONDS_MAX 20
#define REC_SAMPLES_MAX (RATE * REC_SECONDS_MAX)

static const struct device *const mic = DEVICE_DT_GET(DT_NODELABEL(pdm0));
static const struct device *const dac = DEVICE_DT_GET(DT_NODELABEL(dac0));
static const struct device *const dma = DEVICE_DT_GET(DT_NODELABEL(dma0));
static const struct gpio_dt_spec spk_en = GPIO_DT_SPEC_GET(DT_NODELABEL(spk_enable), gpios);

K_MEM_SLAB_DEFINE_STATIC(mic_slab, BLOCK_BYTES, 8, 4);

/* Recording lives in PSRAM (.psram_bss): 20 s at 16 kHz = 640 KB. */
__attribute__((section(".psram_bss"))) static int16_t rec_buf[REC_SAMPLES_MAX];
static uint32_t rec_len;
static volatile uint32_t play_pos;

/* Loopback ring between the mic thread (producer) and the DAC fill (consumer). */
RING_BUF_DECLARE(loop_ring, 8192);
static volatile bool loop_active;

static bool mic_configured;
static int makeup_shift = 2; /* playback gain 2^n (4 = +12 dB); the SDK uses +30 dB with a limiter */

static int32_t hp_prev_in, hp_prev_out;

/* Remove the AUADC's DC offset (one-pole high-pass, ~20 Hz) then apply the make-up gain. */
static inline int16_t makeup(int16_t v)
{
	int32_t y = (int32_t)v - hp_prev_in + (hp_prev_out * 255) / 256;

	hp_prev_in = v;
	hp_prev_out = y;
	int32_t x = y << makeup_shift;

	return (int16_t)CLAMP(x, INT16_MIN, INT16_MAX);
}

uint32_t audio_recorded_samples(void) { return rec_len; }
uint32_t audio_rate(void) { return RATE; }

static int mic_setup(void)
{
	static struct pcm_stream_cfg stream = {
		.pcm_rate = RATE, .pcm_width = 16, .block_size = BLOCK_BYTES, .mem_slab = &mic_slab,
	};
	static struct dmic_cfg cfg = {
		.io = {.min_pdm_clk_freq = 1000000, .max_pdm_clk_freq = 3500000},
		.streams = &stream,
		.channel = {.req_num_streams = 1, .req_num_chan = 1},
	};

	if (!device_is_ready(mic)) {
		return -ENODEV;
	}
	if (!mic_configured) {
		int r = dmic_configure(mic, &cfg);

		if (r != 0) {
			return r;
		}
		mic_configured = true;
	}
	return 0;
}

static int spk_enable(bool on)
{
	if (!gpio_is_ready_dt(&spk_en)) {
		return -ENODEV;
	}
	return gpio_pin_configure_dt(&spk_en, on ? GPIO_OUTPUT_ACTIVE : GPIO_OUTPUT_INACTIVE);
}

int audio_init(void)
{
	struct dac_channel_cfg ch = {.channel_id = 0, .resolution = 10};

	if (!device_is_ready(dac) || !device_is_ready(dma)) {
		return -ENODEV;
	}
	(void)dac_channel_setup(dac, &ch);
	(void)dac_write_value(dac, 0, 512);
	(void)spk_enable(false);
	return 0;
}

/* ---- capture helpers ---------------------------------------------------- */

static int mic_start(void)
{
	int r = mic_setup();

	if (r == 0) {
		r = dmic_trigger(mic, DMIC_TRIGGER_START);
	}
	return r;
}

static void mic_stop(void)
{
	(void)dmic_trigger(mic, DMIC_TRIGGER_STOP);
}

static uint32_t block_rms(const int16_t *pcm, size_t n)
{
	uint64_t acc = 0;

	for (size_t i = 0; i < n; i++) {
		acc += (int64_t)pcm[i] * pcm[i];
	}
	return (uint32_t)sqrt((double)(acc / n));
}

int audio_mic_level(const struct shell *sh, uint32_t seconds, bool on_lcd)
{
	int r = mic_start();
	int64_t end = k_uptime_get() + (int64_t)seconds * 1000;
	uint32_t peak = 0, blocks = 0;
	int64_t next_print = 0;
	uint32_t rms_acc = 0, rms_n = 0;
	int16_t bmin = INT16_MAX, bmax = INT16_MIN;
	int64_t mean_acc = 0;

	if (r != 0) {
		shell_error(sh, "mic start: %d", r);
		return r;
	}
	shell_print(sh, "mic level for %u s: 20 ms blocks, 16-bit PCM (full scale 32767)", seconds);
	while (k_uptime_get() < end) {
		void *blk;
		size_t sz;

		r = dmic_read(mic, 0, &blk, &sz, 500);
		if (r != 0) {
			shell_error(sh, "dmic_read: %d (no frames from the AUADC)", r);
			break;
		}
		const int16_t *pcm = blk;
		size_t n = sz / 2;

		if (blocks == 0) {
			shell_print(sh, "first block, samples 0..15:");
			for (int i = 0; i < 16; i++) {
				shell_fprintf(sh, SHELL_NORMAL, " %d", pcm[i]);
			}
			shell_print(sh, "");
		}
		uint32_t rms = block_rms(pcm, n);

		for (size_t i = 0; i < n; i++) {
			bmin = MIN(bmin, pcm[i]);
			bmax = MAX(bmax, pcm[i]);
			mean_acc += pcm[i];
		}
		rms_acc += rms;
		rms_n++;
		blocks++;
		peak = MAX(peak, rms);
		k_mem_slab_free(&mic_slab, blk);
		if (on_lcd) {
			(void)lcd_level_bar(MIN(rms * 1000 / 4000, 1000), rms > 3200 ? C_RED : C_GREEN);
		}
		if (k_uptime_get() >= next_print) {
			uint32_t avg = rms_n ? rms_acc / rms_n : 0;

			shell_print(sh, "t=%5lld ms  rms %5u  min %6d  max %6d  mean %6lld  |%-32.*s|",
				    k_uptime_get(), avg, bmin, bmax, mean_acc / (int64_t)(rms_n * n),
				    (int)MIN(avg * 32 / 4000, 32), "################################");
			next_print = k_uptime_get() + 250;
			rms_acc = 0; rms_n = 0; bmin = INT16_MAX; bmax = INT16_MIN; mean_acc = 0;
		}
	}
	mic_stop();
	shell_print(sh, "%u blocks, peak rms %u", blocks, peak);
	return r;
}

int audio_mic_dump(const struct shell *sh)
{
	int r = mic_start();

	if (r != 0) {
		return r;
	}
	shell_print(sh, "4 consecutive blocks: first 6 and last 4 samples (block boundary check)");
	for (int b = 0; b < 4; b++) {
		void *blk;
		size_t sz;

		if (dmic_read(mic, 0, &blk, &sz, 500) != 0) {
			break;
		}
		const int16_t *p = blk;
		size_t n = sz / 2;

		shell_print(sh, "blk %d: %6d %6d %6d %6d %6d %6d ... %6d %6d %6d %6d", b, p[0], p[1],
			    p[2], p[3], p[4], p[5], p[n - 4], p[n - 3], p[n - 2], p[n - 1]);
		k_mem_slab_free(&mic_slab, blk);
	}
	mic_stop();
	return 0;
}

int audio_mic_record(const struct shell *sh, uint32_t seconds)
{
	int r;

	seconds = MIN(seconds, REC_SECONDS_MAX);
	r = mic_start();
	if (r != 0) {
		shell_error(sh, "mic start: %d", r);
		return r;
	}
	rec_len = 0;
	shell_print(sh, "recording %u s ...", seconds);
	while (rec_len + BLOCK_SAMPLES <= seconds * RATE) {
		void *blk;
		size_t sz;

		r = dmic_read(mic, 0, &blk, &sz, 200);
		if (r != 0) {
			shell_error(sh, "dmic_read: %d", r);
			break;
		}
		memcpy(&rec_buf[rec_len], blk, sz);
		rec_len += sz / 2;
		k_mem_slab_free(&mic_slab, blk);
	}
	mic_stop();
	shell_print(sh, "recorded %u samples (%u.%02u s), peak %d", rec_len, rec_len / RATE,
		    (rec_len % RATE) * 100 / RATE, 0);
	return r;
}

/* ---- playback ----------------------------------------------------------- */

static void fill_recording(int16_t *pcm, size_t n, void *user)
{
	ARG_UNUSED(user);
	for (size_t i = 0; i < n; i++) {
		pcm[i] = (play_pos < rec_len) ? makeup(rec_buf[play_pos++]) : 0;
	}
}

static int play_run(const struct shell *sh, ipro_dac_stream_fill_t fill, void *user, uint32_t ms)
{
	struct ipro_dac_stream_cfg cfg = {
		.dma = dma, .dma_channel = 1, .sample_rate = RATE, .seg_samples = DAC_SEG,
		.fill = fill, .user = user,
	};
	int r = ipro_dac_stream_start(&cfg);

	if (r != 0) {
		shell_error(sh, "dac stream start: %d", r);
		return r;
	}
	(void)spk_enable(true);
	k_msleep(ms);
	(void)spk_enable(false);
	ipro_dac_stream_stop();
	shell_print(sh, "played %u DMA segments (%u ms)", ipro_dac_stream_segments(),
		    ipro_dac_stream_segments() * DAC_SEG / (RATE / 1000));
	return 0;
}

int audio_play_recording(const struct shell *sh)
{
	if (rec_len == 0) {
		shell_error(sh, "nothing recorded");
		return -ENODATA;
	}
	play_pos = 0;
	hp_prev_in = 0; hp_prev_out = 0;
	shell_print(sh, "playing %u samples (x%d make-up gain, DC removed)", rec_len, 1 << makeup_shift);
	return play_run(sh, fill_recording, NULL, rec_len * 1000 / RATE + 60);
}

struct tone {
	uint32_t hz;
	uint32_t phase; /* Q16 turns */
};

static void fill_tone(int16_t *pcm, size_t n, void *user)
{
	struct tone *t = user;
	uint32_t step = (uint32_t)(((uint64_t)t->hz << 16) / RATE);

	for (size_t i = 0; i < n; i++) {
		double a = (double)(t->phase & 0xFFFF) / 65536.0 * 6.283185307;

		pcm[i] = (int16_t)(sin(a) * 12000.0);
		t->phase += step;
	}
}

int audio_tone(const struct shell *sh, uint32_t hz, uint32_t ms)
{
	struct tone t = {.hz = hz, .phase = 0};

	shell_print(sh, "tone %u Hz for %u ms", hz, ms);
	return play_run(sh, fill_tone, &t, ms);
}

/* ---- live loopback ------------------------------------------------------ */

static void fill_loop(int16_t *pcm, size_t n, void *user)
{
	ARG_UNUSED(user);
	uint32_t got = ring_buf_get(&loop_ring, (uint8_t *)pcm, n * 2);

	if (got < n * 2) {
		memset((uint8_t *)pcm + got, 0, n * 2 - got);
	}
	for (size_t i = 0; i < n; i++) {
		pcm[i] = makeup(pcm[i]);
	}
}

int audio_loopback(const struct shell *sh, uint32_t seconds)
{
	struct ipro_dac_stream_cfg cfg = {
		.dma = dma, .dma_channel = 1, .sample_rate = RATE, .seg_samples = DAC_SEG,
		.fill = fill_loop,
	};
	int64_t end = k_uptime_get() + (int64_t)seconds * 1000;
	int r = mic_start();
	uint32_t drops = 0;

	if (r != 0) {
		shell_error(sh, "mic start: %d", r);
		return r;
	}
	ring_buf_reset(&loop_ring);
	/* Prime ~40 ms so the DAC never runs dry on the mic's slower real rate. */
	{
		uint8_t z[BLOCK_BYTES] = {0};
		ring_buf_put(&loop_ring, z, sizeof(z));
		ring_buf_put(&loop_ring, z, sizeof(z));
	}
	r = ipro_dac_stream_start(&cfg);
	if (r != 0) {
		shell_error(sh, "dac stream start: %d", r);
		mic_stop();
		return r;
	}
	(void)spk_enable(true);
	loop_active = true;
	shell_print(sh, "mic -> speaker for %u s (speak into the mic)", seconds);
	while (k_uptime_get() < end) {
		void *blk;
		size_t sz;

		if (dmic_read(mic, 0, &blk, &sz, 200) != 0) {
			continue;
		}
		if (ring_buf_put(&loop_ring, blk, sz) < sz) {
			drops++;
		}
		k_mem_slab_free(&mic_slab, blk);
	}
	loop_active = false;
	(void)spk_enable(false);
	ipro_dac_stream_stop();
	mic_stop();
	shell_print(sh, "loopback done, %u DMA segments, %u dropped mic blocks",
		    ipro_dac_stream_segments(), drops);
	return 0;
}

int audio_set_gain_shift(int shift)
{
	if (shift < 0 || shift > 5) {
		return -EINVAL;
	}
	makeup_shift = shift;
	return 0;
}
```

## src/cam.c
```c
/*
 * Copyright (c) 2026 INTELPRO
 * SPDX-License-Identifier: Apache-2.0
 *
 * SC101IOT DVP camera -> ISP (DVP_AS, scaler channel 1, ARGB) -> PSRAM
 * ping-pong -> RGB565 -> LCD, the pipeline of apps/platform/ipro7ai_evk_demo
 * cam.c on Zephyr. The board init already gave the sensor MCLK and a reset
 * pulse; start() repeats the reset with the MM blocks held in reset (the
 * SDK's fix for the ISP colour order), probes the sensor over SCCB, loads
 * its register table and runs the ISP into two PSRAM frames.
 *
 * The ISP firmware's AE/AWB (components/isp_firmware img_proc, FreeRTOS
 * tasks) is not built here: exposure and white balance stay at the
 * sensor's power-on values.
 */
#include "demo.h"
#include <ipro_zephyr/ipro_hal_glue.h>
#include <string.h>

#include "ipro7.h"
#include "drv_glb.h"
#include "drv_mm_misc.h"
#include "hal_isp.h"
#include "camera.h"
#include "sensor.h"
#include "sccb.h"

#define PREVIEW_W 320
#define PREVIEW_H 180              /* 16:9 letterboxed on the 320x240 landscape panel */
#define PREVIEW_Y ((240 - PREVIEW_H) / 2)
#define FRAME_BYTES (PREVIEW_W * PREVIEW_H * 4u)
#define CONVERGE_FRAMES 6
static uint8_t fps = 15; /* ISP channel-1 frame-rate control, source 30 fps */
static bool mirror = true; /* horizontal flip while repacking (the module faces the user) */


/* ISP channel-1 ping-pong output, ARGB, in PSRAM. */
__attribute__((section(".psram_bss"))) __aligned(32) static uint32_t frames[2][PREVIEW_W * PREVIEW_H];
/* ARGB (PSRAM) -> wire-order RGB565 strips in OCRAM, one DMA write per strip. */
#define STRIP_ROWS 12
static uint16_t strip[2][PREVIEW_W * STRIP_ROWS] __aligned(32);
static int64_t t_start;

static const rt_camera_desc *desc;
static volatile bool running;
static volatile uint32_t latest;
static volatile uint32_t last_frame; /* newest ISP frame address, for "cam pixels" */
static volatile uint32_t converge;
static struct { uint32_t frames, drawn, dropped, fifo_err, vsync_err, hsync_err, blit_err; int last_err; } st;
static K_SEM_DEFINE(frame_sem, 0, 1);
static K_THREAD_STACK_DEFINE(preview_stack, 2048);
static struct k_thread preview_thread;
static k_tid_t preview_tid;

void ipro7ai_evk_cam_mclk_pinmux(void);
void ipro7ai_evk_cam_mclk_clock(void);
void ipro7ai_evk_cam_reset(int assert);
void ipro7ai_evk_cam_dvp_pinmux(void);

/* The ISP firmware would register its 3A statistics hook here (not built). */
int ipro_isp_stats_ready_config(void *cb, void *usrdata)
{
	ARG_UNUSED(cb); ARG_UNUSED(usrdata);
	return 0;
}

static void isp_cb(isp_out_frame_info_t info)
{
	switch (info.event) {
	case ISP_HAL_INT_FIFO_OVERWRITE: st.fifo_err++; return;
	case ISP_HAL_INT_VSYNC_CNT_ERROR: st.vsync_err++; return;
	case ISP_HAL_INT_HSYNC_CNT_ERROR: st.hsync_err++; return;
	case ISP_HAL_INT_NORMAL: break;
	default: return;
	}
	if (info.out_port != ISP_CHANNEL_1) {
		return;
	}
	st.frames++;
	if (converge) {
		converge--;
		return;
	}
	if (latest) {
		st.dropped++;
	}
	latest = info.out_addr;
	last_frame = info.out_addr;
	k_sem_give(&frame_sem);
}

static inline uint16_t pack_be(uint32_t p)
{
	/* ISP ch1 ARGB: byte 0 = R, 1 = G, 2 = B (after the MM reset); RGB565 big-endian */
	uint16_t c = RGB565(p & 0xFF, (p >> 8) & 0xFF, (p >> 16) & 0xFF);

	return (uint16_t)((c >> 8) | (c << 8));
}

static void blit_frame(uint32_t addr)
{
	const uint32_t *px = (const uint32_t *)(uintptr_t)addr;
	bool be = lcd_big_endian();
	int which = 0;

	ipro_hal_cache_invalidate(addr, FRAME_BYTES);
	for (uint16_t y0 = 0; y0 < PREVIEW_H; y0 += STRIP_ROWS) {
		uint16_t rows = MIN(STRIP_ROWS, PREVIEW_H - y0);
		uint16_t *dst = strip[which];

		for (uint16_t y = 0; y < rows; y++) {
			const uint32_t *src = px + (uint32_t)(y0 + y) * PREVIEW_W;
			uint16_t *d = dst + (uint32_t)y * PREVIEW_W;

			if (mirror) {
				for (uint16_t x = 0; x < PREVIEW_W; x++) {
					uint16_t c = pack_be(src[x]);

					d[PREVIEW_W - 1 - x] = be ? c : (uint16_t)((c >> 8) | (c << 8));
				}
			} else {
				for (uint16_t x = 0; x < PREVIEW_W; x++) {
					uint16_t c = pack_be(src[x]);

					d[x] = be ? c : (uint16_t)((c >> 8) | (c << 8));
				}
			}
		}
		int r = lcd_write_raw(0, PREVIEW_Y + y0, PREVIEW_W, rows, dst, y0 + rows >= PREVIEW_H);

		if (r != 0) {
			st.blit_err++;
			st.last_err = r;
		}
		which ^= 1;
	}
	st.drawn++;
}

static void preview_fn(void *a, void *b, void *c)
{
	ARG_UNUSED(a); ARG_UNUSED(b); ARG_UNUSED(c);
	while (running) {
		if (k_sem_take(&frame_sem, K_MSEC(500)) != 0) {
			continue;
		}
		uint32_t addr = latest;

		latest = 0;
		if (addr && running) {
			blit_frame(addr);
		}
	}
}

static void mm_reset(void)
{
	MM_MISC_Set_SW_Reset(MM_MISC_SW_RESET_ID_DVP_AS, 1);
	MM_MISC_Set_SW_Reset(MM_MISC_SW_RESET_ID_DVP_AS, 0);
	MM_MISC_Set_SW_Reset(MM_MISC_SW_RESET_ID_DVP2AXI_C, 1);
	MM_MISC_Set_SW_Reset(MM_MISC_SW_RESET_ID_DVP2AXI_C, 0);
	MM_MISC_Set_SW_Reset(MM_MISC_SW_RESET_ID_ISP, 1);
	MM_MISC_Set_SW_Reset(MM_MISC_SW_RESET_ID_ISP, 0);
}

int cam_init(void)
{
	return 0;
}

bool cam_running(void) { return running; }

static int isp_up(const struct shell *sh)
{
	isp_hal_cfg_t cfg = {0};

	cfg.isp_src = ISP_HAL_SRC_DVP_AS;
	cfg.in_size.width = desc->width;
	cfg.in_size.height = desc->height;
	cfg.src_cfg.dvp_input.hsync = ISP_HAL_DVP_ACTIVE_HIGH;
	cfg.src_cfg.dvp_input.vsync = ISP_HAL_DVP_ACTIVE_HIGH;
	cfg.src_cfg.dvp_input.order = ISP_HAL_DATA_BYTE_LOWER;
	cfg.src_cfg.dvp_input.pclk = desc->pclk;
	cfg.src_cfg.dvp_input.totalHPixels = desc->total_width;
	cfg.glb_crop.width = desc->width;
	cfg.glb_crop.height = desc->height;
	cfg.out_ch_0.enable = 0;
	cfg.out_ch_1.enable = 1;
	cfg.out_ch_1.scaler_cfg.in.width = desc->width;
	cfg.out_ch_1.scaler_cfg.in.height = desc->height;
	cfg.out_ch_1.scaler_cfg.out.width = PREVIEW_W;
	cfg.out_ch_1.scaler_cfg.out.height = PREVIEW_H;
	cfg.out_ch_1.format = ISP_HAL_OUT_FMT1_ARGB;
	cfg.out_ch_1.chn_common.fr_ctrl.src_fps = 30;
	cfg.out_ch_1.chn_common.fr_ctrl.dst_fps = fps;
	cfg.out_ch_1.chn_common.addr[0] = (uint32_t)(uintptr_t)frames[0];
	cfg.out_ch_1.chn_common.addr[1] = (uint32_t)(uintptr_t)frames[1];
	cfg.out_ch_1.chn_common.pp_num = 2;
	cfg.out_ch_1.chn_common.out_crop.width = PREVIEW_W;
	cfg.out_ch_1.chn_common.out_crop.height = PREVIEW_H;
	cfg.out_callback = isp_cb;

	int r = isp_init(&cfg);

	if (r != 0) {
		shell_error(sh, "isp_init: %d", r);
		return -EIO;
	}
	for (int i = 0; i < 2; i++) {
		ipro_hal_cache_clean((uint32_t)(uintptr_t)frames[i], FRAME_BYTES);
		ipro_hal_cache_invalidate((uint32_t)(uintptr_t)frames[i], FRAME_BYTES);
	}
	/* PSRAM write/read command arbitration for the DVP2AXI-C master. */
	MM_MISC_Set_IPROAIPRO_Rcmd_Mode(MM_MISC_IPROAIPRO_MODE_PROACTIVE);
	MM_MISC_Set_IPROAIPRO_Rcmd_MasterEn(0, 0, 1);
	MM_MISC_Set_IPROAIPRO_Wcmd_Mode(MM_MISC_IPROAIPRO_MODE_PROACTIVE);
	MM_MISC_Set_IPROAIPRO_Wcmd_MasterEn(0, 0, 1);
	return isp_start() == 0 ? 0 : -EIO;
}

int cam_start(const struct shell *sh)
{
	if (running) {
		shell_print(sh, "already running");
		return 0;
	}
	memset(&st, 0, sizeof(st));
	latest = 0;
	t_start = k_uptime_get();
	converge = CONVERGE_FRAMES;

	/* Sensor in reset while the MM blocks are reset, MCLK on, release. */
	GLB_PER_Clock_UnGate(GLB_AHB_CLOCK_MM);
	ipro7ai_evk_cam_reset(1);
	mm_reset();
	ipro7ai_evk_cam_mclk_pinmux();
	ipro7ai_evk_cam_dvp_pinmux();
	ipro7ai_evk_cam_mclk_clock();
	k_msleep(2);
	ipro7ai_evk_cam_reset(0);
	k_msleep(20);

	if (SCCB_Init() != 0) {
		shell_error(sh, "i2c0 not ready");
		return -ENODEV;
	}
	desc = camera_module_init();
	if (desc == NULL) {
		shell_error(sh, "no sensor answered on SCCB (J6 pin 3-7 wired? FPC seated?)");
		return -ENODEV;
	}
	shell_print(sh, "sensor %s @0x%02x, %ux%u, pclk %u", desc->name, desc->addr, desc->width,
		    desc->height, desc->pclk);
	camera_module_start(desc); /* register table (720p, DVP) */

	running = true;
	shell_print(sh, "lcd clear: %d", lcd_fill(C_BLACK));
	preview_tid = k_thread_create(&preview_thread, preview_stack,
				      K_THREAD_STACK_SIZEOF(preview_stack), preview_fn, NULL, NULL,
				      NULL, K_LOWEST_APPLICATION_THREAD_PRIO, 0, K_NO_WAIT);
	k_thread_name_set(preview_tid, "cam_preview");
	int r = isp_up(sh);

	if (r != 0) {
		running = false;
		return r;
	}
	shell_print(sh, "preview %ux%u at %u fps on the LCD (ISP ch1 ARGB -> RGB565)", PREVIEW_W,
		    PREVIEW_H, fps);
	return 0;
}

int cam_stop(const struct shell *sh)
{
	if (!running) {
		shell_print(sh, "not running");
		return 0;
	}
	running = false;
	k_sem_give(&frame_sem);
	k_thread_join(preview_tid, K_MSEC(1000));
	(void)isp_deinit();
	ipro7ai_evk_cam_reset(1); /* hold the sensor in reset */
	{
		int64_t ms = MAX(k_uptime_get() - t_start, 1);

		shell_print(sh, "stopped after %lld ms: %u frames (%u.%u fps), %u drawn (%u.%u fps), "
			    "%u dropped, errors fifo %u vsync %u hsync %u, blit errors %u (last %d)",
			    ms, st.frames, (uint32_t)(st.frames * 1000 / ms),
			    (uint32_t)(st.frames * 10000 / ms % 10), st.drawn,
			    (uint32_t)(st.drawn * 1000 / ms), (uint32_t)(st.drawn * 10000 / ms % 10),
			    st.dropped, st.fifo_err, st.vsync_err, st.hsync_err, st.blit_err,
			    st.last_err);
	}
	return 0;
}

int cam_snap(const struct shell *sh)
{
	int r = running ? 0 : cam_start(sh);

	if (r != 0) {
		return r;
	}
	k_msleep(1500);
	shell_print(sh, "%u frames so far, %u drawn, errors fifo %u vsync %u hsync %u", st.frames,
		    st.drawn, st.fifo_err, st.vsync_err, st.hsync_err);
	return 0;
}

int cam_set_fps(const struct shell *sh, uint32_t n)
{
	if (n < 1 || n > 30) {
		return -EINVAL;
	}
	fps = (uint8_t)n;
	shell_print(sh, "fps %u (takes effect at the next start)", fps);
	return 0;
}

int cam_set_mirror(const struct shell *sh, bool on)
{
	mirror = on;
	shell_print(sh, "mirror %s", on ? "on" : "off");
	return 0;
}

/* A few ARGB pixels from the newest ISP frame (centre row), as the SDK's "cam pixels". */
int cam_pixels(const struct shell *sh)
{
	uint32_t addr = last_frame;

	if (addr == 0) {
		shell_error(sh, "no frame yet");
		return -ENODATA;
	}
	const uint32_t *px = (const uint32_t *)(uintptr_t)addr;
	uint32_t sum = 0;

	ipro_hal_cache_invalidate(addr, FRAME_BYTES);
	shell_print(sh, "frame @%08x, row %d from x=156:", addr, PREVIEW_H / 2);
	for (int i = 0; i < 8; i++) {
		shell_fprintf(sh, SHELL_NORMAL, " %08x", px[(PREVIEW_H / 2) * PREVIEW_W + 156 + i]);
	}
	for (uint32_t i = 0; i < PREVIEW_W * PREVIEW_H; i += 97) {
		sum += px[i] & 0x00FFFFFF;
	}
	shell_print(sh, "\nsampled sum of RGB bytes: %u (0 = all black)", sum);
	return 0;
}
```

## src/cmds.c
```c
/*
 * Copyright (c) 2026 INTELPRO
 * SPDX-License-Identifier: Apache-2.0
 *
 * Shell front end: "evk lcd ...", "evk mic ...", "evk spk ...", "evk cam ...".
 */
#include "demo.h"
#include <stdlib.h>

static uint16_t parse_color(const char *s)
{
	static const struct { const char *n; uint16_t c; } tab[] = {
		{"black", C_BLACK}, {"white", C_WHITE}, {"red", C_RED}, {"green", C_GREEN},
		{"blue", C_BLUE}, {"yellow", C_YELLOW}, {"cyan", C_CYAN}, {"magenta", C_MAGENTA},
	};
	for (size_t i = 0; i < ARRAY_SIZE(tab); i++) {
		if (strcmp(s, tab[i].n) == 0) {
			return tab[i].c;
		}
	}
	return (uint16_t)strtoul(s, NULL, 0);
}

static int cmd_lcd_fill(const struct shell *sh, size_t argc, char **argv)
{
	int r = lcd_fill(argc > 1 ? parse_color(argv[1]) : C_BLACK);

	shell_print(sh, "fill: %d", r);
	return r;
}

static int cmd_lcd_bars(const struct shell *sh, size_t argc, char **argv)
{
	ARG_UNUSED(argc); ARG_UNUSED(argv);
	int r = lcd_bars();

	shell_print(sh, "bars (white yellow cyan green magenta red blue black): %d", r);
	return r;
}

static int cmd_lcd_checker(const struct shell *sh, size_t argc, char **argv)
{
	int r = lcd_checker(argc > 1 ? (uint16_t)strtoul(argv[1], NULL, 0) : 16);

	shell_print(sh, "checker: %d", r);
	return r;
}

static int cmd_lcd_gradient(const struct shell *sh, size_t argc, char **argv)
{
	ARG_UNUSED(argc); ARG_UNUSED(argv);
	int r = lcd_gradient();

	shell_print(sh, "gradient (red across, green down, blue inverse): %d", r);
	return r;
}

static int cmd_lcd_bl(const struct shell *sh, size_t argc, char **argv)
{
	bool on = argc < 2 || strcmp(argv[1], "off") != 0;
	int r = lcd_backlight(on);

	shell_print(sh, "backlight %s: %d", on ? "on" : "off", r);
	return r;
}

static int cmd_lcd_info(const struct shell *sh, size_t argc, char **argv)
{
	ARG_UNUSED(argc); ARG_UNUSED(argv);
	shell_print(sh, "panel %ux%u RGB565, ST7789P3 over SPI0 (SCLK15 MOSI16 CS10 DC17 RST14), backlight GPIO12",
		    lcd_width(), lcd_height());
	return 0;
}

static int cmd_mic_level(const struct shell *sh, size_t argc, char **argv)
{
	return audio_mic_level(sh, argc > 1 ? strtoul(argv[1], NULL, 0) : 5, true);
}

static int cmd_mic_rec(const struct shell *sh, size_t argc, char **argv)
{
	return audio_mic_record(sh, argc > 1 ? strtoul(argv[1], NULL, 0) : 3);
}

static int cmd_mic_play(const struct shell *sh, size_t argc, char **argv)
{
	ARG_UNUSED(argc); ARG_UNUSED(argv);
	return audio_play_recording(sh);
}

static int cmd_mic_dump(const struct shell *sh, size_t argc, char **argv)
{
	ARG_UNUSED(argc); ARG_UNUSED(argv);
	return audio_mic_dump(sh);
}

static int cmd_spk_gain(const struct shell *sh, size_t argc, char **argv)
{
	int shift = argc > 1 ? (int)strtoul(argv[1], NULL, 0) : 2;
	int r = audio_set_gain_shift(shift);

	shell_print(sh, "playback gain x%d: %d", 1 << shift, r);
	return r;
}

static int cmd_mic_loop(const struct shell *sh, size_t argc, char **argv)
{
	return audio_loopback(sh, argc > 1 ? strtoul(argv[1], NULL, 0) : 10);
}

static int cmd_spk_tone(const struct shell *sh, size_t argc, char **argv)
{
	uint32_t hz = argc > 1 ? strtoul(argv[1], NULL, 0) : 1000;
	uint32_t ms = argc > 2 ? strtoul(argv[2], NULL, 0) : 1000;

	return audio_tone(sh, hz, ms);
}

#ifdef CONFIG_EVK_DEMO_CAMERA
static int cmd_cam_start(const struct shell *sh, size_t argc, char **argv)
{
	ARG_UNUSED(argc); ARG_UNUSED(argv);
	return cam_start(sh);
}
static int cmd_cam_stop(const struct shell *sh, size_t argc, char **argv)
{
	ARG_UNUSED(argc); ARG_UNUSED(argv);
	return cam_stop(sh);
}
static int cmd_cam_snap(const struct shell *sh, size_t argc, char **argv)
{
	ARG_UNUSED(argc); ARG_UNUSED(argv);
	return cam_snap(sh);
}
static int cmd_cam_fps(const struct shell *sh, size_t argc, char **argv)
{
	return cam_set_fps(sh, argc > 1 ? strtoul(argv[1], NULL, 0) : 15);
}
static int cmd_cam_mirror(const struct shell *sh, size_t argc, char **argv)
{
	return cam_set_mirror(sh, argc < 2 || strcmp(argv[1], "off") != 0);
}
static int cmd_cam_pixels(const struct shell *sh, size_t argc, char **argv)
{
	ARG_UNUSED(argc); ARG_UNUSED(argv);
	return cam_pixels(sh);
}
static int cmd_cam_status(const struct shell *sh, size_t argc, char **argv)
{
	ARG_UNUSED(argc); ARG_UNUSED(argv);
	shell_print(sh, "camera %s", cam_running() ? "running" : "stopped");
	return 0;
}
SHELL_STATIC_SUBCMD_SET_CREATE(sub_cam,
	SHELL_CMD(start, NULL, "Live preview on the LCD", cmd_cam_start),
	SHELL_CMD(stop, NULL, "Stop the preview", cmd_cam_stop),
	SHELL_CMD(snap, NULL, "Start and report after 1.5 s", cmd_cam_snap),
	SHELL_CMD(status, NULL, "Running or not", cmd_cam_status),
	SHELL_CMD(pixels, NULL, "Dump pixels of the newest ISP frame", cmd_cam_pixels),
	SHELL_CMD_ARG(fps, NULL, "fps <1..30> - ISP output rate (next start)", cmd_cam_fps, 1, 1),
	SHELL_CMD_ARG(mirror, NULL, "mirror on|off - horizontal flip (default on)", cmd_cam_mirror, 1, 1),
	SHELL_SUBCMD_SET_END);
#endif

SHELL_STATIC_SUBCMD_SET_CREATE(sub_lcd,
	SHELL_CMD(info, NULL, "Panel info", cmd_lcd_info),
	SHELL_CMD_ARG(fill, NULL, "fill [color|0xRGB565]", cmd_lcd_fill, 1, 1),
	SHELL_CMD(bars, NULL, "Colour bars", cmd_lcd_bars),
	SHELL_CMD_ARG(checker, NULL, "checker [cell px]", cmd_lcd_checker, 1, 1),
	SHELL_CMD(gradient, NULL, "RGB gradient", cmd_lcd_gradient),
	SHELL_CMD_ARG(bl, NULL, "bl on|off", cmd_lcd_bl, 1, 1),
	SHELL_SUBCMD_SET_END);

SHELL_STATIC_SUBCMD_SET_CREATE(sub_mic,
	SHELL_CMD_ARG(level, NULL, "level [seconds] - RMS meter (also on the LCD)", cmd_mic_level, 1, 1),
	SHELL_CMD_ARG(rec, NULL, "rec [seconds<=20] - record to PSRAM", cmd_mic_rec, 1, 1),
	SHELL_CMD(play, NULL, "Play the recording on the speaker", cmd_mic_play),
	SHELL_CMD(dump, NULL, "Print samples around block boundaries", cmd_mic_dump),
	SHELL_CMD_ARG(loop, NULL, "loop [seconds] - live mic -> speaker", cmd_mic_loop, 1, 1),
	SHELL_SUBCMD_SET_END);

SHELL_STATIC_SUBCMD_SET_CREATE(sub_spk,
	SHELL_CMD_ARG(tone, NULL, "tone [hz] [ms]", cmd_spk_tone, 1, 2),
	SHELL_CMD_ARG(gain, NULL, "gain <shift 0..5> - playback gain 2^shift", cmd_spk_gain, 1, 1),
	SHELL_SUBCMD_SET_END);

SHELL_STATIC_SUBCMD_SET_CREATE(sub_evk,
	SHELL_CMD(lcd, &sub_lcd, "LCD patterns", NULL),
	SHELL_CMD(mic, &sub_mic, "PDM microphone", NULL),
	SHELL_CMD(spk, &sub_spk, "Speaker (GPDAC)", NULL),
#ifdef CONFIG_EVK_DEMO_CAMERA
	SHELL_CMD(cam, &sub_cam, "Camera", NULL),
#endif
	SHELL_SUBCMD_SET_END);
SHELL_CMD_REGISTER(evk, &sub_evk, "IPRO7AI EVK demo", NULL);
```

## src/demo.h
```c
/*
 * Copyright (c) 2026 INTELPRO
 * SPDX-License-Identifier: Apache-2.0
 */
#ifndef EVK_DEMO_H_
#define EVK_DEMO_H_

#include <zephyr/kernel.h>
#include <zephyr/shell/shell.h>
#include <stdint.h>
#include <stdbool.h>

/* RGB565 helpers */
#define RGB565(r, g, b) ((uint16_t)((((r) & 0xF8) << 8) | (((g) & 0xFC) << 3) | ((b) >> 3)))
#define C_BLACK   RGB565(0, 0, 0)
#define C_WHITE   RGB565(255, 255, 255)
#define C_RED     RGB565(255, 0, 0)
#define C_GREEN   RGB565(0, 255, 0)
#define C_BLUE    RGB565(0, 0, 255)
#define C_YELLOW  RGB565(255, 255, 0)
#define C_CYAN    RGB565(0, 255, 255)
#define C_MAGENTA RGB565(255, 0, 255)

/* lcd.c */
int lcd_init(void);
uint16_t lcd_width(void);
uint16_t lcd_height(void);
int lcd_fill(uint16_t color);
int lcd_fill_rect(uint16_t x, uint16_t y, uint16_t w, uint16_t h, uint16_t color);
int lcd_bars(void);
int lcd_checker(uint16_t cell);
int lcd_gradient(void);
/** Blit a w x h RGB565 frame (row-major, wire byte order handled here). */
int lcd_blit(uint16_t x, uint16_t y, uint16_t w, uint16_t h, const uint16_t *rgb565);
int lcd_backlight(bool on);
int lcd_write_raw(uint16_t x, uint16_t y, uint16_t w, uint16_t h, const void *wire_pixels, bool last);
bool lcd_big_endian(void);
/** Horizontal level bar at the bottom of the panel, 0..1000 permille. */
int lcd_level_bar(uint16_t permille, uint16_t color);

/* audio.c */
int audio_init(void);
int audio_mic_level(const struct shell *sh, uint32_t seconds, bool on_lcd);
int audio_mic_record(const struct shell *sh, uint32_t seconds);
int audio_mic_dump(const struct shell *sh);
int audio_set_gain_shift(int shift);
int audio_play_recording(const struct shell *sh);
int audio_tone(const struct shell *sh, uint32_t hz, uint32_t ms);
int audio_loopback(const struct shell *sh, uint32_t seconds);
uint32_t audio_recorded_samples(void);
uint32_t audio_rate(void);

/* cam.c (CONFIG_EVK_DEMO_CAMERA) */
int cam_init(void);
int cam_start(const struct shell *sh);
int cam_stop(const struct shell *sh);
int cam_snap(const struct shell *sh);
bool cam_running(void);
int cam_set_fps(const struct shell *sh, uint32_t n);
int cam_set_mirror(const struct shell *sh, bool on);
int cam_pixels(const struct shell *sh);

#endif /* EVK_DEMO_H_ */
```

## src/lcd.c
```c
/*
 * Copyright (c) 2026 INTELPRO
 * SPDX-License-Identifier: Apache-2.0
 *
 * LCD helpers over the Zephyr display API (ST7789P3 through spi_ipro +
 * mipi-dbi-spi on the EVK). Row-buffered writes: the panel is 240x320
 * RGB565, a full frame is 150 KB, so patterns are streamed a strip at a
 * time from a 4 KB scratch buffer.
 */
#include "demo.h"
#include <zephyr/device.h>
#include <zephyr/drivers/display.h>
#include <zephyr/drivers/gpio.h>
#include <zephyr/sys/byteorder.h>
#include <string.h>

static const struct device *const disp = DEVICE_DT_GET(DT_CHOSEN(zephyr_display));
static const struct gpio_dt_spec bl = GPIO_DT_SPEC_GET(DT_NODELABEL(lcd_backlight), gpios);
static struct display_capabilities caps;
#define STRIP_PIXELS 4096 /* 8 KB: 12 rows of a 320-wide frame per SPI write */
static uint16_t strip[STRIP_PIXELS];
static bool big_endian_pixels;

int lcd_init(void)
{
	if (!device_is_ready(disp)) {
		return -ENODEV;
	}
	display_get_capabilities(disp, &caps);
	/* PIXEL_FORMAT_RGB_565 is big-endian on the wire; RGB_565X little-endian. */
	big_endian_pixels = (caps.current_pixel_format & PIXEL_FORMAT_RGB_565X) == 0;
	(void)display_blanking_off(disp);
	(void)lcd_backlight(true);
	return 0;
}

uint16_t lcd_width(void) { return caps.x_resolution; }
uint16_t lcd_height(void) { return caps.y_resolution; }

int lcd_backlight(bool on)
{
	if (!gpio_is_ready_dt(&bl)) {
		return -ENODEV;
	}
	return gpio_pin_configure_dt(&bl, on ? GPIO_OUTPUT_ACTIVE : GPIO_OUTPUT_INACTIVE);
}

static inline uint16_t wire(uint16_t c)
{
	return big_endian_pixels ? sys_cpu_to_be16(c) : c;
}

int lcd_fill_rect(uint16_t x, uint16_t y, uint16_t w, uint16_t h, uint16_t color)
{
	uint16_t rows = STRIP_PIXELS / w;
	struct display_buffer_descriptor d = {.width = w, .pitch = w, .frame_incomplete = true};
	uint16_t c = wire(color);

	if (w == 0 || rows == 0) {
		return -EINVAL;
	}
	for (int i = 0; i < w * rows; i++) {
		strip[i] = c;
	}
	for (uint16_t yy = 0; yy < h; yy += rows) {
		uint16_t n = MIN(rows, h - yy);

		d.height = n;
		d.buf_size = n * w * 2;
		d.frame_incomplete = (yy + n) < h;
		int r = display_write(disp, x, y + yy, &d, strip);

		if (r != 0) {
			return r;
		}
	}
	return 0;
}

int lcd_fill(uint16_t color)
{
	return lcd_fill_rect(0, 0, caps.x_resolution, caps.y_resolution, color);
}

int lcd_bars(void)
{
	static const uint16_t cols[8] = {C_WHITE, C_YELLOW, C_CYAN, C_GREEN,
					 C_MAGENTA, C_RED, C_BLUE, C_BLACK};
	uint16_t bw = caps.x_resolution / 8;

	for (int i = 0; i < 8; i++) {
		int r = lcd_fill_rect(i * bw, 0, (i == 7) ? caps.x_resolution - 7 * bw : bw,
				      caps.y_resolution, cols[i]);
		if (r != 0) {
			return r;
		}
	}
	return 0;
}

int lcd_checker(uint16_t cell)
{
	uint16_t w = caps.x_resolution;
	struct display_buffer_descriptor d = {.width = w, .pitch = w, .height = 1, .buf_size = w * 2};

	if (cell == 0) {
		cell = 16;
	}
	for (uint16_t y = 0; y < caps.y_resolution; y++) {
		for (uint16_t x = 0; x < w; x++) {
			strip[x] = wire((((x / cell) + (y / cell)) & 1) ? C_WHITE : C_BLACK);
		}
		d.frame_incomplete = (y + 1) < caps.y_resolution;
		int r = display_write(disp, 0, y, &d, strip);

		if (r != 0) {
			return r;
		}
	}
	return 0;
}

int lcd_gradient(void)
{
	uint16_t w = caps.x_resolution;
	struct display_buffer_descriptor d = {.width = w, .pitch = w, .height = 1, .buf_size = w * 2};

	for (uint16_t y = 0; y < caps.y_resolution; y++) {
		uint8_t g = (uint8_t)(y * 255 / (caps.y_resolution - 1));

		for (uint16_t x = 0; x < w; x++) {
			uint8_t rr = (uint8_t)(x * 255 / (w - 1));

			strip[x] = wire(RGB565(rr, g, 255 - rr));
		}
		d.frame_incomplete = (y + 1) < caps.y_resolution;
		int r = display_write(disp, 0, y, &d, strip);

		if (r != 0) {
			return r;
		}
	}
	return 0;
}

int lcd_blit(uint16_t x, uint16_t y, uint16_t w, uint16_t h, const uint16_t *rgb565)
{
	uint16_t rows = STRIP_PIXELS / w;
	struct display_buffer_descriptor d = {.width = w, .pitch = w};

	if (w == 0 || rows == 0) {
		return -EINVAL;
	}
	for (uint16_t yy = 0; yy < h; yy += rows) {
		uint16_t n = MIN(rows, h - yy);
		const uint16_t *src = rgb565 + (size_t)yy * w;

		for (size_t i = 0; i < (size_t)n * w; i++) {
			strip[i] = wire(src[i]);
		}
		d.height = n;
		d.buf_size = n * w * 2;
		d.frame_incomplete = (yy + n) < h;
		int r = display_write(disp, x, y + yy, &d, strip);

		if (r != 0) {
			return r;
		}
	}
	return 0;
}

int lcd_level_bar(uint16_t permille, uint16_t color)
{
	uint16_t h = 12, y = caps.y_resolution - h;
	uint16_t lit = (uint32_t)caps.x_resolution * MIN(permille, 1000) / 1000;
	int r = lcd_fill_rect(0, y, lit ? lit : 1, h, lit ? color : C_BLACK);

	if (r == 0 && lit < caps.x_resolution) {
		r = lcd_fill_rect(lit, y, caps.x_resolution - lit, h, C_BLACK);
	}
	return r;
}

/* Raw strip write: pixels already in the panel's wire byte order. */
int lcd_write_raw(uint16_t x, uint16_t y, uint16_t w, uint16_t h, const void *wire_pixels,
		  bool last)
{
	struct display_buffer_descriptor d = {
		.width = w, .pitch = w, .height = h, .buf_size = (uint32_t)w * h * 2,
		.frame_incomplete = !last,
	};
	return display_write(disp, x, y, &d, wire_pixels);
}

bool lcd_big_endian(void)
{
	return big_endian_pixels;
}
```
