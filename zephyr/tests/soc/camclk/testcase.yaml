## zephyr/tests/soc/camclk/testcase.yaml
```yaml
common:
  platform_allow:
    - ipro7_evb
    - ipro7ai_evk
  integration_platforms:
    - ipro7_evb
  tags:
    - soc
    - ipro
    - camera
  harness: console
  harness_config:
    type: one_line
    regex:
      - "PROBE DONE"
tests:
  soc.ipro.camclk:
    build_only: false
```

## zephyr/tests/soc/psram/testcase.yaml
```yaml
common:
  platform_allow:
    - ipro7ai_evk
  integration_platforms:
    - ipro7ai_evk
  tags:
    - soc
    - ipro
    - psram
  harness: ztest
tests:
  soc.ipro.psram:
    build_only: false
```

## zephyr/tests/soc/reboot/testcase.yaml
```yaml
common:
  platform_allow:
    - ipro7_evb
    - ipro7ai_evk
  integration_platforms:
    - ipro7_evb
  tags:
    - soc
    - ipro
    - reboot
    - hwinfo
  harness: ztest
tests:
  soc.ipro.reboot:
    build_only: false
```
