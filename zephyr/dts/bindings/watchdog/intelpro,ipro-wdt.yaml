## zephyr/dts/bindings/watchdog/intelpro,ipro-wdt.yaml
```yaml
# Copyright (c) 2026 INTELPRO
# SPDX-License-Identifier: Apache-2.0

description: |
  IPRO7 watchdog (WDT0 inside the TIMER block @0x30010000). 16-bit counter
  clocked from the 32 kHz clock / 32 (1 kHz, set by the clock-control
  driver) -> 1 ms resolution, up to 65.535 s. Fires a reset, or the
  TIMER0_WDT interrupt when interrupt mode is used. Driven through the SDK
  HAL (hal_wdt.c).

compatible: "intelpro,ipro-wdt"

include: base.yaml

properties:
  reg:
    required: true

  interrupts:
    required: true

  clocks:
    required: true
```

## zephyr/dts/bindings/wifi/intelpro,ipro-wifi.yaml
```yaml
# Copyright (c) 2026 INTELPRO
# SPDX-License-Identifier: Apache-2.0

description: IPRO6S on-chip Wi-Fi 6 MAC/PHY (SDK macsw + fhost stack)

compatible: "intelpro,ipro-wifi"

include: base.yaml
```

## zephyr/samples/bap_broadcast_source/sample.yaml
```yaml
sample:
  name: BAP broadcast source (LC3 sine) on the IPRO7 ISO controller
tests:
  sample.ipro.bap_broadcast_source:
    platform_allow:
      - ipro7_evb
      - ipro7ai_evk
    integration_platforms:
      - ipro7_evb
    tags:
      - ipro
      - bluetooth
      - leaudio
    build_only: true
```

## zephyr/soc/intelpro/Kconfig
```kconfig
# Copyright (c) 2026 INTELPRO
# SPDX-License-Identifier: Apache-2.0

if SOC_FAMILY_INTELPRO

rsource "*/Kconfig"

endif # SOC_FAMILY_INTELPRO
```

## zephyr/soc/intelpro/Kconfig.soc
```kconfig
# Copyright (c) 2026 INTELPRO
# SPDX-License-Identifier: Apache-2.0

config SOC_FAMILY_INTELPRO
	bool

config SOC_FAMILY
	default "intelpro" if SOC_FAMILY_INTELPRO

rsource "*/Kconfig.soc"
```

## zephyr/soc/intelpro/ipro6s/Kconfig
```kconfig
# Copyright (c) 2026 INTELPRO
# SPDX-License-Identifier: Apache-2.0

config SOC_SERIES_IPRO6S
	select RISCV
	select RISCV_PRIVILEGED
	select RISCV_ISA_RV32I
	select RISCV_ISA_EXT_M
	select RISCV_ISA_EXT_A
	select RISCV_ISA_EXT_F
	select RISCV_ISA_EXT_C
	select RISCV_ISA_EXT_ZICSR
	select RISCV_ISA_EXT_ZIFENCEI
	select RISCV_ISA_EXT_ZBA
	select RISCV_ISA_EXT_ZBB
	select RISCV_ISA_EXT_ZBC
	select RISCV_ISA_EXT_ZBS
	select CPU_HAS_FPU
	select RISCV_HAS_CLIC
	select RISCV_SOC_CONTEXT_SAVE
	select RISCV_SOC_HAS_GP_RELATIVE_ADDRESSING
	select RISCV_SOC_INTERRUPT_INIT
	select INCLUDE_RESET_VECTOR
	select XIP
	select SOC_PREP_HOOK
	select SOC_EARLY_INIT_HOOK
	select DYNAMIC_INTERRUPTS
	select IPRO_HAL
	select INTC_IPRO_ECLIC
	select IPRO_SYSTIMER

if SOC_SERIES_IPRO6S

config IPRO6S_EM_SIZE_KB
	int "BLE Exchange Memory carved from the top of WRAM (KB)"
	default 0
	range 0 64
	help
	  On IPRO6S the BLE controller's Exchange Memory comes out of the
	  160 KB WRAM (GLB_SRAM_CFG3[3:0], one bit per 16 KB from the top),
	  not out of OCRAM. 0 when Bluetooth is not used.

config IPRO6S_MCU_CLOCK_FALLBACK
	bool "Program the 240/80 MHz clock tree if the bootheader did not"
	default y
	help
	  The IPRO6 bootheader normally leaves MCU 240 MHz / PBCLK 80 MHz.
	  Re-tune only when the tree is not already there (RAM/debug boots),
	  exactly like bsp/board/ipro6/board.c.

config IPRO6S_DCACHE
	bool "Enable the L1 data cache"
	default y
	help
	  Turn on the D-cache in soc_early_init_hook(). DMA buffers are kept
	  coherent by the DMA glue; XIP flash routines run from OCRAM.

endif # SOC_SERIES_IPRO6S
```

## zephyr/soc/intelpro/ipro6s/Kconfig.soc
```kconfig
# Copyright (c) 2026 INTELPRO
# SPDX-License-Identifier: Apache-2.0

config SOC_SERIES_IPRO6S
	bool
	select SOC_FAMILY_INTELPRO
	help
	  INTELPRO IPRO6S (the IPRO6 die): the same Nuclei N300-class RV32IMAFC
	  core and ECLIC as IPRO7, 320 KB OCRAM + 160 KB WRAM, no PSRAM, XIP
	  flash at 0x13000000, Wi-Fi 6 + BLE + IEEE 802.15.4 radios.

config SOC_SERIES
	default "ipro6s" if SOC_SERIES_IPRO6S

config SOC_IPRO6S
	bool
	select SOC_SERIES_IPRO6S
	help
	  IPRO6S. The SDK builds it as CONFIG_IPRO6 / bsp/drivers/ipro6_soc.

config SOC
	default "ipro6s" if SOC_IPRO6S
```

## zephyr/soc/intelpro/ipro7/Kconfig
```kconfig
# Copyright (c) 2026 INTELPRO
# SPDX-License-Identifier: Apache-2.0

config SOC_SERIES_IPRO7
	select RISCV
	select RISCV_PRIVILEGED
	select RISCV_ISA_RV32I
	select RISCV_ISA_EXT_M
	select RISCV_ISA_EXT_A
	select RISCV_ISA_EXT_F
	select RISCV_ISA_EXT_C
	select RISCV_ISA_EXT_ZICSR
	select RISCV_ISA_EXT_ZIFENCEI
	select RISCV_ISA_EXT_ZBA
	select RISCV_ISA_EXT_ZBB
	select RISCV_ISA_EXT_ZBC
	select RISCV_ISA_EXT_ZBS
	select CPU_HAS_FPU
	select RISCV_HAS_CLIC
	select RISCV_SOC_CONTEXT_SAVE
	select RISCV_SOC_HAS_GP_RELATIVE_ADDRESSING
	select RISCV_SOC_INTERRUPT_INIT
	select INCLUDE_RESET_VECTOR
	select XIP
	select HAS_FLASH_LOAD_OFFSET
	select SOC_PREP_HOOK
	select SOC_EARLY_INIT_HOOK
	select DYNAMIC_INTERRUPTS
	select IPRO_HAL
	select INTC_IPRO_ECLIC
	select IPRO_SYSTIMER

if SOC_SERIES_IPRO7

config IPRO7_IDLE_NO_WFI
	bool "Busy-wait in the idle thread instead of WFI (diagnostic)"
	select ARCH_HAS_CUSTOM_CPU_IDLE
	select ARCH_HAS_CUSTOM_CPU_ATOMIC_IDLE
	help
	  Replace the RISC-V "wfi" in arch_cpu_idle()/arch_cpu_atomic_idle()
	  with an interrupt-enabled spin. Costs power; only for isolating
	  resets or hangs that coincide with the core going idle.

config IPRO7_NPU
	bool "NPU (IPRO7AI) support"
	select IPRO_HAL_USE_PSRAM
	help
	  Build for the IPRO7AI variant. Enables the NPU power domain bit at
	  reset and requires PSRAM for activation buffers (mirrors the SDK's
	  CONFIG_AI_SUPPORT semantics).

config IPRO7_EM_SIZE_KB
	int "BLE Exchange Memory carved from the top of OCRAM (KB)"
	default 0
	range 0 64
	help
	  Size of the Exchange Memory the BLE controller takes from the top of
	  the 256 KB OCRAM. Must match what the board's SRAM node exposes to
	  Zephyr (CONFIG_SRAM_SIZE = 256 - EM) and the BLE controller variant
	  (bt54_iso2 archives need 32 KB). 0 when Bluetooth is not used.

config IPRO7_CLOCK_BOOST_AT_RESET
	bool "Switch to PLL 192 MHz before the .data copy"
	default y
	help
	  Run the SDK's XIP-resident clock_boost_init() from soc_prep_hook so
	  the LMA->VMA copy and everything after it runs at HCLK 192 MHz
	  instead of the boot ROM's XCLK. Mirrors bsp/drivers/ipro7_soc's
	  startup_ipro7.S.

config IPRO7_DCDC14_VOUT_SEL
	hex "DCDC14 output code for the VDD14 rail"
	default 0x1b
	help
	  AON DCDC14 vout_sel written at boot (board.c: 0x0B = 1.4 V,
	  0x0F = 1.5 V, 0x1B = 1.8 V default).

config IPRO7_LDO14_VOUT_SEL
	hex "LDO14 vout_sel while LDO14 is retired"
	default 0x7
	help
	  Lower codes reduce residual divider leakage once the DCDC owns the
	  rail (board.c uses 0x7 with the 1.8 V DCDC target).

config IPRO7_DCACHE
	bool "Enable the L1 data cache"
	default y
	help
	  Enable the Nuclei L1 D-cache at early init (same as the SDK unless
	  it is built with CONFIG_DCACHE_DISABLE). DMA buffers must then be
	  flushed/invalidated or placed in the non-cacheable alias.

config SOC_IPRO7_XTAL_CAPCODE
	int "RF crystal capcode trim (0 = no trim, RF init loads 85)"
	range 0 255
	default 0
	help
	  Load-capacitance trim of the 32 MHz RF crystal (AON XTAL capcode
	  in/out). The crystal sets the 2.4 GHz carrier and also clocks the
	  mtimer, so this trims the BLE / 802.15.4 frequency error and the
	  kernel clock rate together. Same trim as the FreeRTOS SDK's
	  IPRO7_XTAL_CAPCODE, which is what the shared RF code reads (mirrored
	  in Kconfig.hal).

	  A non-zero value is written by soc_early_init_hook() and boot prints
	  "[XTAL] capcode <boot> -> <value>". Every RF init (the BLE
	  controller's HCI reset, 802.15.4 radio init and reset) loads it
	  again. With 0 the boot value stays until the first RF init, which
	  then loads the ROM default 85.

	  Board-class values (mtimer against NTP): the IPRO7AI Reef runs
	  +12..+16 ppm fast at 85 and +0.2..+4.7 ppm at 95. Zephyr has no Reef
	  board; on a Reef (which runs ipro7_evb images) set
	  CONFIG_SOC_IPRO7_XTAL_CAPCODE=95. The bench IPRO7 EVBs are +57..68
	  ppm at 85 and reach 0 ppm near 155..172. Production units still
	  need a per-unit eFuse trim.

endif # SOC_SERIES_IPRO7
```

## zephyr/soc/intelpro/ipro7/Kconfig.soc
```kconfig
# Copyright (c) 2026 INTELPRO
# SPDX-License-Identifier: Apache-2.0

config SOC_SERIES_IPRO7
	bool
	select SOC_FAMILY_INTELPRO
	help
	  INTELPRO IPRO7 series: Nuclei N300-class RV32IMAFC core with ECLIC,
	  256 KB OCRAM, XIP flash at 0x13000000, optional 8 MB PSRAM, BLE 5.4
	  and IEEE 802.15.4 radios.

config SOC_SERIES
	default "ipro7" if SOC_SERIES_IPRO7

config SOC_IPRO7
	bool
	select SOC_SERIES_IPRO7
	help
	  IPRO7 / IPRO7AI (same die; the AI variant enables the NPU).

config SOC
	default "ipro7" if SOC_IPRO7
```

## zephyr/subsys/shell/Kconfig
```kconfig
# Copyright (c) 2026 INTELPRO
# SPDX-License-Identifier: Apache-2.0

config IPRO_SHELL_CMDS
	bool "IPRO board shell commands (reboot, reboot_dl, ipro info)"
	default y
	depends on SHELL && SOC_FAMILY_INTELPRO
	select REBOOT
	select HWINFO
	help
	  The commands the FreeRTOS SDK shell provides on every firmware, so
	  the flash tooling can enter download mode over the console
	  ("reboot_dl") and a board can be reset ("reboot") without a cable
	  or the BOOT pin.
```

## zephyr/tests/drivers/counter/testcase.yaml
```yaml
common:
  platform_allow:
    - ipro7_evb
    - ipro7ai_evk
    - ipro6s_evb
  integration_platforms:
    - ipro7_evb
  tags:
    - drivers
    - ipro
    - counter
  harness: ztest
tests:
  drivers.ipro.counter:
    build_only: false
```

## zephyr/tests/drivers/dac_stream/testcase.yaml
```yaml
common:
  platform_allow:
    - ipro7_evb
    - ipro7ai_evk
  integration_platforms:
    - ipro7_evb
  tags:
    - drivers
    - ipro
    - dac
    - dma
  harness: ztest
tests:
  drivers.ipro.dac_stream:
    build_only: false
```

## zephyr/tests/drivers/dma/testcase.yaml
```yaml
common:
  platform_allow:
    - ipro7_evb
    - ipro7ai_evk
    - ipro6s_evb
  integration_platforms:
    - ipro7_evb
  tags:
    - drivers
    - ipro
    - dma
  harness: ztest
tests:
  drivers.ipro.dma:
    build_only: false
```

## zephyr/tests/drivers/entropy/testcase.yaml
```yaml
common:
  platform_allow:
    - ipro7_evb
    - ipro7ai_evk
    - ipro6s_evb
  integration_platforms:
    - ipro7_evb
  tags:
    - drivers
    - ipro
    - entropy
  harness: ztest
tests:
  drivers.ipro.entropy:
    build_only: false
```

## zephyr/tests/drivers/flash/testcase.yaml
```yaml
common:
  platform_allow:
    - ipro7_evb
    - ipro7ai_evk
    - ipro6s_evb
  integration_platforms:
    - ipro7_evb
  tags:
    - drivers
    - ipro
    - flash
  harness: ztest
tests:
  drivers.ipro.flash:
    build_only: false
```

## zephyr/tests/drivers/gpio/testcase.yaml
```yaml
common:
  platform_allow:
    - ipro7_evb
    - ipro7ai_evk
    - ipro6s_evb
  integration_platforms:
    - ipro7_evb
  tags:
    - drivers
    - ipro
    - gpio
  harness: ztest
tests:
  drivers.ipro.gpio:
    build_only: false
```

## zephyr/tests/drivers/i2c/testcase.yaml
```yaml
common:
  platform_allow:
    - ipro7_evb
    - ipro7ai_evk
  integration_platforms:
    - ipro7_evb
  tags:
    - drivers
    - ipro
    - i2c
  harness: ztest
tests:
  drivers.ipro.i2c:
    build_only: false
```

## zephyr/tests/drivers/pwm/testcase.yaml
```yaml
common:
  platform_allow:
    - ipro7_evb
    - ipro7ai_evk
  integration_platforms:
    - ipro7_evb
  tags:
    - drivers
    - ipro
    - pwm
  harness: ztest
tests:
  drivers.ipro.pwm:
    build_only: false
```

## zephyr/tests/drivers/rtc/testcase.yaml
```yaml
common:
  platform_allow:
    - ipro7_evb
    - ipro7ai_evk
  integration_platforms:
    - ipro7_evb
  tags:
    - drivers
    - ipro
    - counter
    - rtc
  harness: ztest
tests:
  drivers.ipro.rtc:
    build_only: false
```

## zephyr/tests/drivers/uart/testcase.yaml
```yaml
common:
  platform_allow:
    - ipro7_evb
    - ipro7ai_evk
    - ipro6s_evb
  integration_platforms:
    - ipro7_evb
  tags:
    - drivers
    - ipro
    - uart
  harness: ztest
tests:
  drivers.ipro.uart:
    build_only: false
```

## zephyr/tests/drivers/uart_async/testcase.yaml
```yaml
common:
  platform_allow:
    - ipro7_evb
    - ipro7ai_evk
  integration_platforms:
    - ipro7_evb
  tags:
    - drivers
    - ipro
    - uart
    - dma
  harness: ztest
tests:
  drivers.ipro.uart_async:
    build_only: false
```

## zephyr/tests/drivers/watchdog/testcase.yaml
```yaml
common:
  platform_allow:
    - ipro7_evb
    - ipro7ai_evk
    - ipro6s_evb
  integration_platforms:
    - ipro7_evb
  tags:
    - drivers
    - ipro
    - watchdog
  harness: ztest
tests:
  drivers.ipro.watchdog:
    build_only: false
```
