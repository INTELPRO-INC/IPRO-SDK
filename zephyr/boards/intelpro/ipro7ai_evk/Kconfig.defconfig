## zephyr/boards/intelpro/ipro7ai_evk/Kconfig.ipro7ai_evk
```kconfig
# Copyright (c) 2026 INTELPRO
# SPDX-License-Identifier: Apache-2.0

config BOARD_IPRO7AI_EVK
	select SOC_IPRO7
```

## zephyr/boards/intelpro/ipro7ai_evk/board.yml
```yaml
board:
  name: ipro7ai_evk
  full_name: IPRO7AI EVK (IPRO7AI_MODULE_SUB_0812A)
  vendor: intelpro
  socs:
    - name: ipro7
```

## zephyr/drivers/Kconfig
```kconfig
# Copyright (c) 2026 INTELPRO
# SPDX-License-Identifier: Apache-2.0

rsource "interrupt_controller/Kconfig"
rsource "timer/Kconfig"
rsource "clock_control/Kconfig"
rsource "pinctrl/Kconfig"
rsource "gpio/Kconfig"
rsource "serial/Kconfig"
rsource "spi/Kconfig"
rsource "i2c/Kconfig"
rsource "pwm/Kconfig"
rsource "flash/Kconfig"
rsource "watchdog/Kconfig"
rsource "counter/Kconfig"
rsource "dma/Kconfig"
rsource "entropy/Kconfig"
rsource "ieee802154/Kconfig"
rsource "bluetooth/Kconfig"
rsource "hwinfo/Kconfig"
rsource "adc/Kconfig"
rsource "dac/Kconfig"
rsource "i2s/Kconfig"
rsource "audio/Kconfig"
rsource "wifi/Kconfig"
```

## zephyr/drivers/adc/Kconfig
```kconfig
# Copyright (c) 2026 INTELPRO
# SPDX-License-Identifier: Apache-2.0

config ADC_IPRO
	bool "IPRO7 GPADC driver"
	default y
	depends on DT_HAS_INTELPRO_IPRO_ADC_ENABLED
	depends on ADC
	select IPRO_HAL
	help
	  Zephyr ADC over the IPRO7 GPADC (SDK LL drv_adc.c): 12/14/16-bit
	  single-ended conversions on the 12 analog pads and the internal
	  channels (DAC outputs, temperature sensor, Vref, VBAT/2, GND).

config ADC_IPRO_DISCARD_ROUNDS
	int "Conversion rounds to discard after a start"
	depends on ADC_IPRO
	default 2
	range 0 8
	help
	  The GPADC's first conversions after a start carry the previous input;
	  the driver runs the scan list continuously and drops this many rounds
	  before taking the samples it returns.
```

## zephyr/drivers/audio/Kconfig
```kconfig
# Copyright (c) 2026 INTELPRO
# SPDX-License-Identifier: Apache-2.0

config AUDIO_DMIC_IPRO
	bool "IPRO7 PDM microphone (AUADC) driver"
	default y
	depends on DT_HAS_INTELPRO_IPRO_PDM_ENABLED
	depends on AUDIO_DMIC
	select IPRO_HAL
	select DMA
	help
	  Zephyr DMIC over the IPRO7 AUADC PDM input (SDK HAL hal_auadc.c):
	  one 16-bit channel at 8/16/32/48 kHz nominal, frames delivered by DMA
	  into the application's memory slab. Not yet verified on hardware.

config DMIC_IPRO_MAX_BLOCK_SIZE
	int "Largest PCM block (bytes) a stream may ask for"
	depends on AUDIO_DMIC_IPRO
	default 2048
	range 2 8190
	help
	  Sizes the static, cache-aligned DMA ping-pong pair (2 x this).

config DMIC_IPRO_DIGITAL_GAIN_DB
	int "AUADC digital gain (dB, -95..18)"
	depends on AUDIO_DMIC_IPRO
	default 18
	range -95 18
	help
	  Applied after each configure. 18 dB is the hardware maximum and what
	  the SDK's microphone apps use; the PDM path is quiet without it.

config DMIC_IPRO_QUEUE_LEN
	int "Captured blocks queued for dmic_read()"
	depends on AUDIO_DMIC_IPRO
	default 4
```

## zephyr/drivers/clock_control/Kconfig
```kconfig
# Copyright (c) 2026 INTELPRO
# SPDX-License-Identifier: Apache-2.0

config CLOCK_CONTROL_IPRO
	bool "IPRO7 GLB peripheral clock gate controller"
	default y
	depends on DT_HAS_INTELPRO_IPRO_GLB_CLOCK_ENABLED
	depends on CLOCK_CONTROL
	select IPRO_HAL
	help
	  Zephyr clock_control API over the SDK's GLB_PER_Clock_UnGate/Gate
	  (AHB clock gates) and Clock_Peripheral_Clock_Get (functional clock
	  rates). Every ipro_* driver turns its clock on through this driver
	  instead of touching GLB itself.
```

## zephyr/drivers/counter/Kconfig
```kconfig
# Copyright (c) 2026 INTELPRO
# SPDX-License-Identifier: Apache-2.0

config COUNTER_IPRO
	bool "IPRO7 TIMER counter driver"
	default y
	depends on DT_HAS_INTELPRO_IPRO_COUNTER_ENABLED
	depends on COUNTER
	select IPRO_HAL
	help
	  Zephyr counter over the IPRO7 TIMER block (SDK LL drv_timer.c):
	  32-bit channels, two alarms per channel, settable top value.

config COUNTER_IPRO_RTC
	bool "IPRO HBN RTC counter driver"
	default y
	depends on DT_HAS_INTELPRO_IPRO_RTC_ENABLED
	depends on COUNTER
	select IPRO_HAL
	select COUNTER_SUPPORTS_64BITS_TICKS
	select COUNTER_64BITS_TICKS
	help
	  Zephyr counter over the HBN RTC: free-running 40-bit 32 kHz counter
	  that keeps running through PDS/HBN sleep, one alarm on HBN_OUT0.

config COUNTER_IPRO_RTC_MEASURE_MS
	int "Measure the RTC clock against the crystal at init (ms, 0 = skip)"
	depends on COUNTER_IPRO_RTC
	default 20
	range 0 200
	help
	  The RC32K is only eFuse-trimmed (several percent off). Count RTC ticks
	  for this long against the 32 MHz-derived cycle counter at driver init
	  and report the measured rate as the counter frequency (20 ms gives
	  about 0.15 % resolution). 0 keeps the nominal clock-frequency.
```

## zephyr/drivers/dac/Kconfig
```kconfig
# Copyright (c) 2026 INTELPRO
# SPDX-License-Identifier: Apache-2.0

config DAC_IPRO
	bool "IPRO7 GPDAC driver"
	default y
	depends on DT_HAS_INTELPRO_IPRO_DAC_ENABLED
	depends on DAC
	select IPRO_HAL
	help
	  Zephyr DAC over the IPRO7 GPDAC (SDK LL drv_dac.c): two 10-bit
	  register-sourced channels, A on GPIO23 and B on GPIO22.

config DAC_IPRO_STREAM
	bool "GPDAC DMA streaming (ipro_dac_stream.h)"
	depends on DAC_IPRO && DMA
	help
	  Continuous mono PCM playback through GPDAC channel A fed by DMA, the
	  SDK components/audio path, as a small vendor API (Zephyr's DAC API
	  has no streaming).

if DAC_IPRO_STREAM

config DAC_IPRO_STREAM_MAX_SEG_SAMPLES
	int "Maximum samples per DMA segment"
	default 1024

config DAC_IPRO_STREAM_THREAD_PRIO
	int "Refill thread priority"
	default 3
	help
	  The segment producer runs on its own thread so an application load
	  (Bluetooth host, codec) cannot starve it; keep it above them.

config DAC_IPRO_STREAM_THREAD_STACK
	int "Refill thread stack (bytes)"
	default 2048

config DAC_IPRO_STREAM_DMA_REQ
	int "DMA peripheral request id of the GPDAC"
	default 13
	help
	  IPRO7_DMA_REQ_DAC0 from dt-bindings/dma/ipro7-dma.h.

endif
```

## zephyr/drivers/dma/Kconfig
```kconfig
# Copyright (c) 2026 INTELPRO
# SPDX-License-Identifier: Apache-2.0

config DMA_IPRO
	bool "IPRO7 DMA driver"
	default y
	depends on DT_HAS_INTELPRO_IPRO_DMA_ENABLED
	depends on DMA
	select IPRO_HAL
	help
	  Zephyr DMA API over the SDK HAL (hal_dma.c). Single-block and
	  cyclic transfers, memory-to-memory and peripheral requests,
	  completion/error callbacks. The HAL builds its LLI chain with
	  malloc(): keep COMMON_LIBC_MALLOC_ARENA_SIZE large enough for
	  (transfer_size / 4064) * 16 bytes per active channel.
```

## zephyr/drivers/entropy/Kconfig
```kconfig
# Copyright (c) 2026 INTELPRO
# SPDX-License-Identifier: Apache-2.0

config ENTROPY_IPRO_TRNG
	bool "IPRO7 TRNG entropy driver"
	default y
	depends on DT_HAS_INTELPRO_IPRO_TRNG_ENABLED
	depends on ENTROPY_GENERATOR
	select ENTROPY_HAS_DRIVER
	select IPRO_HAL
	help
	  Zephyr entropy over the SDK security-engine TRNG (hal_sec_trng.c).
```

## zephyr/drivers/flash/Kconfig
```kconfig
# Copyright (c) 2026 INTELPRO
# SPDX-License-Identifier: Apache-2.0

config SOC_FLASH_IPRO
	bool "IPRO7 flash driver"
	default y
	depends on DT_HAS_INTELPRO_IPRO_FLASH_CONTROLLER_ENABLED
	depends on FLASH
	select FLASH_HAS_DRIVER_ENABLED
	select FLASH_HAS_PAGE_LAYOUT
	select FLASH_HAS_EXPLICIT_ERASE
	select IPRO_HAL
	help
	  Zephyr flash API over the SDK HAL (hal_flash.c): byte-granular
	  reads/writes, 4 KB sector erase, XIP-safe (the HAL runs the
	  programming sequence from OCRAM with interrupts off).
```

## zephyr/drivers/gpio/Kconfig
```kconfig
# Copyright (c) 2026 INTELPRO
# SPDX-License-Identifier: Apache-2.0

config GPIO_IPRO
	bool "IPRO7 GPIO driver"
	default y
	depends on DT_HAS_INTELPRO_IPRO_GPIO_ENABLED
	depends on GPIO
	select IPRO_HAL
	help
	  GPIO over the SDK LL (drv_gpio.c / drv_glb.c): GLB_GPIO_Init for
	  pin configuration, GLB_GPIO_Write/Read/Toggle for levels and the
	  GLB per-pin interrupt block for edge/level callbacks on the shared
	  GPIO_INT0 line.
```

## zephyr/drivers/hwinfo/Kconfig
```kconfig
# Copyright (c) 2026 INTELPRO
# SPDX-License-Identifier: Apache-2.0

config HWINFO_IPRO
	bool "IPRO7 hwinfo (eFuse chip id, reset cause)"
	default y
	depends on HWINFO
	depends on SOC_SERIES_IPRO7
	select IPRO_HAL
	help
	  Device id from the 8-byte eFuse chip id; reset cause from the SDK's
	  boot-time detection (power-on, watchdog, software, exception, PDS wake).
```

## zephyr/drivers/i2c/Kconfig
```kconfig
# Copyright (c) 2026 INTELPRO
# SPDX-License-Identifier: Apache-2.0

config I2C_IPRO
	bool "IPRO7 I2C driver"
	default y
	depends on DT_HAS_INTELPRO_IPRO_I2C_ENABLED
	depends on I2C
	select IPRO_HAL
	select PINCTRL
	help
	  Zephyr I2C controller over the SDK LL (drv_i2c.c). Polled
	  transactions with NACK detection; the hal_i2c.c wrapper is not used
	  because it hard-codes 400 kHz and cannot express restarts.

if I2C_IPRO

config I2C_IPRO_TIMEOUT_US
	int "Per-byte transfer timeout (microseconds)"
	default 5000
	help
	  Longest wait for one FIFO slot / one transfer end before the
	  transaction is aborted with -ETIMEDOUT (bus stuck, clock stretching).

endif # I2C_IPRO
```

## zephyr/drivers/i2s/Kconfig
```kconfig
# Copyright (c) 2026 INTELPRO
# SPDX-License-Identifier: Apache-2.0

config I2S_IPRO
	bool "IPRO7 I2S driver"
	default y
	depends on DT_HAS_INTELPRO_IPRO_I2S_ENABLED
	depends on I2S
	select IPRO_HAL
	select DMA
	select PINCTRL
	help
	  Zephyr I2S over the IPRO7 I2S block (SDK HAL hal_i2s.c): master or
	  slave, I2S / left / right justified / PCM A / PCM B, 8-32 bit words,
	  1-4 channels, TX and RX streamed by DMA from the application's memory
	  slab. Not yet verified on hardware.

config I2S_IPRO_QUEUE_LEN
	int "Blocks queued per direction"
	depends on I2S_IPRO
	default 4
```

## zephyr/drivers/ieee802154/Kconfig
```kconfig
# Copyright (c) 2026 INTELPRO
# SPDX-License-Identifier: Apache-2.0

config IEEE802154_IPRO
	bool "IPRO7 IEEE 802.15.4 radio driver"
	default y
	depends on DT_HAS_INTELPRO_IPRO_IEEE802154_ENABLED
	depends on IEEE802154
	select IPRO_HAL
	select IPRO_WIRELESS_IEEE802154
	select IPRO_WIRELESS_RF
	help
	  Zephyr ieee802154_radio_api over the SDK unified 802.15.4 driver
	  (ieee802154.c / lmac154) and the IPRO7 RF front-end.

if IEEE802154_IPRO

config IEEE802154_IPRO_XTAL_CAPCODE
	int "RF crystal capcode (deprecated, use SOC_IPRO7_XTAL_CAPCODE)"
	range 0 255
	default 0
	help
	  Deprecated: the crystal trim is chip-wide (it also sets the BLE
	  carrier and the kernel clock), so it moved to the SoC option
	  SOC_IPRO7_XTAL_CAPCODE. A non-zero value here still overrides that
	  option everywhere (boot, BLE and 802.15.4 RF init); 0 defers to it.
	  Calibrate with `ipro154 xtal <code>` and `ipro154 cfo` against a
	  reference radio.

config IEEE802154_IPRO_RX_STACK_SIZE
	int "RX thread stack size"
	default 1024
	help
	  Frames are copied out of the radio ISR into a small ring and handed
	  to the network stack from this thread.

config IEEE802154_IPRO_RX_QUEUE_DEPTH
	int "RX frame queue depth"
	default 4

config IEEE802154_IPRO_INIT_PRIO
	int "Driver init priority"
	default 80

config IEEE802154_IPRO_CSL_ACCURACY
	int "Clock accuracy for delayed operations (ppm)"
	range 0 255
	default 255
	help
	  Accuracy of the timebase used for timed TX/RX, reported to OpenThread
	  as the CSL clock accuracy (Parent Response to Thread 1.2+ children).
	  The IPRO7 32 MHz crystal has not been characterised on this port, so
	  the default is the worst case (255 ppm = unknown); lower it once the
	  drift has been measured.

config IEEE802154_IPRO_TX_SEC
	bool "Secure transmitted frames in the driver (CCM*) and inject the CSL IE"
	default y
	help
	  Advertise IEEE802154_HW_TX_SEC: the stack hands secured frames over
	  unencrypted with the MAC keys and frame counter, the driver runs
	  CCM* right before transmission and fills the CSL IE phase/period.
	  Required for a CSL receiver (SSED) on OpenThread; a router or
	  plain SED works either way.

endif # IEEE802154_IPRO

config IEEE802154_IPRO_CSMA_RETRIES
	int "Extra CSMA-CA rounds before reporting a busy channel"
	depends on IEEE802154_IPRO
	default 2
	range 0 8
	help
	  When the MAC's CSMA-CA (up to max backoffs) ends with CHANNEL_BUSY, the
	  driver re-runs the whole CSMA transmit this many more times, with a
	  1-4 ms random gap, before returning -EBUSY to the stack.

config IEEE802154_IPRO_FRAME_TRACE
	bool "HAL frame trace (ipro154 trace shell command)"
	depends on IEEE802154_IPRO
	help
	  Keep a ring of the frames the radio receives and transmits (after
	  security, including its own Enh-ACKs and the ACKs it receives) with
	  the HAL's microsecond SFD timestamps, dumped by `ipro154 trace dump`
	  and turned into a pcap on the host - protocol verification without
	  a sniffer. Recording starts with `ipro154 trace on`.

config IEEE802154_IPRO_FRAME_TRACE_DEPTH
	int "Frame trace ring depth (records)"
	default 96
	depends on IEEE802154_IPRO_FRAME_TRACE

config IEEE802154_IPRO_FRAME_TRACE_AT_BOOT
	bool "Frame trace records from boot"
	depends on IEEE802154_IPRO_FRAME_TRACE
	help
	  Start recording at boot, so the frames sent right after a reset are
	  in the ring when the host turns streaming back on.

config IEEE802154_IPRO_OT_CSL_PERIOD_US
	int "OpenThread CSL period applied at boot (us, 0 = none)"
	default 0
	depends on NET_L2_OPENTHREAD && OPENTHREAD_CSL_RECEIVER
	help
	  OpenThread keeps the CSL period in RAM only: after a reset an SSED
	  comes back as a plain SED while its parent still sends to it by CSL,
	  and Thread 1.4.1 4.6.4 wants it to re-establish CSL synchronization.
	  A non-zero value (a multiple of 160 us) is set once OpenThread is up,
	  like THREAD_CSL_PERIOD_US of the FreeRTOS ipro_thread_ftd_cli.

config IEEE802154_IPRO_OT_CSL_TIMEOUT_S
	int "OpenThread CSL synchronized timeout applied at boot (s, 0 = default)"
	default 0
	depends on IEEE802154_IPRO_OT_CSL_PERIOD_US != 0

config IEEE802154_IPRO_FRAME_DUMP
	bool "Hexdump every transmitted and received PSDU (bench)"
	depends on IEEE802154_IPRO
	help
	  Air-level debugging without a sniffer. Very chatty; use deferred
	  logging (LOG_MODE_IMMEDIATE faults from the TX path).
```

## zephyr/drivers/interrupt_controller/Kconfig
```kconfig
# Copyright (c) 2026 INTELPRO
# SPDX-License-Identifier: Apache-2.0

config INTC_IPRO_ECLIC
	bool "IPRO7 Nuclei ECLIC (run-time located)"
	default y
	depends on DT_HAS_INTELPRO_IPRO_ECLIC_ENABLED
	select RISCV_SOC_HAS_CUSTOM_IRQ_HANDLING
	help
	  Enhanced Core Local Interrupt Controller of the Nuclei N300 core in
	  the IPRO7. Unlike Zephyr's generic CLIC driver the register base is
	  not a device-tree constant: the SoC only publishes it through the
	  MIRGB_INFO CSR at run time (IREGION + 0x20000), exactly as the
	  vendor SDK and boot ROM discover it.

if INTC_IPRO_ECLIC

config INTC_IPRO_ECLIC_NLBITS
	int "Interrupt level bits (0 = use every clicintctl bit as level)"
	range 0 8
	default 0
	help
	  Number of clicintctl bits that encode the interrupt level (the rest
	  encode priority within a level). 0 keeps the SDK behaviour, where
	  every implemented bit is a level bit (CLICINTCTLBITS from
	  clicinfo, 3 on the IPRO7 -> 8 preemption levels).

endif # INTC_IPRO_ECLIC
```

## zephyr/drivers/pinctrl/Kconfig
```kconfig
# Copyright (c) 2026 INTELPRO
# SPDX-License-Identifier: Apache-2.0

config PINCTRL_IPRO
	bool "IPRO7 pin controller"
	default y
	depends on DT_HAS_INTELPRO_IPRO_PINCTRL_ENABLED
	depends on PINCTRL
	select IPRO_HAL
	help
	  pinctrl over the SDK's GLB_GPIO_Init() (pad function, mode, pull,
	  drive, Schmitt) plus GLB_UART_Fun_Sel() for the UART signal slots.
```

## zephyr/drivers/pwm/Kconfig
```kconfig
# Copyright (c) 2026 INTELPRO
# SPDX-License-Identifier: Apache-2.0

config PWM_IPRO
	bool "IPRO7 PWM driver"
	default y
	depends on DT_HAS_INTELPRO_IPRO_PWM_ENABLED
	depends on PWM
	select IPRO_HAL
	select PINCTRL
	help
	  Zephyr PWM over the SDK LL (drv_pwm.c): shared 16-bit period per
	  block, four channels with independent thresholds and polarity.
```
