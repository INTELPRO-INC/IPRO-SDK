## zephyr/drivers/serial/Kconfig
```kconfig
# Copyright (c) 2026 INTELPRO
# SPDX-License-Identifier: Apache-2.0

config UART_IPRO
	bool "IPRO7 UART driver"
	default y
	depends on DT_HAS_INTELPRO_IPRO_UART_ENABLED
	depends on SERIAL
	select SERIAL_HAS_DRIVER
	select SERIAL_SUPPORT_INTERRUPT
	select SERIAL_SUPPORT_ASYNC
	select DMA if UART_ASYNC_API
	select IPRO_HAL
	select PINCTRL
	help
	  Zephyr UART (polling, interrupt-driven, runtime configure) over the
	  SDK LL UART driver (bsp/drivers/ipro7_soc/std_drv/drv_uart.c).
```

## zephyr/drivers/spi/Kconfig
```kconfig
# Copyright (c) 2026 INTELPRO
# SPDX-License-Identifier: Apache-2.0

config SPI_IPRO
	bool "IPRO7 SPI driver"
	default y
	depends on DT_HAS_INTELPRO_IPRO_SPI_ENABLED
	depends on SPI
	select IPRO_HAL
	select SPI_ASYNC if SPI_RTIO
	select PINCTRL
	help
	  Zephyr SPI master over the SDK HAL (hal_spi.c / drv_spi.c). Polled
	  full-duplex transfers; software chip select through cs-gpios or the
	  controller's own SS pad.

config SPI_IPRO_DMA_MIN_BYTES
	int "Transmit-only chunks at least this long go by DMA (node with dmas)"
	depends on SPI_IPRO && DMA
	default 64
```

## zephyr/drivers/timer/Kconfig
```kconfig
# Copyright (c) 2026 INTELPRO
# SPDX-License-Identifier: Apache-2.0

config IPRO_SYSTIMER
	bool "IPRO7 Nuclei system timer (run-time located)"
	default y
	depends on DT_HAS_INTELPRO_IPRO_SYSTIMER_ENABLED
	select TICKLESS_CAPABLE
	select SYSTEM_TIMER_HAS_DISABLE_SUPPORT
	help
	  Kernel tick/timeout source on the 64-bit mtime/mtimecmp pair of the
	  Nuclei private system timer (IREGION + 0x30000). The base is
	  discovered at run time like the ECLIC; otherwise this is the
	  riscv_machine_timer algorithm. The counter runs at 4 MHz
	  (SYS_CLOCK_HW_CYCLES_PER_SEC) after soc_early_init_hook() programs
	  GLB_Set_MTimer_CLK().
```

## zephyr/drivers/watchdog/Kconfig
```kconfig
# Copyright (c) 2026 INTELPRO
# SPDX-License-Identifier: Apache-2.0

config WDT_IPRO
	bool "IPRO7 watchdog driver"
	default y
	depends on DT_HAS_INTELPRO_IPRO_WDT_ENABLED
	depends on WATCHDOG
	select IPRO_HAL
	help
	  Zephyr watchdog over the SDK HAL (hal_wdt.c): 1 ms resolution,
	  reset or interrupt (callback) on timeout.
```
