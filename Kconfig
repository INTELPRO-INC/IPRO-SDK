## components/3rdparty/cjson/Kconfig
```kconfig
config COMPONENTS_CJSON_ENABLE
    bool "Enable cJSON (lightweight JSON parser)"
    default n
    help
      Enable cJSON, a lightweight JSON parser written in ANSI C.
      MIT License, ~30KB flash.
```

## components/3rdparty/flashdb/Kconfig
```kconfig
config COMPONENTS_FLASHDB_ENABLE
    bool "Enable FlashDB (Key-Value & Time-Series Database)"
    default n
    help
      Enable FlashDB, a lightweight embedded database for
      key-value storage (KVDB) and time-series logging (TSDB).
      Requires flash read/write HAL adaptation.
      License: Apache 2.0. ~20KB flash.

if COMPONENTS_FLASHDB_ENABLE

config FLASHDB_USING_KVDB
    bool "Enable Key-Value Database (KVDB)"
    default y
    help
      Enable the key-value database feature for persistent
      configuration storage.

config FLASHDB_USING_TSDB
    bool "Enable Time-Series Database (TSDB)"
    default n
    help
      Enable the time-series database feature for logging
      sensor data with timestamps.

config FLASHDB_DEBUG
    bool "Enable FlashDB debug output"
    default n
    help
      Enable debug print messages from FlashDB.

endif # COMPONENTS_FLASHDB_ENABLE
```

## components/3rdparty/llhttp/Kconfig
```kconfig
config COMPONENTS_LLHTTP_ENABLE
    bool "Enable llhttp (HTTP parser)"
    default n
    help
      Enable llhttp, a lightweight HTTP/1.x parser from Node.js.
      MIT License, ~15KB flash.
```

## components/3rdparty/minimp3/Kconfig
```kconfig
config COMPONENTS_MINIMP3_ENABLE
    bool "Enable minimp3 MP3 decoder library"
    default n
    help
      minimp3 is a minimalistic MP3 decoder library.
      Public domain, header-only, zero external dependencies.
      https://github.com/lieff/minimp3
```

## components/3rdparty/nmsis_nn/Kconfig
```kconfig
config COMPONENTS_NMSIS_NN_ENABLE
    bool "Enable NMSIS-NN (Nuclei RISC-V NN kernels)"
    default n
    help
      Enable NMSIS-NN, the Nuclei neural network kernel library for RISC-V.
      Provides int8/int4/int16 convolution, depthwise convolution, pooling,
      fully-connected, softmax and LSTM kernels.

      DSP (P-extension) acceleration is enabled automatically when the app is
      built with an xxldsp march - no extra option is required.

      This is the int8 world used by TFLM. It is independent of the uint8
      kernels in components/ai that serve the .inm NPU path; the two can
      coexist. License: Apache 2.0.
```

## components/3rdparty/psa_arch_tests/Kconfig
```kconfig
menuconfig COMPONENTS_PSA_ARCH_TESTS_ENABLE
    bool "Arm psa-arch-tests dev_apis suites in the NSPE"
    default n
    depends on PSA_CLIENT

if COMPONENTS_PSA_ARCH_TESTS_ENABLE
choice
    prompt "Suite"
    default PSA_ARCH_TEST_SUITE_CRYPTO
config PSA_ARCH_TEST_SUITE_CRYPTO
    bool "CRYPTO (spec 1.0.0 list)"
config PSA_ARCH_TEST_SUITE_ITS
    bool "INTERNAL_TRUSTED_STORAGE"
config PSA_ARCH_TEST_SUITE_ATTEST
    bool "INITIAL_ATTESTATION (profile 1)"
endchoice
config PSA_ARCH_TEST_RANGE_START
    int "First test number to build (0 = from the start)"
    default 0
config PSA_ARCH_TEST_RANGE_END
    int "Last test number to build (0 = to the end)"
    default 0
config PSA_ARCH_TEST_VERBOSITY
    int "VERBOSITY (1 all .. 5 errors only)"
    default 3
endif
```

## components/3rdparty/tflm/Kconfig
```kconfig
config COMPONENTS_TFLM_ENABLE
    bool "Enable TFLM (TensorFlow Lite for Microcontrollers)"
    default n
    help
      Enable TensorFlow Lite for Microcontrollers, so that customer-supplied
      .tflite models can run on the CPU.

      This is independent of the .inm NPU path in components/ai: the NPU
      yields the core while it computes, so a TFLM model and a .inm model can
      run concurrently on IPRO7. TFLM cannot drive the NPU itself - the NPU
      consumes an offline-compiled instruction stream and TFLM has no delegate
      mechanism. License: Apache 2.0.

if COMPONENTS_TFLM_ENABLE

config TFLM_NMSIS_NN_KERNELS
    bool "Use NMSIS-NN optimized kernels"
    default y
    select COMPONENTS_NMSIS_NN_ENABLE
    help
      Replace 14 reference kernels (conv, depthwise_conv, fully_connected,
      pooling, softmax, svdf, lstm, ...) with the NMSIS-NN backend, which uses
      the RISC-V P-extension when the app is built with an xxldsp march.

      Costs flash - the SIMD kernels are several times larger than the
      reference ones - and buys speed. Turn off to measure the difference or
      when flash is tight.

config TFLM_SIGNAL_OPS
    bool "Include signal processing ops (FFT, filter bank)"
    default n
    help
      Audio front-end operators used by micro_speech style models. Pulls in
      kissfft. Leave off for vision-only models.

config TFLM_STRIP_ERROR_STRINGS
    bool "Strip error strings"
    default n
    help
      Compile out human-readable error messages to save flash. Debugging a
      model that fails to allocate gets considerably harder - keep this off
      during bring-up.

endif
```

## components/3rdparty/tinycbor/Kconfig
```kconfig
config COMPONENTS_TINYCBOR_ENABLE
    bool "Enable TinyCBOR (binary serialization)"
    default n
    help
      Enable TinyCBOR, a compact CBOR encoder/decoder from Intel.
      MIT License, ~10KB flash.
```
