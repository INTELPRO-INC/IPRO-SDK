/*
 * Copyright (c) 2026 IntelPro Technology Co., Ltd.
 * All rights reserved.
 *
 * This software and associated documentation files (the "Software") are
 * proprietary and confidential to IntelPro Technology Co., Ltd..
 *
 * Access to and use of this Software is limited exclusively to authorized 
 * customers and partners of IntelPro Technology Co., Ltd. who have entered into a 
 * valid license or non-disclosure agreement.
 *
 * Unauthorized copying, modification, distribution, or reverse engineering 
 * of this Software, via any medium, is strictly prohibited without 
 * prior written permission from IntelPro Technology Co., Ltd..
 *
 * SPDX-License-Identifier: Proprietary
 */

/*
 * hal_pio_sdh_crc.c - SD checksums + command framing.
 *
 * CRC7 table, 4-bit-lane CRC16 and the command word layout are ported
 * verbatim from the carlk3/ZuluSCSI rp2040_sdio driver (Apache-2.0), which
 * in turn matches the SD Physical Layer Simplified Specification.
 */
#include "hal_pio_sdh_crc.h"

/* CRC7 (x^7 + x^3 + 1) table; result byte holds CRC7 in bits [7:1]. */
static const uint8_t crc7_table[256] = {
    0x00, 0x12, 0x24, 0x36, 0x48, 0x5a, 0x6c, 0x7e, 0x90, 0x82, 0xb4, 0xa6, 0xd8, 0xca, 0xfc, 0xee,
    0x32, 0x20, 0x16, 0x04, 0x7a, 0x68, 0x5e, 0x4c, 0xa2, 0xb0, 0x86, 0x94, 0xea, 0xf8, 0xce, 0xdc,
    0x64, 0x76, 0x40, 0x52, 0x2c, 0x3e, 0x08, 0x1a, 0xf4, 0xe6, 0xd0, 0xc2, 0xbc, 0xae, 0x98, 0x8a,
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    0x1c, 0x0e, 0x38, 0x2a, 0x54, 0x46, 0x70, 0x62, 0x8c, 0x9e, 0xa8, 0xba, 0xc4, 0xd6, 0xe0, 0xf2
};

uint8_t crc7_byte(uint8_t crc, uint8_t b)
{
    return crc7_table[crc ^ b];
}

#if defined(__GNUC__) && !defined(__clang__)
__attribute__((optimize("Ofast")))
#endif
uint64_t sdio_crc16_4bit(const uint32_t *data, uint32_t num_words)
{
    uint64_t crc = 0;
    const uint32_t *end = data + num_words;
    while (data < end) {
        for (int unroll = 0; unroll < 4 && data < end; unroll++) {
            /* Each 32-bit word contains 8 bits per line; SDIO is big-endian. */
            uint32_t data_in = __builtin_bswap32(*data++);

            uint32_t data_out = (uint32_t)(crc >> 32);
            crc <<= 32;

            data_out ^= (data_out >> 16);
            data_out ^= (data_in >> 16);

            uint64_t xorred = data_out ^ data_in;
            crc ^= xorred;
            crc ^= xorred << (5 * 4);
            crc ^= xorred << (12 * 4);
        }
    }
    return crc;
}

void sdio_make_cmd_words(uint8_t cmd, uint32_t arg, uint8_t resp_bits,
                         uint32_t *w0, uint32_t *w1)
{
    uint32_t word0 =
        (47u << 24) |                 /* number of bits in command minus one */
        (1u << 22) |                  /* transfer direction host -> card */
        ((uint32_t)cmd << 16) |       /* command index (start bit + dir are in [23:22]) */
        (((arg >> 24) & 0xFF) << 8) | /* MSB byte of argument */
        (((arg >> 16) & 0xFF) << 0);

    uint32_t word1 =
        (((arg >> 8) & 0xFF) << 24) |
        (((arg >> 0) & 0xFF) << 16) |
        (1u << 8);                    /* end bit */

    if (resp_bits) {
        word1 |= ((uint32_t)(resp_bits - 1) << 0);
    }

    /* CRC7 over the 5 transmitted bytes, in transmit (big-endian) order. */
    uint8_t crc = 0;
    crc = crc7_byte(crc, (word0 >> 16) & 0xFF);
    crc = crc7_byte(crc, (word0 >> 8) & 0xFF);
    crc = crc7_byte(crc, (word0 >> 0) & 0xFF);
    crc = crc7_byte(crc, (word1 >> 24) & 0xFF);
    crc = crc7_byte(crc, (word1 >> 16) & 0xFF);
    word1 |= (uint32_t)crc << 8;

    *w0 = word0;
    *w1 = word1;
}

int sdio_check_r1_crc(uint32_t resp0, uint32_t resp1)
{
    uint8_t crc = 0;
    crc = crc7_byte(crc, (resp0 >> 24) & 0xFF);
    crc = crc7_byte(crc, (resp0 >> 16) & 0xFF);
    crc = crc7_byte(crc, (resp0 >> 8) & 0xFF);
    crc = crc7_byte(crc, (resp0 >> 0) & 0xFF);
    crc = crc7_byte(crc, (resp1 >> 8) & 0xFF);

    uint8_t actual = (resp1 >> 0) & 0xFE;
    return (crc == actual) ? 0 : -1;
}
