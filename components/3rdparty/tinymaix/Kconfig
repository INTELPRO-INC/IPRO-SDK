## components/fs/Kconfig
```kconfig
menu "File System Configuration"

# EVFS - New unified VFS layer
source "components/fs/evfs/Kconfig"

config COMPONENTS_FATFS_ENABLE
    bool "Enable FAT File System (FATFS)"
    default n
    help
      Enable support for FAT file system (FAT12/16/32).
      Commonly used with SD cards and USB mass storage devices.

if COMPONENTS_FATFS_ENABLE

choice FATFS_CODE_PAGE
    prompt "FAT FS OEM Code Page"
    default FATFS_CODE_PAGE_437
    help
      Select the OEM code page for FAT filesystem long filename support.
      This affects the character encoding used for filenames.

      Code size impact:
        - Single-byte code pages (437, 850, etc.): ~1KB
        - CJK code pages (932, 936, 949, 950): ~60KB each

config FATFS_CODE_PAGE_437
    bool "437 - U.S. (smallest)"
    help
      U.S. English code page. Smallest code size.

config FATFS_CODE_PAGE_850
    bool "850 - Latin 1 (Western European)"
    help
      Western European languages (French, German, Spanish, etc.)

config FATFS_CODE_PAGE_932
    bool "932 - Japanese (Shift_JIS) (~60KB)"
    help
      Japanese Shift_JIS encoding. Large code size due to CJK tables.

config FATFS_CODE_PAGE_936
    bool "936 - Simplified Chinese (GBK) (~60KB)"
    help
      Simplified Chinese GBK encoding. Large code size.

config FATFS_CODE_PAGE_950
    bool "950 - Traditional Chinese (Big5) (~60KB)"
    help
      Traditional Chinese Big5 encoding. Large code size.

endchoice

config FATFS_CODE_PAGE_VALUE
    int
    default 437 if FATFS_CODE_PAGE_437
    default 850 if FATFS_CODE_PAGE_850
    default 932 if FATFS_CODE_PAGE_932
    default 936 if FATFS_CODE_PAGE_936
    default 950 if FATFS_CODE_PAGE_950

endif # COMPONENTS_FATFS_ENABLE

config COMPONENTS_ROMFS_ENABLE
    bool "Enable ROM File System (ROMFS)"
    default n
    help
      Enable support for ROMFS, a simple read-only file system,
      typically used for embedding static files in firmware.

choice KV_STORAGE_BACKEND
    prompt "Key-Value Storage Backend"
    optional
    help
      Select the key-value storage backend for flash storage.
      Only one can be enabled at a time.

config EASYFLASH4
    bool "EasyFlash4 - Lightweight embedded flash storage"
    help
      EasyFlash is a lightweight embedded flash storage library.
      It supports key-value storage for environment variables.

config LITTLEFS
    bool "LittleFS - Little Fail-safe Filesystem"
    help
      LittleFS is a little fail-safe filesystem designed for microcontrollers.
      Features:
      - Power-loss resilience
      - Dynamic wear leveling
      - Bounded RAM/ROM usage

endchoice

# EasyFlash4 sub-options
if EASYFLASH4
source "components/fs/easyflash4/Kconfig.options"
endif

# LittleFS sub-options
if LITTLEFS
source "components/fs/littlefs/Kconfig.options"
endif

endmenu
```

## components/fs/easyflash4/Kconfig.options
```kconfig
# EasyFlash4 sub-options (main config is in parent Kconfig)

config EASYFLASH4_CLI
    bool "Enable EasyFlash CLI commands"
    default y
    depends on COMPONENTS_CLI_CMD_ENABLE
    help
      Enable CLI commands for EasyFlash (psm_set, psm_unset, psm_dump, psm_erase, psm_test).

config EASYFLASH4_FIXED_PARTITION
    bool "Use an application-provided fixed PSM partition"
    default n
    help
      Use a fixed flash offset and size instead of obtaining the PSM partition
      from the Boot2 hand-off table. This is intended for platforms whose
      Boot2 ABI does not export the partition table to the application.

config EASYFLASH4_FIXED_PARTITION_OFFSET
    hex "Fixed PSM partition flash offset"
    default 0x0
    depends on EASYFLASH4_FIXED_PARTITION

config EASYFLASH4_FIXED_PARTITION_SIZE
    hex "Fixed PSM partition size"
    default 0x0
    depends on EASYFLASH4_FIXED_PARTITION
```

## components/fs/evfs/Kconfig
```kconfig
# EVFS - Embedded Virtual Filesystem Configuration

menuconfig EVFS
    bool "Enable EVFS (Embedded Virtual Filesystem)"
    default n
    help
      Enable the EVFS virtual filesystem layer.
      EVFS provides a unified API for multiple filesystem backends
      including FatFs, LittleFS, and Romfs.

if EVFS

config EVFS_USE_FATFS
    bool "Enable FatFs backend"
    default y
    help
      Enable FatFs filesystem support in EVFS.

config EVFS_USE_FATFS_IMAGE
    bool "Enable FatFs image mounting"
    depends on EVFS_USE_FATFS
    default n
    help
      Enable mounting FatFs images from other filesystems.

config EVFS_USE_LITTLEFS
    bool "Enable LittleFS backend"
    default y
    help
      Enable LittleFS filesystem support in EVFS.

config EVFS_USE_LITTLEFS_IMAGE
    bool "Enable LittleFS image mounting"
    depends on EVFS_USE_LITTLEFS
    default n
    help
      Enable mounting LittleFS images from other filesystems.

config EVFS_USE_ROMFS
    bool "Enable Romfs backend"
    default n
    help
      Enable Romfs (read-only filesystem) support in EVFS.

config EVFS_USE_TAR
    bool "Enable Tar filesystem"
    default n
    help
      Enable uncompressed tar archive access as a filesystem.

config EVFS_USE_TAR_RSRC
    bool "Enable Tar resource filesystem"
    depends on EVFS_USE_TAR
    default n
    help
      Enable tar resource filesystem variant.

config EVFS_USE_SEMIHOST
    bool "Enable Semihosting filesystem backend"
    default y if SEMIHOSTING_FILEIO
    depends on SEMIHOSTING_FILEIO
    help
      Enable semihosting filesystem support in EVFS.
      This allows accessing host files through debugger semihosting
      interface. Files are mounted at /host/ mount point.

config EVFS_POSIX
    bool "Enable POSIX compatibility layer"
    default y
    help
      Enable POSIX-like file I/O API (open, read, write, close, etc.)
      using EVFS as the backend. This provides a familiar interface
      for applications that use standard POSIX file operations.

menu "EVFS Shim Layers"

config EVFS_USE_SHIM_TRACE
    bool "Enable trace shim"
    default n
    help
      Enable tracing shim for debugging filesystem operations.

config EVFS_USE_SHIM_JAIL
    bool "Enable jail shim"
    default n
    help
      Enable jail shim to restrict filesystem access to a subdirectory.

config EVFS_USE_SHIM_ROTATE
    bool "Enable rotate shim"
    default n
    help
      Enable log rotation shim for managing log files.

endmenu

endif # EVFS
```

## components/fs/littlefs/Kconfig.options
```kconfig
# LittleFS sub-options (main config is in parent Kconfig)

config LITTLEFS_CLI
    bool "Enable LittleFS CLI commands"
    default y
    depends on COMPONENTS_CLI_CMD_ENABLE
    help
      Enable CLI commands for LittleFS (lfs_mount, lfs_ls, lfs_cat, lfs_write, etc.).

config LITTLEFS_USE_PARTITION_TABLE
    bool "Use partition table for LittleFS"
    default y
    help
      Use partition table (hal_boot2) for automatic partition discovery.
      If disabled, you must specify a fixed flash address and size.

if !LITTLEFS_USE_PARTITION_TABLE

config LITTLEFS_FLASH_ADDRESS
    hex "Fixed flash address for LittleFS partition"
    default 0x200000
    help
      Specify the fixed flash address for LittleFS when not using partition table.

config LITTLEFS_FLASH_SIZE
    int "LittleFS partition size (bytes)"
    default 65536
    help
      Size of the LittleFS partition in bytes.

endif # !LITTLEFS_USE_PARTITION_TABLE
```

## components/imu/Kconfig
```kconfig
menu "IMU Sensors"

config COMPONENTS_IMU_MPU6500_ENABLE
    bool "Enable MPU-6500 / GY-6500 IMU driver"
    default n
    help
      I2C driver for InvenSense MPU-6500 (GY-6500 module).
      Provides accelerometer (±2/4/8/16g), gyroscope (±250~2000°/s),
      and temperature readings via burst read.

config MPU6500_GPIO_SDA
    int "I2C SDA GPIO pin"
    default 3
    depends on COMPONENTS_IMU_MPU6500_ENABLE

config MPU6500_GPIO_SCL
    int "I2C SCL GPIO pin"
    default 2
    depends on COMPONENTS_IMU_MPU6500_ENABLE

endmenu
```

## components/ipro_llm/Kconfig
```kconfig
menu "IPRO on-device tool-calling model"

config COMPONENTS_IPRO_LLM_ENABLE
    bool "ipro_llm engine: text request in, tool calls out"
    default n
    help
      Runs the IPRO SAN tool-calling models trained in tools/ipro_llm (XS:
      d192, 6 layers, CQ2/CQ4 weights, about 1.69 MB) from one blob made by
      tools/ipro_llm/export/export_blob.py. Portable C11 with no allocation:
      the app gives it the blob and about 1.5 MB of work memory (PSRAM, so
      it needs CONFIG_USE_PSRAM=y). Uses float; the IPRO7 FreeRTOS port
      saves the FPU registers, so other tasks may use float too.

config IPRO_LLM_NPU
    bool "Run the attention projections on the IPRO7 NPU"
    depends on COMPONENTS_IPRO_LLM_ENABLE && AI_SUPPORT
    default n
    help
      port/ipro7: q/k/v/gate and out of every layer become int8 1x1
      convolutions on the NPU, for prompt chunks and one-token decode
      steps (two models per projection). The blob needs the NPUS section
      (export_blob.py --npu-calib); the app attaches the accelerator with
      ipro_llm_npu_init() + ipro_llm_accel_attach(). About 1.2 MB of heap
      for XS (weights 0.9 MB, activation 256 KB). Needs CONFIG_AI_SUPPORT
      (the NPU runtime, components/ai).

config IPRO_LLM_PROF_CYCLES
    bool "Print the float work's cycle buckets after every request (debug)"
    depends on COMPONENTS_IPRO_LLM_ENABLE
    default n
    help
      Counts mcycle around the attention core (KV write, q/k norm + RoPE,
      softmax attention, sigmoid gate), the MLP (norms, FWHT, SiLU) and the
      engram, and prints one LLM_CYCLES line per ipro_llm_run(). Off, the
      buckets compile to nothing.

endmenu
```

## components/isp_firmware/Kconfig
```kconfig
config COMPONENTS_ISP_FIRMWARE_ENABLE
    bool "Enable ISP FIRMWARE Parser"
    default y
    help
      Enable the ISP FIRMWARE Parser
```

## components/isp_iq_cmd/Kconfig
```kconfig
config COMPONENTS_ISP_CMD_ENABLE
    bool "Enable ISP CMD Parser"
    default y
    help
      Enable the ISP CMD Parser
```

## components/isp_iq_param/Kconfig
```kconfig
config COMPONENTS_ISP_IQ_ENABLE
    bool "Enable ISP IQ Framework"
    default y
    help
      Enable the isp iq param
```

## components/libc/Kconfig
```kconfig
config COMPONENTS_NEW_LIBC_ENABLE
    bool "Enable newlib C Library (newlibc)"
    default y
    help
      Enable the newlib C standard library.

      newlib is a C library implementation intended for use on embedded systems.
      It provides standard libc features such as `printf()`, `malloc()`, `string.h`, etc.

config NEWLIBC_CONSOLE_GUARD
    bool "Serialize console lines between tasks"
    default n
    depends on COMPONENTS_NEW_LIBC_ENABLE && FREERTOS_SUPPORT
    help
      printf/puts from tasks wait for each other instead of the later one
      being dropped (interrupt context still drops while busy), and the
      OpenThread CLI output is emitted as whole lines. Needed when a second
      task prints continuously, e.g. the radio_trace stream. The app calls
      newlibc_console_init() before the scheduler starts. Always on for
      the Thread Wi-Fi border router.

# Include semihosting config if folder exists (osource ignores missing files)
osource "components/libc/semihosting/Kconfig"
```

## components/libc/semihosting/Kconfig
```kconfig
menuconfig SEMIHOSTING
    bool "Semihosting support (debug only)"
    default n
    depends on COMPONENTS_NEW_LIBC_ENABLE
    help
      Enable semihosting for debugger communication.

      Semihosting allows the target to communicate with the host debugger
      (OpenOCD/GDB) for console I/O and file operations.

      This is useful during FPGA bringup or debugging.
      Remove components/libc/semihosting/ folder for production release.

if SEMIHOSTING

config SEMIHOSTING_PRINTF
    bool "Redirect printf to semihosting"
    default y
    help
      Printf output goes to GDB via semihosting instead of UART.

      Requires a debugger connection (OpenOCD/GDB) to see output.

config SEMIHOSTING_FILEIO
    bool "Enable semihosting file I/O"
    default n
    help
      Enable file operations (open/read/write/close) via semihosting.

      Allows FPGA to read/write files on the host PC through debugger.
      Provides semihost_open(), semihost_read(), semihost_write(), etc.

endif # SEMIHOSTING
```
