## components/3rdparty/tinymaix/Kconfig
```kconfig
config COMPONENTS_TINYMAIX_ENABLE
    bool "Enable TinyMaix (Lightweight NN Inference)"
    default n
    help
      Enable TinyMaix, a tiny neural network inference library
      designed for microcontrollers. Supports INT8/FP32 models.
      Only ~3-10KB flash for the core library.
      License: Apache 2.0.
```

## components/at_client/Kconfig
```kconfig
config AT_CLIENT
    bool "Generic AT Command Client"
    select IPRO_OSAL
    default n
    help
      Reusable AT command client engine for AT-based devices
      (LTE modem, WiFi module, etc). Transport-agnostic with
      pluggable UART/SPI transport. OS-agnostic via ipro_osal.
      Multi-instance.
```

## components/audio/Kconfig
```kconfig
menu "Audio"

config AUDIO_CAPTURE
    bool "Audio capture producer (AMIC/DMIC/I2S) with multicast"
    default n
    help
      Enable audio_capture framework: DMA-driven mic capture (analog mic,
      PDM digital mic, or I2S) with multi-consumer StreamBuffer multicast.
      Consumers: audio recorders, STT, UAC loopback, voice assistant, etc.

config AUDIO_OUTPUT
    bool "Audio output sink abstraction (DAC/UAC/I2S/DUMP)"
    default n
    help
      Enable audio_output framework: pluggable PCM sink with DAC backend
      (one-shot + N-ring streaming), UAC backend, I2S backend, and raw
      dump backend (file or custom hook). Includes linear resampler.

config AUDIO_OUTPUT_UAC_EXCLUDE
    bool "Do not build the UAC output backend"
    depends on AUDIO_OUTPUT
    default n
    help
      Leave audio_output_uac.c out of the build even when
      CHERRYUSB_DEVICE_AUDIO is on.

      Required by any app that implements its own USB Audio Class device —
      a microphone, for instance. usbd_audio_open(), usbd_audio_close() and
      usbd_audio_in_callback() are fixed-name callbacks of the CherryUSB
      audio class, so the backend and an app-side implementation collide at
      link time ("multiple definition").

      Opt-out rather than opt-in so apps that do not set it keep building
      the backend exactly as before.

endmenu
```

## components/board/ipro7ai_evk/Kconfig
```kconfig
menu "IPRO7AI EVK board library"

config COMPONENTS_IPRO7AI_EVK_ENABLE
    bool "IPRO7AI EVK board library (ST7789P3 LCD, camera, mic, speaker)"
    default n
    help
      Board layer for the IPRO7AI EVK sub-board (CONFIG_IPRO7AI_EVK): the
      ST7789P3 2.4" panel driver with row-compositing text/overlay helpers,
      and - opt-in below - the SC101IOT camera pipeline (ISP channel 0 to
      the panel, channel 1 to the NPU), the IM69D129 PDM microphone and the
      DAC + TPA2037D1 speaker. One evk_begin() brings the board up.

      Raw per-app .config files do not resolve Kconfig `depends on`, so an
      app sets the sub-options below explicitly together with what they
      need (MM_SUPPORT + COMPONENTS_SENSOR_ENABLE for the camera,
      AUDIO_OUTPUT + DMA_CHANNEL_ALLOCATOR for the audio).

config EVK_CAMERA
    bool "Camera: SC101IOT -> ISP -> LCD preview + NPU feed"
    depends on COMPONENTS_IPRO7AI_EVK_ENABLE
    depends on MM_SUPPORT && COMPONENTS_SENSOR_ENABLE
    default n
    help
      evk_cam_*: DVP bring-up, sensor probe, ISP channel 0 (YUYV preview
      into PSRAM ping-pong) and channel 1 (a sensor ROI scaled to the NPU
      input, one frame in flight). Needs PSRAM for the frames.

config EVK_AUDIO
    bool "Audio: PDM microphone (evk_mic) and DAC speaker (evk_spk)"
    depends on COMPONENTS_IPRO7AI_EVK_ENABLE
    depends on AUDIO_OUTPUT
    default n
    help
      evk_mic_*: AUADC PDM capture on GPIO18/19 (AON pads handed back to
      the GLB mux first). evk_spk_*: components/audio DAC sink opened with
      this board's active-high amplifier enable, Q12 volume, tone generator.
      Both integer-only. Set CONFIG_DMA_CHANNEL_ALLOCATOR=y as well, or the
      AUADC and DAC DMAs both take channel 0.

config EVK_SDCARD
    bool "micro-SD on the SDH controller, FatFS at sd:/"
    depends on COMPONENTS_IPRO7AI_EVK_ENABLE
    depends on COMPONENTS_FATFS_ENABLE && EVFS_USE_FATFS
    default n
    help
      evk_sd_*: card detect, 4-bit mount at "sd:", free space, exists().
      Needs CONFIG_EVFS=y + CONFIG_EVFS_USE_FATFS=y +
      CONFIG_COMPONENTS_FATFS_ENABLE=y (+ the code page keys). With
      CONFIG_AI_MODEL_FROM_FILE=y the NPU runtime can then load models
      from the card instead of the flash mfg partition.

config EVK_SHELL
    bool "Shell commands: lcd, cam, mic, spk, sd"
    depends on COMPONENTS_IPRO7AI_EVK_ENABLE && SHELL
    default n
    help
      Board-level bench commands. Leave off in an app that registers its
      own `lcd` or `cam` command - the export macro creates one global
      symbol per command name and two of them do not link.

endmenu
```

## components/boot/Kconfig
```kconfig
menu "Boot Loader Components"

osource "components/boot/app_header/Kconfig"
osource "components/boot/uboot_trigger/Kconfig"

endmenu
```

## components/boot/app_header/Kconfig
```kconfig
config BOOT_APP_HEADER_ENABLE
    bool "IPRO u-boot application image envelope (app_header)"
    default n
    help
      Build the 256-byte envelope header parser used by boot2 to validate
      u-boot-produced application images (.img). When disabled, boot2 runs
      the legacy IPNP-only path.

config BOOT_APP_HEADER_STANDALONE_CRC
    bool "Use built-in CRC32 in app_header (no softcrc dependency)"
    depends on BOOT_APP_HEADER_ENABLE
    default n
    help
      Compile the bit-by-bit CRC-32/IEEE implementation inside app_header
      itself instead of calling softcrc. Useful for boot2 which wants a
      minimal footprint and no extra component dependency. Slightly slower
      than softcrc's table-based version.
```

## components/boot/uboot_trigger/Kconfig
```kconfig
config BOOT_UBOOT_TRIGGER_ENABLE
    bool "Enable 1200-baud-touch trigger for re-entering u-boot rescue"
    depends on COMPONENTS_CHERRYUSB_ENABLE
    default n
    help
      Arm a small helper that reboots into the boot2 USB rescue mode
      whenever the host drops DTR after setting the CDC baud to 1200 —
      the same pattern the Arduino IDE uses to "touch" a sketch into
      bootloader mode. Useful on boards where the only debug surface
      is USB (no exposed UART for `reboot_usb`).

config BOOT_UBOOT_TRIGGER_AUTO_CDC_HOOKS
    bool "Auto-install CDC set_line_coding / set_dtr overrides"
    depends on BOOT_UBOOT_TRIGGER_ENABLE
    default y
    help
      Provide default usbd_cdc_acm_set_line_coding / usbd_cdc_acm_set_dtr
      implementations that feed uboot_trigger. Disable this if your app
      already overrides those callbacks and call uboot_trigger_note_baud
      / uboot_trigger_note_dtr from your own handlers instead.
```

## components/cherryusb/Kconfig
```kconfig
config COMPONENTS_CHERRYUSB_ENABLE
    bool "Enable CherryUSB Stack"
    default n
    help
      Enable CherryUSB - a lightweight and portable USB stack
      supporting USB Device and Host functionalities.

if COMPONENTS_CHERRYUSB_ENABLE

menu "CherryUSB Configuration"

#
# General Configuration
#
config CHERRYUSB_DEVICE
    bool "Enable USB Device Support"
    help
      Enable USB device functionality using CherryUSB.

config USB_HS
    bool "Enable USB High-Speed Mode"
    help
      Enable USB high-speed (USB 2.0 HS) support if hardware allows.

#
# USB Device Classes
#
config CHERRYUSB_DEVICE_CDC
    bool "Enable USB CDC (Communication Device Class)"
    help
      Enable support for the USB CDC class (Virtual COM Port).

config CHERRYUSB_DEVICE_HID
    bool "Enable USB HID (Human Interface Device)"
    help
      Enable support for HID class devices (keyboard, mouse, etc).

config CHERRYUSB_DEVICE_MSC
    bool "Enable USB MSC (Mass Storage Class)"
    help
      Enable support for mass storage devices (e.g., USB flash drives).

config CHERRYUSB_DEVICE_AUDIO
    bool "Enable USB Audio Class"
    help
      Enable support for USB audio input/output devices.

config CHERRYUSB_DEVICE_VIDEO
    bool "Enable USB Video Class"
    help
      Enable support for USB video devices (e.g., webcams).

config CHERRYUSB_DEVICE_CDC_ECM
    bool "Enable USB CDC ECM (Ethernet Control Model)"
    help
      Enable support for CDC ECM class (USB Ethernet adapter).

config CHERRYUSB_DEVICE_CDC_NCM
    bool "Enable USB CDC NCM (Network Control Model)"
    help
      Enable support for CDC NCM class (USB Ethernet, Windows 11 native).

config CHERRYUSB_DEVICE_RNDIS
    bool "Enable USB RNDIS (Remote NDIS)"
    help
      Enable support for RNDIS class (USB Ethernet, Windows compatible).

config CHERRYUSB_DEVICE_VENDOR_TP
    bool "Enable USB vendor throughput test class"
    help
      Enable the bulk/isoc throughput test device class (the "usb_tp" shell
      command) used to benchmark the ipro6 USB device against a Windows
      WinUSB host. Requires USB_HS for meaningful (High-Speed) numbers.

#
# USB Host Support
#
config CHERRYUSB_HOST
    bool "Enable USB Host Support"
    help
      Enable USB Host functionality for connecting external USB devices.

endmenu

endif  # COMPONENTS_CHERRYUSB_ENABLE
```

## components/cmsis_dap/Kconfig
```kconfig
config COMPONENTS_CMSIS_DAP_ENABLE
    bool "Enable CMSIS-DAP debug-probe core (ARM reference)"
    default n
    help
      Vendored ARM CMSIS-DAP command processor (DAP.c). The board layer
      (DAP_config.h + JTAG/SWD transport) is provided by the application.
```

## components/crypto/Kconfig
```kconfig
#
# mbedTLS Integration
#
config COMPONENTS_MBEDTLS_ENABLE
    bool "Enable mbedTLS Library"
    default n
    help
      Enable the mbedTLS cryptographic and SSL/TLS library.
      This provides support for secure communication protocols and crypto functions.

config COMPONENTS_CIPHER_SUITE_ENABLE
    bool "Enable Custom Cipher Suite"
    default n
    help
      Enable custom configuration of supported cipher suites.
      Requires mbedTLS to be enabled.

config MBEDTLS_PSA_CRYPTO
    bool "Compile the mbedtls PSA Crypto core (psa_crypto*.c)"
    default n
    depends on COMPONENTS_MBEDTLS_ENABLE

config MBEDTLS_V3
    bool "mbedtls 3.6 instead of 2.28 (PSA apps only)"
    default n
    depends on PSA_SPE || PSA_CLIENT
    help
      The SPE builds components/crypto/mbedtls3 in place of
      components/crypto/mbedtls; the NSPE PSA client takes the 3.6
      headers. SPE and NSPE images must agree.

config TF_PSA_CRYPTO
    bool "TF-PSA-Crypto 1.2 instead of mbedtls (PSA apps only)"
    default n
    depends on (PSA_SPE || PSA_CLIENT) && !MBEDTLS_V3
    help
      The SPE builds components/crypto/tfpsa in place of
      components/crypto/mbedtls; the NSPE PSA client takes the
      TF-PSA-Crypto headers. SPE and NSPE images must agree.

source "components/crypto/nist_sp800_22/Kconfig"

#
# mbedTLS Advanced Configuration
#
if COMPONENTS_MBEDTLS_ENABLE

menu "mbedTLS Configuration"

# You can add additional options here, such as:
# config MBEDTLS_TLS_VERSION
# config MBEDTLS_ENABLE_DEBUG
# config MBEDTLS_MAX_CONTENT_LEN
# config MBEDTLS_CUSTOM_CONFIG_FILE

endmenu

endif  # COMPONENTS_MBEDTLS_ENABLE
```

## components/crypto/nist_sp800_22/Kconfig
```kconfig
# NIST SP 800-22 Statistical Test Suite Configuration

config COMPONENTS_NIST_SP800_22_ENABLE
    bool "Enable NIST SP 800-22 Statistical Test Suite"
    default n
    help
      Enable the NIST SP 800-22 Rev 1a statistical test suite for
      random number generator validation.

      This library implements all 15 tests:
      - 2.1  Frequency (Monobit) Test
      - 2.2  Frequency Test within a Block
      - 2.3  Runs Test
      - 2.4  Test for the Longest Run of Ones in a Block
      - 2.5  Binary Matrix Rank Test
      - 2.6  Discrete Fourier Transform (Spectral) Test
      - 2.7  Non-overlapping Template Matching Test
      - 2.8  Overlapping Template Matching Test
      - 2.9  Maurer's "Universal Statistical" Test
      - 2.10 Linear Complexity Test
      - 2.11 Serial Test
      - 2.12 Approximate Entropy Test
      - 2.13 Cumulative Sums Test
      - 2.14 Random Excursions Test
      - 2.15 Random Excursions Variant Test

      For full test suite execution, 1 million bits (~125KB) of random
      data is recommended. Some tests require this minimum for validity.

config NIST_KAT
    bool "Known-answer test against sts-2.1.2 reference (trng_kat)"
    default n
    depends on COMPONENTS_NIST_SP800_22_ENABLE
    help
      Embed a fixed 2^20-bit input (binary expansion of e, 128KB rodata)
      plus golden P-values generated by the official NIST sts-2.1.2
      reference implementation, and add the trng_kat shell command that
      runs the full suite on that input and compares every P-value.

      This validates the test implementation itself: a test whose
      decision statistic has silently degraded still passes statistical
      self-checks with good PRNG data, but cannot reproduce the
      reference P-values on fixed input.

      Regenerate the golden data with tools/gen_kat_golden.py.

config NIST_FULL_TEST
    bool "Enable full NIST SP 800-22 test suite"
    default n
    depends on COMPONENTS_NIST_SP800_22_ENABLE
    help
      Enable the complete NIST SP 800-22 test suite for official
      certification purposes.

      When enabled:
      - Non-overlapping Template: Tests all 148 official aperiodic
        templates (m=9) instead of 10 representative templates

      When disabled (default):
      - Non-overlapping Template uses 10 representative templates for
        faster execution; suitable for hardware tuning and development

      All other tests are identical in both modes (the Overlapping
      Template test always uses the exact NIST m=9 parameters).

      Enable this for final TRNG validation before submitting for
      NIST certification. The full test takes significantly longer.

config NIST_PRNG_VERIFY
    bool "Enable software PRNG verification commands"
    default n
    depends on COMPONENTS_NIST_SP800_22_ENABLE
    help
      Enable shell commands for verifying NIST test implementation
      using software PRNG (XORShift64*).

      Commands enabled:
      - trng_verify: Run NIST tests with software PRNG
      - trng_pattern: Debug pattern matching

      Use these commands to verify the test implementation is correct.
      If software PRNG passes but hardware TRNG fails, the issue is
      hardware quality, not implementation bugs.
```
