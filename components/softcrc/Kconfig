## components/wireless/bluetooth/ipro_ble_controller/Kconfig.ipro6s
```kconfig
# IPRO6S controller compatibility Kconfig
# ======================================

menuconfig BTDM_ENABLE
    bool "Enable IPRO6S RW v13.0.18 controller"
    depends on IPRO6
    default n
    help
      Enable the IPRO6S RivieraWaves v13.0.18 controller backend from
      components/wireless/bluetooth/ipro_ble_controller.

      BLE is always available. BR/EDR can be enabled independently with
      BTDM_BT_ENABLE; both modes use the same source-built controller and
      IPRO6S platform layer.

config IPRO_BLE_CTLR_PLATFORM_IPRO6S
    bool
    depends on BTDM_ENABLE
    default y if BTDM_ENABLE
    help
      Internal platform selector for the unified controller component.

if BTDM_ENABLE

config BTDM_BLE_ENABLE
    bool "Enable BLE Support"
    default y
    help
      Enable Bluetooth Low Energy (BLE) support.

config BTDM_BT_ENABLE
    bool "Enable BT Classic Support"
    default n
    help
      Build the official RW v13.0.18 BR/EDR link layer alongside BLE. The
      controller is compiled for IPRO6S instead of importing an E907 archive.

config BTDM_MAX_BR_ACL_CONNECTIONS
    int "Maximum BR/EDR ACL connections"
    range 1 3
    default 1
    depends on BTDM_BT_ENABLE
    help
      Maximum number of simultaneous BR/EDR ACL links.

menu "BLE Configuration"
    depends on BTDM_BLE_ENABLE

config BTDM_PER_ADV
    bool "IPRO6S periodic advertising and synchronization"
    default n
    help
      Compile the BLE 5.x periodic advertiser and periodic synchronizer.
      Host advertiser/observer roles must be enabled separately.

config BTDM_PAST
    bool "IPRO6S periodic advertising sync transfer"
    default n
    select BTDM_PER_ADV
    help
      Compile Periodic Advertising Sync Transfer (PAST) without enabling
      PAwR. Host sender/receiver roles must be enabled separately.

config BTDM_PAWR
    bool "IPRO6S periodic advertising with responses (experimental)"
    default n
    select BTDM_PER_ADV
    select BTDM_PAST
    help
      Compile PAwR advertiser/scanner with required periodic advertising and
      PAST support. Host roles must be enabled separately. This experimental
      configuration requires runtime qualification before customer release.

config BTDM_MAX_ACL_CONNECTIONS
    int "Maximum ACL Connections"
    range 1 8
    default 4
    help
      Maximum number of simultaneous BLE ACL connections.

config BTDM_MAX_ADV_SETS
    int "Maximum Advertising Sets"
    range 1 8
    default 2
    help
      Maximum number of advertising sets for extended advertising.

config BTDM_MAX_SCAN_SETS
    int "Maximum Scan Sets"
    range 1 4
    default 1
    help
      Maximum number of scanning sets.

config IPRO_BLE_CTLR_CH_CLASS_TEST
    bool "Enable deterministic BLE 5.3 channel-classification test input"
    default n
    help
      Test-only hook that replaces local RF channel assessment with one forced
      bad data channel. Keep disabled in customer controller builds.

endmenu

menu "RF Configuration"

config BTDM_TX_PWR_DBM
    int "Default TX Power (dBm)"
    range -20 10
    default 0
    help
      Default transmit power in dBm.

config BTDM_TX_PWR_MIN
    int "Minimum TX Power (dBm)"
    range -20 0
    default -20
    help
      Minimum supported TX power.

config BTDM_TX_PWR_MAX
    int "Maximum TX Power (dBm)"
    range 0 10
    default 10
    help
      Maximum supported TX power.

endmenu

menu "Power Management"

config BTDM_SLEEP_ENABLE
    bool "Enable Deep Sleep"
    default n
    help
      Enable BTDM deep sleep mode for power saving.

config BTDM_WAKEUP_DELAY_SLOTS
    int "Wakeup Delay (slots)"
    range 1 10
    default 2
    depends on BTDM_SLEEP_ENABLE
    help
      Number of slots required for RF wakeup.

endmenu

menu "HCI Configuration"

config BTDM_HCI_UART
    bool "Enable HCI over UART"
    default n
    help
      Enable HCI transport over UART for external host communication.

if BTDM_HCI_UART

config BTDM_HCI_UART_INDEX
    int "HCI UART Index"
    range 0 2
    default 0
    help
      UART peripheral index for HCI transport.

config BTDM_HCI_UART_BAUDRATE
    int "HCI UART Baudrate"
    default 115200
    help
      UART baudrate for HCI transport.

config BTDM_HCI_FLOW_CONTROL
    bool "Enable HCI Flow Control"
    default n
    help
      Enable hardware flow control for HCI UART.

endif # BTDM_HCI_UART

endmenu

menu "Debug Configuration"

config BTDM_DEBUG
    bool "Enable Debug Output"
    default y
    help
      Enable debug output for BTDM stack.

config BTDM_DEBUG_VERBOSE
    bool "Enable Verbose Debug"
    default n
    depends on BTDM_DEBUG
    help
      Enable verbose debug output.

config BTDM_DEBUG_HCI
    bool "Enable HCI Debug"
    default n
    depends on BTDM_DEBUG
    help
      Enable HCI packet tracing.

config BTDM_DEBUG_LL
    bool "Enable Link Layer Debug"
    default n
    depends on BTDM_DEBUG
    help
      Enable Link Layer debug output.

endmenu

menu "Platform Configuration"

config BTDM_FPGA
    bool "FPGA Platform"
    default y
    help
      Build for FPGA platform.

config BTDM_RF_T2
    bool "T2 RF Daughter Board"
    default y
    depends on BTDM_FPGA
    help
      Use T2 RF daughter board for FPGA testing.

endmenu

endif # BTDM_ENABLE
```

## components/wireless/coex_bz/Kconfig
```kconfig
config COEX_BZ
    bool "BLE / 802.15.4 radio arbiter (IPRO7 PTA)"
    default n
    depends on IPRO7 && IEEE802154_ENABLE
    help
        Arbitrate the BLE controller and the 802.15.4 MAC on the one
        radio: the PTA arbiter enable and the MAC's request priorities,
        written once after the 802.15.4 driver is up and put back after a
        platform PDS.  Defaults are the Matter bench's (a connected BLE
        link through Thread attach and SRP): the MAC wins its ACK windows
        against BLE connection events (~7), BLE advertising loses to
        802.15.4 listening.

if COEX_BZ
config COEX_BZ_TX_PRI
    int "802.15.4 TX priority (0..15)"
    range 0 15
    default 12
config COEX_BZ_RX_UNICAST_PRI
    int "802.15.4 unicast RX priority (0..15)"
    range 0 15
    default 11
config COEX_BZ_RX_SFD_PRI
    int "802.15.4 priority after SFD (0..15)"
    range 0 15
    default 8
config COEX_BZ_RX_IDLE_PRI
    int "802.15.4 idle-listening priority (0..15)"
    range 0 15
    default 8
config COEX_BZ_RX_ON_AFTER_ABORT
    bool "802.15.4 receiver back on after the arbiter took the radio"
    default y
    help
      The MAC turns its receiver on again by itself once BLE hands the
      radio back.  Right for a receiver that is always on (router, MED).
      A sleepy device (SED / SSED) opens short receive windows; one BLE
      cut short is then reopened behind the driver's back and stays open
      (power, no PDS, and idle listening outranking BLE).  Say n there.
endif
```

## components/wireless/wifi6/sigma_dut/Kconfig
```kconfig
config SIGMA_DUT
    bool "Enable WFA Sigma-DUT CAPI Agent"
    depends on WIFI6 && COMPONENTS_LWIP_ENABLE
    default n
    help
      Enable the WFA sigma-dut CAPI agent (TCP port 9000) for
      Wi-Fi Alliance certification testing.

      The agent listens for CAPI commands from the WFA UCC test bed
      and translates them into WiFi stack API calls.
```

## components/wireless/wifi_aic8800/Kconfig
```kconfig
# AIC8800 D80-H (AICSemi) external Wi-Fi 5 + BT combo over SDIO

config WIFI_AIC8800
    bool "Enable AIC8800 D80 Wi-Fi/BT combo over SDIO"
    default n
    help
      External AICSemi AIC8800 D80 Wi-Fi 5 (2.4/5 GHz) + BT combo module
      driven by IPRO7 as SDIO host (bsp/hal/hal_sdio.c). Links the vendor
      release archive under components/wireless/wifi_aic8800/aic8800_release,
      which contains the FullMAC host driver, wpa_supplicant/hostapd,
      mbedTLS wrappers, the IPRO7 platform layer (SDIO shim, FreeRTOS and
      lwIP glue) and the SDIO HCI mailbox transport. The Wi-Fi + BT firmware
      (~430 KB) is embedded in the archive as rodata, so the app needs the
      2 MB internal flash (CONFIG_IPRO7_FLASH_2M).

      Requires CONFIG_COMPONENTS_LWIP_ENABLE, CONFIG_ETHERNET (lwipopts ABI,
      not the EMAC), CONFIG_DHCPD (SoftAP) and CONFIG_USE_PSRAM. Only the
      D80 SDIO variant is provided. Bluetooth is transport only: the host
      stack is the customer's (see aic_hci_transport.h); no SCO/eSCO/ISO and
      no A2DP/HFP codec.

config AIC8800_HCI_SMOKE
    bool "Build the vendor HCI transport smoke test (hci_info)"
    default n
    help
      Compiles the application-side release test from
      aic8800_release/example/ipro7_aic8800_wifi/hci_release_test.c into the
      app and registers the `hci_info` shell command: it attaches the HCI
      transport in AIC_HCI_FLOW_HOST, sends BT Reset plus the version /
      features / buffer-size / BD_ADDR queries and detaches again.

      Bring-up and acceptance only. It must not run beside an attached host
      stack, and production images should leave it off.
```

## components/wireless/wifi_atbm6162/Kconfig
```kconfig
# ATBM6162 (Altobeam OCEANUS) external Wi-Fi 6 over SDIO

config WIFI_ATBM6162
    bool "Enable ATBM6162 (Altobeam OCEANUS) Wi-Fi 6 over SDIO"
    default n
    help
      External Altobeam ATBM6162 (OCEANUS family) Wi-Fi 6 + BLE combo module,
      driven by IPRO7 as SDIO host (bsp/hal/hal_sdio.c). Phase 0 brings up the
      SDIO transport, firmware download and chip handshake (WiFi-only subset).

      The WiFi firmware (~164 KB) is stored as rodata in the 2 MB internal flash.
      BLE coexist and the wpa_supplicant data path are added in later phases.

if WIFI_ATBM6162

config WIFI_ATBM6162_SDIO
    bool
    default y
    help
      Transport selection. Only SDIO is supported on IPRO7 (USB variant
      deliberately omitted from the port).

config WIFI_ATBM6162_BLE_COEXIST
    bool "Enable ATBM Wi-Fi + BLE coexist (Phase 4)"
    default n
    help
      Pull in the ATBM combo firmware and the nimble BLE host for Wi-Fi/BLE
      coexistence. Not implemented in Phase 0 — leave disabled.

endif # WIFI_ATBM6162
```

## zephyr/Kconfig
```kconfig
# Copyright (c) 2026 INTELPRO
# SPDX-License-Identifier: Apache-2.0

menu "IPRO SDK integration"

rsource "Kconfig.hal"
rsource "drivers/Kconfig"
rsource "subsys/shell/Kconfig"

endmenu
```
