## components/sys/usb_console/Kconfig
```kconfig
config DEBUG_CONSOLE_USB
    bool "Debug console over USB CDC-ACM (printf TX mirror + shell RX)"
    depends on COMPONENTS_CHERRYUSB_ENABLE && CHERRYUSB_DEVICE && CHERRYUSB_DEVICE_CDC && FREERTOS
    default n
    help
      Mirror firmware printf/log output to a USB CDC-ACM IN endpoint and source
      FinSH shell input from its OUT endpoint, in addition to the debug UART.
      When disabled, only the UART console is used and behavior is unchanged.
      USB needs the WIFIPLL up (BROM leaves it up at boot) + heap/FreeRTOS, so
      usb_console_init() is called from the app after the scheduler starts.

config DEBUG_CONSOLE_USB_OWN_DISPATCHER
    bool "usb_console provides the usbd_event_handler dispatcher"
    depends on DEBUG_CONSOLE_USB
    default n
    help
      Compile usb_console's own strong usbd_event_handler shim. Leave =n (the
      default) when the app already links a dispatcher (usb_demo's
      usbd_event_common.c or the OTA shim): usb_console registers through it, and
      =y would collide on a duplicate usbd_event_handler /
      usbd_event_register_callback. Set =y ONLY for an app that links no other
      usbd_event_handler.

config DEBUG_CONSOLE_USB_ATTACH
    bool "Attach console into the app's own composite USB device"
    depends on DEBUG_CONSOLE_USB
    default n
    help
      The console does not own the USB device: the app registers a composite
      descriptor carrying a second CDC-ACM (interfaces 2/3, EP 0x84/0x05/0x86),
      calls usb_console_attach() before its own usbd_initialize(), and chains
      events to usb_console_notify_event(). One cable then carries both the
      app's data channel and the shell console.
```

## components/utils/Kconfig
```kconfig
config COMPONENTS_UTILITY_API_ENABLE
    bool "Enable Utility API Support"
    default y
    help
      Enable utility function APIs such as memory operations, string helpers,
      logging wrappers, or platform abstraction utilities.
      This provides commonly-used helper functions for application and component development.

menu "IPRO Logging System"
    depends on COMPONENTS_UTILITY_API_ENABLE

    config IPRO_LOG_ENABLE
        bool "Enable IPRO Logging System"
        default y
        help
          Enable the IPRO logging system for debug and runtime information.

    choice LOG_DEFAULT_LEVEL
        prompt "Default Log Level"
        default LOG_DEFAULT_LEVEL_INFO
        depends on IPRO_LOG_ENABLE
        help
          Select the default log level for the system.

        config LOG_DEFAULT_LEVEL_NONE
            bool "No output"
        config LOG_DEFAULT_LEVEL_ERROR
            bool "Error"
        config LOG_DEFAULT_LEVEL_WARN
            bool "Warning"
        config LOG_DEFAULT_LEVEL_INFO
            bool "Info"
        config LOG_DEFAULT_LEVEL_DEBUG
            bool "Debug"
        config LOG_DEFAULT_LEVEL_VERBOSE
            bool "Verbose"
    endchoice

    config LOG_DEFAULT_LEVEL
        int
        depends on IPRO_LOG_ENABLE
        default 0 if LOG_DEFAULT_LEVEL_NONE
        default 1 if LOG_DEFAULT_LEVEL_ERROR
        default 2 if LOG_DEFAULT_LEVEL_WARN
        default 3 if LOG_DEFAULT_LEVEL_INFO
        default 4 if LOG_DEFAULT_LEVEL_DEBUG
        default 5 if LOG_DEFAULT_LEVEL_VERBOSE

    config LOG_COLORS
        bool "Enable colored output"
        default y
        depends on IPRO_LOG_ENABLE
        help
          Enable colored log output for better readability.

    config LOG_TIMESTAMP
        bool "Enable timestamp"
        default y
        depends on IPRO_LOG_ENABLE
        help
          Enable timestamp in log output.

    config LOG_THREAD_ID
        bool "Enable thread ID"
        default y
        depends on IPRO_LOG_ENABLE && FREERTOS
        help
          Enable thread ID in log output for multi-threaded debugging.

    config LOG_BUFFER_SIZE
        int "Log buffer size"
        default 512
        range 128 2048
        depends on IPRO_LOG_ENABLE
        help
          Size of the log buffer in bytes.

    config LOG_USE_MUTEX
        bool "Use mutex for thread safety"
        default y
        depends on IPRO_LOG_ENABLE && FREERTOS
        help
          Use mutex to ensure thread-safe logging.

    choice LOG_OUTPUT_TYPE
        prompt "Log Output Type"
        default LOG_OUTPUT_UART
        depends on IPRO_LOG_ENABLE
        help
          Select the output destination for log messages.

        config LOG_OUTPUT_UART
            bool "UART Output"
        config LOG_OUTPUT_RTT
            bool "RTT Output"
        config LOG_OUTPUT_FILE
            bool "File Output"
    endchoice

endmenu
```

## components/wireless/Kconfig
```kconfig
# Wireless Subsystem Configuration
#
# Configuration for wireless connectivity features including Bluetooth LE,
# Wi-Fi, Zigbee, and other wireless protocols.

menu "Wireless Configuration"

config BLUETOOTH_LE_ENABLE
    bool "Enable Bluetooth Low Energy (BLE)"
    help
      Enable support for Bluetooth Low Energy features and profiles.

      This includes the BLE 5.4 stack with support for:
      - GAP (Generic Access Profile)
      - GATT (Generic Attribute Profile)
      - GAF (Generic Audio Framework)
      - BAP (Basic Audio Profile)
      - LE Audio features

# BLE Stack Configuration
if BLUETOOTH_LE_ENABLE
    osource "components/wireless/bluetooth/Kconfig"
endif

config WIFI6
    bool "Enable Wi-Fi 6 (802.11ax)"
    help
      Enable Wi-Fi 6 (802.11ax) wireless connectivity support.

config PHY_CLI
    bool "Enable PHY/RF test CLI (phyrf bring-up)"
    help
      Build the IPRO6 PHY/RF driver with its shell/CLI test commands
      (phy_init, txsin_start, tx11*_start, at_rx_start, rr/wr, ...) without
      pulling in the full Wi-Fi 6 networking stack. For PHY/RF bring-up and
      manufacturing test on the ASIC via the WiFi IP macbypass hardware.

config WL_BB_LOG_DISABLE
    bool "Compile out the IPRO6 Wi-Fi baseband/RF debug log (WL_BB_LOG_EN=0)"
    help
      Builds the ipro6_rf driver with WL_BB_LOG_EN=0, which turns its
      wl_logprintf() debug prints (PHY/RFC/calibration) into no-ops. Replies
      of the PHY/RF test CLI are still printed. Unset keeps WL_BB_LOG_EN=1,
      the logging every IPRO6 app had before. Per-app .config files get no
      Kconfig defaults, so turning the log off is the explicit choice.

config PHY_LPFW
    bool "Build the low-power-mode PHY variant (phy_lp.c)"
    help
      Select the low-power-mode PHY (phy_lp.c / agcmem_lp.c) instead of the
      normal PHY (phy.c / agcmem.c). The low-power variant uses a reduced AGC
      event memory and re-tuned RX gain-control / reference-level settings.
      Leave unset for normal phyrf / Wi-Fi builds.

config WIRELESS_LIB_VARIANT
    string "Prebuilt library variant"
    default ""
    help
      Name of the lib/<variant>/ directory that holds prebuilt archives.
      A component whose lib/<variant>/lib<name>.a exists links that archive
      instead of compiling its sources. Empty builds everything from source.
      Release packages set it per shipped defconfig.

config IPRO6_FMAC
    bool "Build the IPRO6S FullMAC firmware variant"
    depends on WIFI6
    help
      FullMAC firmware for a Linux cfg80211 host: the macsw UMAC/LMAC with
      macif_bus.c in place of the fhost glue, and no fhost, wpa_supplicant,
      lwIP adapter, sigma_dut, Wi-Fi/BT coexistence, beaconing, radio
      measurement or PHY CLI. Set only by apps/platform/ipro6_fmac
      (defconfig_ipro6_fmac).

config IPRO6_FMAC_AP
    bool "FullMAC firmware: softAP for a host hostapd"
    depends on IPRO6_FMAC
    help
      Adds beaconing (apm, mm_bcn) to the FullMAC firmware and the bus
      messages hostapd needs through nl80211: AP start/stop, station
      add/delete, beacon template download and host management frame
      TX with ack status. The host runs the AP SME.

config WIFI_HT40_ENABLE
    bool "Permit HT40 (40 MHz) channel width by default"
    depends on WIFI6
    help
      Boot default for the fhost HT40 permission flag. It only PERMITS 40 MHz:
      the modem capability (phy_get_bw, read-only) and the AP's HT Operation IE
      still decide the width actually used, so this is safe to leave on.

      When set, the link governor also starts in auto mode: 40 MHz while
      the secondary channel is clean, 20 MHz while it is busy (`lgov bw`
      overrides it at runtime).

      Leave unset to keep the historic 20 MHz-only behaviour. Either way the
      `wifi_ht40` shell command overrides it at runtime, before stack_wifi.

config WIFI_AP_MAC_SPLIT
    bool "Give the softAP its own MAC address"
    depends on WIFI6
    help
      The AP interface takes the station MAC with its last bit flipped.
      Without it the AP and the station interface of one device share
      an address, and an IPRO6S client cannot join the AP. The bridge
      images always set it; set it in a standalone image that runs
      wifi_ap_start.

config IPRO6S_HOTCODE
    bool "Place per-frame hot functions in TCM"
    help
      Functions marked HOTCODE or section(".hotcode") are placed in the
      .hotcode input section. The IPRO6 generated flash linker script
      places that section and the objects in HOTCODE_OBJECTS
      (configs/ipro6_flash.cmake) in TCM.

choice WIFI_MEM_PROFILE
    prompt "IPRO6 standalone station memory profile"
    depends on WIFI6 && IPRO6
    default WIFI_MEM_PROFILE_PERF
    help
      Splits RAM between Wi-Fi throughput and the FreeRTOS heap on a
      standalone station (lwIP on the IPRO6). The SDIO/USB bridges do
      not use it.

config WIFI_MEM_PROFILE_PERF
    bool "Max throughput"
    help
      All of HOTCODE_OBJECTS in TCM, 70 KB lwIP heap, 20 RX buffers,
      20 KB MAC RX buffer, 24-MSS TCP window, 34-MSS send buffer.

config WIFI_MEM_PROFILE_BALANCED
    bool "Balanced"
    help
      HOTCODE_OBJECTS_BALANCED in TCM, 32 KB lwIP heap, 12 RX
      buffers, 12 KB MAC RX buffer, 8-MSS TCP window, 16-MSS send
      buffer, 8-frame reorder window.

config WIFI_MEM_PROFILE_APP
    bool "Heavy application"
    help
      Only HOTCODE-marked functions in TCM, 24 KB lwIP heap, 10 RX
      buffers, 12 KB MAC RX buffer, 6-MSS TCP window, 8-MSS send
      buffer, 8-frame reorder window.

endchoice

if WIFI6
endif

# ATBM6162 (Altobeam OCEANUS) external Wi-Fi 6 over SDIO
osource "components/wireless/wifi_atbm6162/Kconfig"

# AIC8800 D80-H (AICSemi) external Wi-Fi 5 + BT combo over SDIO
osource "components/wireless/wifi_aic8800/Kconfig"

config LPAPP
    bool "Enable Low Power Application Processor"
    help
      Enable low power application processor support for power-optimized
      wireless applications.

config ZIGBEE_STACK
    bool "Enable Zigbee Stack"
    select IEEE802154_ENABLE
    help
      Enable Zigbee wireless protocol stack support.

# Hidden backward-compatibility alias (lmac154 is now part of ieee802154)
config LOWER_MAC_15P4_LIB
    bool
    default IEEE802154_ENABLE

osource "components/wireless/coex_bz/Kconfig"

config OPENTHREAD_ENABLE
    bool "Enable OpenThread Stack"
    select IEEE802154_ENABLE
    help
      Enable OpenThread Thread protocol stack support for IoT mesh networking.

      OpenThread is an open-source implementation of the Thread networking
      protocol. Thread provides a reliable, secure, low-power mesh network
      for IoT devices.

if OPENTHREAD_ENABLE
endif

# IPRO6S BLE controller compatibility configuration.  The historical BTDM
# names are retained, but the implementation lives in ipro_ble_controller.
osource "components/wireless/bluetooth/ipro_ble_controller/Kconfig.ipro6s"

endmenu
```
