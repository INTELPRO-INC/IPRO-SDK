## components/os/zephyr/dts/bindings/i2c/ipro,ipro7-i2c.yaml
```yaml
# Copyright (c) 2025 IPRO
# SPDX-License-Identifier: Apache-2.0

description: IPRO7 I2C controller

compatible: "ipro,ipro7-i2c"

include: [i2c-controller.yaml, base.yaml]

properties:
  reg:
    required: true

  interrupts:
    required: true

  clock-frequency:
    default: 100000
    description: I2C bus clock frequency in Hz
```

## components/os/zephyr/dts/bindings/pwm/ipro,ipro7-pwm.yaml
```yaml
# Copyright (c) 2025 IPRO
# SPDX-License-Identifier: Apache-2.0

description: IPRO7 PWM controller

compatible: "ipro,ipro7-pwm"

include: [pwm-controller.yaml, base.yaml]

properties:
  reg:
    required: true

  interrupts:
    required: true

  "#pwm-cells":
    const: 3

pwm-cells:
  - channel
  - period
  - flags
```

## components/os/zephyr/dts/bindings/spi/ipro,ipro7-spi.yaml
```yaml
# Copyright (c) 2025 IPRO
# SPDX-License-Identifier: Apache-2.0

description: IPRO7 SPI controller

compatible: "ipro,ipro7-spi"

include: [spi-controller.yaml, base.yaml]

properties:
  reg:
    required: true

  interrupts:
    required: true

  clock-frequency:
    type: int
    default: 1000000
    description: SPI controller clock frequency
```

## components/os/zephyr/soc/riscv/ipro/Kconfig.defconfig
```kconfig
# Copyright (c) 2025 IPRO
# SPDX-License-Identifier: Apache-2.0

if SOC_IPRO7

config SOC
	default "ipro7"

config NUM_IRQS
	default 128

config CPU_HAS_FPU
	default y

config 2ND_LVL_ISR_TBL_OFFSET
	default 12

config 2ND_LVL_INTR_00_OFFSET
	default 11

config MAX_IRQ_PER_AGGREGATOR
	default 128

config RISCV_MCAUSE_EXCEPTION_MASK
	hex
	default 0x7FFFFFFF

config RISCV_MACHINE_TIMER_SYSTEM_CLOCK_DIVIDER
	default 1

config KERNEL_ENTRY
	default "_start"

endif # SOC_IPRO7
```

## components/os/zephyr/soc/riscv/ipro/ipro7/Kconfig.soc
```kconfig
# Copyright (c) 2025 IPRO
# SPDX-License-Identifier: Apache-2.0

config SOC_IPRO7
	bool "IPRO7 SoC"
	select RISCV_ISA_RV32I
	select RISCV_ISA_EXT_M
	select RISCV_ISA_EXT_A
	select RISCV_ISA_EXT_C
	select RISCV_ISA_EXT_F
	select RISCV_ISA_EXT_ZBA
	select RISCV_ISA_EXT_ZBB
	select RISCV_ISA_EXT_ZBC
	select RISCV_ISA_EXT_ZBS
	select CPU_HAS_FPU
	select INCLUDE_RESET_VECTOR
	help
	  IPRO7 RISC-V 32-bit SoC with FPU support

if SOC_IPRO7

config NUM_IRQS
	int
	default 128

config CPU_HAS_FPU
	bool
	default y

config 2ND_LVL_ISR_TBL_OFFSET
	int
	default 12

config 2ND_LVL_INTR_00_OFFSET
	int
	default 11

config MAX_IRQ_PER_AGGREGATOR
	int
	default 128

config RISCV_MCAUSE_EXCEPTION_MASK
	hex
	default 0x7FFFFFFF

config RISCV_MACHINE_TIMER_SYSTEM_CLOCK_DIVIDER
	int
	default 1

endif # SOC_IPRO7
```

## components/psa/Kconfig
```kconfig
menu "PSA (Platform Security Architecture)"

config PSA_ENABLE
    bool
    default n

config PSA_SPE
    bool "Build the M-mode PSA-RoT (SPE) image"
    default n
    select PSA_ENABLE
    select COMPONENTS_MBEDTLS_ENABLE
    select MBEDTLS_PSA_CRYPTO
    select LITTLEFS
    select LITTLEFS_USE_PARTITION_TABLE
    select COMPONENTS_TINYCBOR_ENABLE
    select SEC_ENG_HAL_V2
    help
      Secure Processing Environment: SPM, PMP, ecall services.
      Requires CONFIG_NO_RTOS=y.

menu "PSA SPE options"
    depends on PSA_SPE

config PSA_HUK_EFUSE_SLOT
    int "eFuse key slot of the HUK"
    range 2 4
    default 4
    help
      eFuse key slot that holds the HUK: 4 on parts with XIP AES-128
      (ef_sf_aes_mode 1), 2 on plaintext parts (ef_sf_aes_mode 0).
      The SEC_ENG key mux follows ef_sf_aes_mode (IPRO7 702L key
      table, tzc_sboot_done 0): plaintext KEY_SEL 0 = slot 3, 1 =
      slot 2; AES-128 KEY_SEL 1 = slot 4, 3 = slot 2. Slot 3 holds
      trim data; huk.h refuses any slot but 2 and 4. HUK
      provisioning (PSA_HUK_PROV) burns slot 4 only.

config PSA_HUK_KEY_SEL
    int "SEC_ENG KEY_SEL of the HUK hardware key"
    range 0 3
    default 1 if !PSA_HUK_IN_RAM
    default 0
    help
      SEC_ENG KEY_SEL of the hardware-key path of huk_prf, with the
      SE_AES_SBOOT key source 0, while tzc_sboot_done is 0 (eFuse
      keep_dbg_port_closed set). KEY_SEL 1 is the HUK slot on both
      slot 4 (XIP AES-128) and slot 2 (plaintext) parts; see
      PSA_HUK_EFUSE_SLOT. huk.c refuses to build KEY_SEL 0 without
      PSA_HUK_IN_RAM.

config PSA_HUK_IN_RAM
    bool "Read the HUK from its eFuse slot for each derivation"
    default y
    help
      huk_prf reads the HUK eFuse slot into one stack buffer and runs
      software AES; the buffer is wiped after each call. Off: the
      SEC_ENG hardware key (KEY_SEL above) only; the slot is never
      read and may be read-locked.

config PSA_HUK_KAT
    bool "Check the hardware key against the HUK slot at init"
    default n
    help
      huk_init compares one SEC_ENG hardware-key block with software
      AES under the HUK slot and uses the hardware key on a match.
      Reads the slot into RAM once.

config PSA_HUK_LOCK
    bool "Close the SEC_ENG hardware-key route after init"
    depends on !PSA_HUK_IN_RAM
    default y
    help
      After the last HUK derivation of SPE init and before the NSPE
      runs, huk_lock sets tzc_sboot_done (TZC_SEC ROM_TZSRG_CTRL
      bits 31:28) to 0xF by read-modify-write, reads it back and
      runs one KEY_SEL block: it must give the zero-key block, else
      spm_fatal. Skipped when tzc_sboot_done is already non-zero at
      huk_init (part without eFuse keep_dbg_port_closed). huk_prf
      refuses every call after huk_lock, with or without this option.

config PSA_DEV_HUK
    bool "Built-in development HUK when the HUK slot is blank"
    default y
    help
      With a blank HUK (blank slot, or a hardware key equal to the
      all-0 / all-1 key), huk_prf runs on a public development key
      and huk_is_dev() returns 1. A locked (tzc_sboot_done set) or
      failed engine never falls back to it: no HUK, ITS and
      attestation disabled. Off: no HUK, no ITS.

config PSA_HUK_PROVISION
    bool "HUK provisioning image (draws and burns eFuse slot 4)"
    depends on !PSA_HUK_IN_RAM && !PSA_DEV_HUK && !PSA_HUK_KAT
    depends on PSA_HUK_LOCK
    default n
    help
      The SPE runs huk_prov_main instead of the services and never
      launches an NSPE: checks the part, prints a plan digest, waits
      60 s for "HUKPROV <chip> <digest>" on the console, draws 128
      bits from the SEC_ENG TRNG, burns key slot 4 and the 0x7C
      bits 23 + 30, prints KCV = AES-128(HUK, 0) and halts. Build
      only defconfig_ipro7_hukprov with it; never ship it in an OTA
      package.

config PSA_SEC_ENG_ACCEL
    bool "SEC_ENG accelerator driver for PSA Crypto"
    depends on MBEDTLS_V3 || TF_PSA_CRYPTO
    select SEC_ENG_HAL_V2
    default n
    help
      The ipro_sec transparent driver (components/psa/accel) runs
      SHA-1/224/256/384/512 (and HMAC through them), AES-128/192/256
      ECB and CBC without padding, CTR and GCM, P-256 randomized ECDSA
      sign, ECDSA verify, ECDH, key generation and public key export
      on the SEC_ENG through HAL v2, and seeds the CTR_DRBG from the
      HAL v2 TRNG. Other algorithms, curves and key sizes fall back to
      the built-in software driver. Patches the driver wrappers of the 3.6 and
      TF-PSA trees (port/sec_eng_driver.patch); off: no change.

config PSA_TZC_ISOLATION
    bool "Lock bus-master isolation (TZC_SEC) before the NSPE"
    default n
    help
      spm_tzc_apply sets and locks TZC_SEC before the NSPE runs:
      DMA channels, USB, SDHA, EMAC and M154 become master ID1;
      ID1 loses SPE RAM (OCRAM and MM2OCRAM 0x11010000-0x1101FFFF),
      all of flash (SF RX), the APB slots outside spm_periph and the
      DMA and timer registers, the AHB slaves but USB (PDS, HBN, HBN
      RAM, EMAC, SDH, MM), SEC_ENG and SF_CTRL. The CPU stays ID0 in
      M and U mode, so PMP still separates SPE and NSPE. Values are
      read back and a tamper write must not take, else spm_fatal.
      RST pin, SW system, SW POR and WDT resets clear the locks; the
      SPE sets them on every boot.

config PSA_TZC_CCI_ID1
    bool "CCI debug master as ID1"
    depends on PSA_TZC_ISOLATION
    default n
    help
      CCI gets the ID1 view: no SPE RAM, flash, GLB, eFuse or TZC.
      CCI cannot set its pinmux (GLB is ID0 only): no CCI access to
      the part while the SPE runs.
      Product build only (defconfig_ipro7).

endmenu

config PSA_NSPE_DMA_USB
    bool "NSPE owns DMA0 and the USB device"
    depends on (PSA_SPE && PSA_TZC_ISOLATION) || PSA_CLIENT
    default n
    help
      SPE: the DMA0 (0x30082000) and USB (0x30084000) register
      blocks become NSPE PMP windows with their IRQs (DMA0_ALL_IRQn,
      USB_IRQn); U-mode word loads and stores to GLB usb_xcvr,
      usb_xcvr_config and the GPIO 8/9 config are done by the SPE
      under a write mask; an NSPE reset disables the DMA channels
      and the USB core. SPE: needs PSA_TZC_ISOLATION (both are ID1).
      NSPE: CherryUSB on drv_usb_v1.c, HAL interrupt calls routed to
      the vIRQ table (IPRO_HAL_OS_IRQ_SEAM).

config PSA_CLIENT
    bool "Build the NSPE PSA client library"
    default n
    depends on FREERTOS_PORT_NSPE
    select PSA_ENABLE

config FREERTOS_PORT_NSPE
    bool "FreeRTOS U-mode port (NSPE under the PSA SPE)"
    default n
    depends on FREERTOS
    help
      Replaces portable_ipro7 with portable_ipro7_nspe: no M-mode
      CSRs, interrupts arrive as virtual IRQs from the SPE.

endmenu
```

## components/radar/Kconfig
```kconfig
menu "Radar Sensors"

config COMPONENTS_RADAR_KW307_ENABLE
    bool "Enable Keywave KW307 24 GHz presence radar"
    default n
    help
      UART driver for the Keywave KW307-P 24 GHz human-presence module.
      The module streams a 27-byte detection frame at 20 Hz carrying a
      presence flag and up to three tracked targets (two moving, one
      stationary), each with distance, angle, magnitude and tracker state.

      The module is 3.3 V logic and is NOT 5 V tolerant, so the pads it is
      wired to must sit in a bank whose VDDIO is 3.3 V.

config RADAR_KW307_HISTORY_SECONDS
    int "Seconds of frame history to retain in PSRAM"
    default 900
    depends on COMPONENTS_RADAR_KW307_ENABLE
    help
      The module emits 20 frames per second and each retained sample is 26
      bytes, so a second of history costs 520 bytes: 900 s is 457 KB and an
      hour is 1.79 MB. This history is what separates the part from an M0
      host - it is the input to any analysis whose window is longer than a
      single frame (dwell statistics, breathing, behavioural baselines, and
      the time axis of a range-time map). Set to 0 to compile the ring out.

endmenu
```

## components/sensor/Kconfig
```kconfig
config COMPONENTS_SENSOR_ENABLE
    bool "Enable Sensor Framework"
    default n
    help
      Enable the sensor subsystem to support various hardware sensors.
      This may include temperature, humidity, motion, or custom sensors.

config SENSOR_OV5640
    bool "OmniVision OV5640 DVP driver (YUV422, 1280x720 binned)"
    depends on COMPONENTS_SENSOR_ENABLE
    default n
    help
      SCCB 0x3C, 16-bit registers. Runs the 5 MP array 2x-binned through a
      16:9 window to 1280x720 YUV422 (YUYV) with the sensor's own AEC/AGC/AWB;
      the ISP firmware's imgproc 3A is not needed. Register tables ported from
      esp32-camera. Used by the IPRO7AI Reef FLEX-24 camera connector.

config SENSOR_OV2640
    bool "OmniVision OV2640 DVP driver (YUV422, 1280x720 from UXGA)"
    depends on COMPONENTS_SENSOR_ENABLE
    default n
    help
      SCCB 0x30, banked 8-bit registers. UXGA base mode cropped to a 1600x900
      window and DSP-scaled to 1280x720 YUV422 with on-sensor 3A. Build with
      -DOV2640_DEFAULT_VGA for the 640x480 SVGA-base path instead.
```
