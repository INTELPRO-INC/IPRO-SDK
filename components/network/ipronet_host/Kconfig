## components/network/rtsp_server/Kconfig
```kconfig
menuconfig RTSP_SERVER
    bool "RTSP Server (MJPEG streaming)"
    depends on COMPONENTS_LWIP_ENABLE
    default n
    help
      Enable RTSP server for MJPEG/H.264 streaming over lwIP on
      FreeRTOS (Apache-2.0, see LICENSE-APACHE-2.0.txt).

      Pull-model frame source: producer registers a get_frm_t callback
      via set_strm_cb(); RTSP session pulls frames at the configured
      fps. ISP integration (Phase 5) just wires the ISP JPEG-done
      path into the same callback.

if RTSP_SERVER

config RTSP_LISTEN_PORT
    int "RTSP listen port"
    default 8554
    range 1 65535
    help
      TCP port for RTSP control channel. Default 8554 matches the
      library's DFL_RTSP_PORT. Use 554 only if you also own the
      privileged-port capability on your network.

config RTSP_DEFAULT_VIDEO_FPS
    int "Default video fps"
    default 5
    range 1 60
    help
      Default frame rate for the pull-model source. Phase 4 test
      source uses this to pace its canned-frame rotation.

config RTSP_TASK_STACK_SIZE
    int "RTSP listener task stack (bytes)"
    default 4096
    range 2048 16384
    help
      Stack size for the main RTSP server task (rtsp_srv_thrd).
      Per-session tasks reuse the same default. Bump to 6144 if
      stack-overflow assertions fire during long soaks.

config RTSP_TEST_SOURCE
    bool "Compile Phase 4 canned-frame test source"
    default y
    help
      When enabled, builds rtsp_test_source.c which implements a
      get_frm_t callback that cycles through canned JPEG frames from
      apps/platform/ipro7_demo/demo/esp32_at/mjpeg_frames.h (or an
      embedded fallback 720p JPEG). Turn OFF in Phase 5 when the
      real ISP callback is wired in.

config RTSP_ISP_SOURCE
    bool "Compile Phase 5 ISP -> MJPEG real source"
    depends on MM_SUPPORT && COMPONENTS_SENSOR_ENABLE
    default y if MM_SUPPORT
    help
      When enabled, builds rtsp_isp_source.c which boots the IPRO7
      sensor + ISP + MJPEG pipeline and serves real-time JPEG frames
      to the RTSP server through a get_frm_t callback. Mutually
      exclusive at runtime with RTSP_TEST_SOURCE — install one or
      the other via the shell (rtsp_isp_src on / rtsp_test_src on).

config RTSP_SHELL
    bool "Enable dev shell commands (rtsp_*)"
    default y

config RTSP_AUTOSTART
    bool "Auto-start RTSP server when host netif has IP"
    depends on ESP_HOSTED_NETIF
    default y
    help
      Spawn a task during app_main that polls
      esp_hosted_netif_is_ip_ready() and calls rtsp_init_lib() +
      rtsp_test_source_install() (if enabled) once the host has a
      DHCP lease. Requires the user to drive eh_init + eh_connect
      from the shell; this only automates what happens AFTER IP is
      up. Turn OFF to drive the full sequence manually.

endif # RTSP_SERVER
```

## components/network/sdio_host_probe/Kconfig
```kconfig
# sdio_host_probe sub-options. COMPONENTS_SDIO_HOST_PROBE_ENABLE itself is
# defined in components/network/Kconfig, next to the other network components.

config SDIO_HOST_PROBE_BUS
    bool "SDIO host probe: own the host descriptor (enumerate + negotiate + dumps)"
    depends on COMPONENTS_SDIO_HOST_PROBE_ENABLE
    default y
    help
      Compiles the bus layer, which keeps one SDIO_Host_Type on SDH controller
      0 and drives enumeration, bus negotiation and the CCCR/CIS/function dumps.

      Turn this OFF for a module whose vendor driver calls sdio_host_init()
      itself -- ATBM6162 keeps its own descriptor in atbm_os_sdio.c, and a
      second one on the same controller would race it. Those apps still get the
      board layer (SDH pinmux + module power/reset sequencing).

config SDIO_HOST_PROBE_SHELL
    bool "SDIO host probe: register the generic sdio_* shell commands"
    depends on SDIO_HOST_PROBE_BUS && SHELL
    default y
    help
      sdio_init / sdio_pwr / sdio_reset / sdio_cycle / sdio_enum / sdio_width /
      sdio_clk / sdio_hs / sdio_blksz / sdio_en / sdio_dis / sdio_cccr /
      sdio_cis / sdio_func / sdio_readb / sdio_writeb / sdio_rdbyte /
      sdio_rdblk / sdio_wrblk / sdio_pins / sdio_probe.

      Module-specific commands stay in the app; bind an on_post_enable callback
      with sdio_probe_shell_bind() to have sdio_probe run the module's own
      bring-up registers.
```

## components/os/Kconfig
```kconfig
menu "RTOS Configuration"

#
# RTOS Support Flags (selected automatically)
#
config FREERTOS_SUPPORT
    bool
    default n
    help
      Internal symbol indicating that FreeRTOS is enabled.

config ZEPHYR_SUPPORT
    bool
    default n
    help
      Internal symbol indicating that Zephyr RTOS is enabled.

config COMPONENTS_FREERTOS_ENABLE
    bool 
    default n
    help
      Internal symbol used to enable FreeRTOS-specific components and settings.

config COMPONENTS_ZEPHYR_ENABLE
    bool
    default n
    help
      Internal symbol used to enable Zephyr-specific components and settings.


#
# RTOS Selection
#
choice
    prompt "Select RTOS"
    default FREERTOS
    help
      Select which RTOS to use in this project.
      Only one option may be selected at a time.

config FREERTOS
    bool "FreeRTOS"
    help
      Enable FreeRTOS support in the project.
      This includes the FreeRTOS kernel and related components.
    select FREERTOS_SUPPORT
    select COMPONENTS_FREERTOS_ENABLE

config ZEPHYR
    bool "Zephyr RTOS"
    help
      Enable Zephyr RTOS support in the project.
      This includes the Zephyr kernel and its integration settings.
    select ZEPHYR_SUPPORT
    select COMPONENTS_ZEPHYR_ENABLE

config NO_RTOS
    bool "No RTOS"
    help
      Do not include any RTOS in the project.
      Useful for bare-metal applications or test cases.
endchoice


#
# FreeRTOS-specific Options
#
if FREERTOS

menu "FreeRTOS Configuration"

config FREERTOS_IDLE_TASK_STACK_WORDS
    int "Static idle task stack override (0 uses port default)"
    depends on IPRO7 || IPRO6
    range 0 4096
    default 0
    help
      Stack size in 32-bit words for the shared static idle-task hook.
      Zero preserves configMINIMAL_STACK_SIZE. Nonzero values must be at
      least 128 words. Audit idle hooks, task cleanup and interrupt stack
      switching, then measure high-water marks before reducing the size.
      Other tasks using configMINIMAL_STACK_SIZE are not changed.

config FREERTOS_TIMER_TASK_STACK_WORDS
    int "Timer service task stack (32-bit words)"
    depends on IPRO7 || IPRO6
    range 1 65535
    default 4096
    help
      Preserve 4096 words unless the application's linked timer callbacks and
      interrupt stack usage have been audited and measured under load.
      This does not change the separate Matter event-loop task stack.

config FREERTOS_STACK_REPORT_S
    int "Bench: print stack and heap high-water marks every N seconds"
    default 0
    help
      Zero (default) builds nothing. Otherwise ipro_platform_init() starts a
      low-priority task (2 KB static stack) that prints every task's minimum
      free stack, the heap's minimum-ever free size and, on IPRO7, how deep
      the hal_lp PDS stack has been used. Its wake-ups cut PDS windows, so
      use it to size stacks under the real workload, not for power runs.

config APP_WATCHDOG
    bool "Arm the AON watchdog, fed from a highest-priority task"
    depends on IPRO7
    default n
    help
      app_watchdog_start() (app_watchdog.h) arms the always-on watchdog and
      feeds it every second (hardware-timer time) from a task at configMAX_PRIORITIES - 1, so the
      SoC restarts when the CPU as a whole stops: a bus stall (an NPU running
      a malformed program), interrupts left off, an interrupt storm. A busy
      task starving lower ones does not trip it. platform_init() arms it at
      the start of every boot as well, so a boot that hangs before the
      feeder runs restarts too: an app that enables this must call
      app_watchdog_start(). Shell: `watchdog`, `watchdog test` (stop
      feeding). The Edge AI Teach firmwares enable it.

config APP_WATCHDOG_TIMEOUT_S
    int "AON watchdog timeout (seconds; 2, 4, 8, 16, 32 or 64)"
    depends on APP_WATCHDOG
    range 2 64
    default 8
    help
      Rounded up to the next power of two (the hardware only doubles). It
      must cover the longest stretch with interrupts off: flash_erase() holds
      them off for the whole range it erases (about 45 ms per 4 KB sector,
      400 ms at worst).

config COMPONENTS_FREERTOS_POSIX_ENABLE
    bool "Enable FreeRTOS POSIX Compatibility Layer"
    default n
    help
      Enable POSIX API support for FreeRTOS.
      This allows writing applications using standard POSIX functions like pthread, sem, etc.

config HW_STACK_PROTECTION
    bool "Hardware Stack Protection"
    default n
    depends on IPRO7 || IPRO6
    help
      Enable hardware stack overflow detection using
      mstack_ctrl/mstack_bound/mstack_base CSRs (0x7C6-0x7C8).
      Provides instant hardware trap on stack overflow with zero
      runtime polling overhead. Requires CFG_HAS_STACK_CHECK
      enabled in RTL.

endmenu

endif  # FREERTOS

#
# IPRO OSAL (works with FreeRTOS)
#
if FREERTOS
source "components/os/ipro_osal/Kconfig"
endif

#
# Zephyr: the SDK builds as a Zephyr module (zephyr/module.yml at the repo
# root). Zephyr applications are configured with Zephyr's own Kconfig, not
# this one; CONFIG_ZEPHYR here only exists so the RTOS choice is complete.
#
endmenu
```

## components/os/ipro_osal/Kconfig
```kconfig
# IPRO OSAL Configuration

config IPRO_OSAL
    bool "Enable IPRO OS Abstraction Layer"
    default y
    help
      Enable the IPRO OS Abstraction Layer (OSAL).
      Provides a unified API for OS primitives like mutex, semaphore,
      task, queue, timer, and memory management.
```

## components/os/zephyr/Kconfig
```kconfig
# Zephyr RTOS Configuration for IPRO SDK

if ZEPHYR

config COMPONENTS_ZEPHYR_ENABLE
    bool
    default y
    help
      Internal symbol used to enable Zephyr-specific components and settings.

config ZEPHYR_SUPPORT
    bool
    default y
    help
      Internal symbol indicating that Zephyr RTOS is enabled.

menu "Zephyr Configuration"

config ZEPHYR_KERNEL_VERSION
    string "Zephyr Kernel Version"
    default "3.4.0"
    help
      Specify the Zephyr kernel version to use.

config ZEPHYR_BOARD
    string "Target Board"
    default "ipro7"
    help
      Specify the target board for Zephyr build.
      Default is 'ipro7' for IPRO7 platform.

config ZEPHYR_IPRO_UART_SUPPORT
    bool "Enable UART support for IPRO platforms"
    default y
    help
      Enable UART driver support for IPRO platforms in Zephyr.

config ZEPHYR_IPRO_GPIO_SUPPORT
    bool "Enable GPIO support for IPRO platforms"
    default y
    help
      Enable GPIO driver support for IPRO platforms in Zephyr.

config ZEPHYR_IPRO_SPI_SUPPORT
    bool "Enable SPI support for IPRO platforms"
    default y
    help
      Enable SPI driver support for IPRO platforms in Zephyr.

config ZEPHYR_IPRO_I2C_SUPPORT
    bool "Enable I2C support for IPRO platforms"
    default y
    help
      Enable I2C driver support for IPRO platforms in Zephyr.

config ZEPHYR_BLUETOOTH_SUPPORT
    bool "Enable Bluetooth support in Zephyr"
    default y if COMPONENTS_WIRELESS_BLE_ENABLE
    help
      Enable Bluetooth Low Energy support in Zephyr.
      This integrates with IPRO's BLE stack.

config ZEPHYR_NETWORKING_SUPPORT
    bool "Enable networking support in Zephyr"
    default y if COMPONENTS_NETWORK_ENABLE
    help
      Enable networking support in Zephyr.
      This integrates with lwIP networking stack.

config ZEPHYR_CRYPTO_SUPPORT
    bool "Enable crypto support in Zephyr"
    default y if COMPONENTS_CRYPTO_ENABLE
    help
      Enable cryptographic support in Zephyr.
      This integrates with Mbed TLS.

config ZEPHYR_FILESYSTEM_SUPPORT
    bool "Enable filesystem support in Zephyr"
    default y if COMPONENTS_FS_ENABLE
    help
      Enable filesystem support in Zephyr.
      This integrates with FatFS and ROMFS.

endmenu

endif # ZEPHYR
```

## components/os/zephyr/boards/riscv/ipro7/Kconfig.defconfig
```kconfig
# Copyright (c) 2025 IPRO
# SPDX-License-Identifier: Apache-2.0

if BOARD_IPRO7_FPGA

config BOARD
	default "ipro7_fpga"

endif # BOARD_IPRO7_FPGA

if BOARD_IPRO7_EVB

config BOARD
	default "ipro7_evb"

endif # BOARD_IPRO7_EVB
```

## components/os/zephyr/boards/riscv/ipro7/ipro7_evb_defconfig
```kconfig
# Copyright (c) 2025 IPRO
# SPDX-License-Identifier: Apache-2.0

CONFIG_SOC_IPRO7=y
CONFIG_BOARD_IPRO7_EVB=y
CONFIG_CONSOLE=y
CONFIG_SERIAL=y
CONFIG_UART_CONSOLE=y
CONFIG_GPIO=y
```

## components/os/zephyr/boards/riscv/ipro_boards/Kconfig.board
```kconfig
# Copyright (c) 2025 IPRO
# SPDX-License-Identifier: Apache-2.0

config BOARD_IPRO7_FPGA
	bool "IPRO7 FPGA Development Board"
	depends on SOC_IPRO7

config BOARD_IPRO7_EVB
	bool "IPRO7 Evaluation Board"
	depends on SOC_IPRO7
```

## components/os/zephyr/boards/riscv/ipro_boards/Kconfig.defconfig
```kconfig
# Copyright (c) 2025 IPRO
# SPDX-License-Identifier: Apache-2.0

if BOARD_IPRO7_FPGA

config BOARD
	default "ipro7_fpga"

config SOC
	default "ipro/ipro7"

endif # BOARD_IPRO7_FPGA

if BOARD_IPRO7_EVB

config BOARD
	default "ipro7_evb"

config SOC
	default "ipro/ipro7"

endif # BOARD_IPRO7_EVB
```

## components/os/zephyr/boards/riscv/ipro_boards/ipro7_fpga_defconfig
```kconfig
# Copyright (c) 2025 IPRO
# SPDX-License-Identifier: Apache-2.0

CONFIG_SOC_FAMILY_IPRO=y
CONFIG_SOC_IPRO7=y
CONFIG_BOARD_IPRO7_FPGA=y

# Enable reset vector
CONFIG_INCLUDE_RESET_VECTOR=y

# Enable FPU
CONFIG_FPU=y
CONFIG_FLOAT_HARD=y

CONFIG_CONSOLE=y
CONFIG_SERIAL=y
CONFIG_UART_CONSOLE=y
CONFIG_SYS_CLOCK_HW_CYCLES_PER_SEC=100000000

# Enable XIP (Execute In Place) to separate code and data
CONFIG_XIP=y

# Enable GPIO support
CONFIG_GPIO=y

# Enable PWM support  
CONFIG_PWM=y

# Enable log system for debugging
CONFIG_LOG=y
CONFIG_PRINTK=y
```

## components/os/zephyr/drivers/Kconfig
```kconfig
# Copyright (c) 2025 IPRO
# SPDX-License-Identifier: Apache-2.0

# IPRO7 Zephyr Driver Configuration

config GPIO_IPRO7
	bool "IPRO7 GPIO driver"
	default y
	depends on GPIO && SOC_IPRO7
	help
	  Enable driver for IPRO7 GPIO controller.

config PWM_IPRO7
	bool "IPRO7 PWM driver"
	default y
	depends on PWM && SOC_IPRO7
	help
	  Enable driver for IPRO7 PWM controller.

config SPI_IPRO7
	bool "IPRO7 SPI driver"
	default y
	depends on SPI && SOC_IPRO7
	help
	  Enable driver for IPRO7 SPI controller.

config I2C_IPRO7
	bool "IPRO7 I2C driver"
	default y
	depends on I2C && SOC_IPRO7
	help
	  Enable driver for IPRO7 I2C controller.

config ADC_IPRO7
	bool "IPRO7 ADC driver"
	default y
	depends on ADC && SOC_IPRO7
	help
	  Enable driver for IPRO7 ADC controller.
```

## components/os/zephyr/dts/bindings/adc/ipro,ipro7-adc.yaml
```yaml
# Copyright (c) 2025 IPRO
# SPDX-License-Identifier: Apache-2.0

description: IPRO7 ADC controller

compatible: "ipro,ipro7-adc"

include: [adc-controller.yaml, base.yaml]

properties:
  reg:
    required: true

  interrupts:
    required: true

  "#io-channel-cells":
    const: 1

io-channel-cells:
  - input
```

## components/os/zephyr/dts/bindings/gpio/ipro,ipro7-gpio.yaml
```yaml
# Copyright (c) 2025 IPRO
# SPDX-License-Identifier: Apache-2.0

description: IPRO7 GPIO controller

compatible: "ipro,ipro7-gpio"

include: [gpio-controller.yaml, base.yaml]

properties:
  reg:
    required: true

  interrupts:
    required: true

  ngpios:
    type: int
    required: true
    description: |
      Number of pins supported by the controller.

  "#gpio-cells":
    const: 2

gpio-cells:
  - pin
  - flags
```
