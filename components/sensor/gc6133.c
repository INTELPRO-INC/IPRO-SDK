/*
 * This file is part of the OpenMV project.
 * Copyright (c) 2013/2014 Ibrahim Abdelkader <i.abdalkader@gmail.com>
 * This work is licensed under the MIT license, see the file LICENSE for details.
 *
 * bf30a2 driver.
 *
 */
#include <stdint.h>
#include <stdio.h>
#include <stdlib.h>
#include <string.h>

#include "sensor.h"
#include "sccb.h"
#include "camera.h"
//#include "bf30a2.h"

static const uint8_t gc6133_reglist[][2] =
{
    /////////////////////////////////////////////////////
    //////////////////////   SYS   //////////////////////
    /////////////////////////////////////////////////////
    {0xfe, 0xa0},
    {0xfe, 0xa0},
    {0xfe, 0xa0},
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    {0x4b, 0x5d},
    /////////////////////////////////////////////////////
    ////////////////   ANALOG & CISCTL       ////////////////
    /////////////////////////////////////////////////////
    {0x03, 0x00},
    {0x04, 0xfa},
    {0x01, 0x24},
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    {0xfe, 0x10},
    /////////////////////////////////////////////////////
    //////////////////////   ISP   //////////////////////
    /////////////////////////////////////////////////////
    {0x20, 0x7e},
    {0x22, 0xb8},
    {0x24, 0x54},
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    {0x3e, 0xf0},
    /////////////////////////////////////////////////////
    //////////////////////   BLK   //////////////////////
    /////////////////////////////////////////////////////
    {0x2a, 0x2f},
    {0x37, 0x46},
    /////////////////////////////////////////////////////
    //////////////////////   GAIN   /////////////////////
    /////////////////////////////////////////////////////
    {0x3f, 0x18 },
    /////////////////////////////////////////////////////
    //////////////////////   DNDD   /////////////////////
    /////////////////////////////////////////////////////
    {0x50, 0x3c},
    {0x52, 0x4f},
    {0x53, 0x81},
    {0x54, 0x43},
    {0x56, 0x78},
    {0x57, 0xaa},
    {0x58, 0xff},
    /////////////////////////////////////////////////////
    //////////////////////   ASDE   /////////////////////
    /////////////////////////////////////////////////////
    {0x5b, 0x60},
    {0x5c, 0x80},
    {0xab, 0x28},
    {0xac, 0xb5},
    /////////////////////////////////////////////////////
    /////////////////////   INTPEE   ////////////////////
    /////////////////////////////////////////////////////
    {0x60, 0x45},
    {0x62, 0x68},
    {0x63, 0x13},
    {0x64, 0x43},
    /////////////////////////////////////////////////////
    //////////////////////   CC   ///////////////////////
    /////////////////////////////////////////////////////
    {0x65, 0x13},
    {0x66, 0x26},
    {0x67, 0x07},
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    {0x6d, 0xfb},
    /////////////////////////////////////////////////////
    //////////////////////   YCP   //////////////////////
    /////////////////////////////////////////////////////
    {0x81, 0x30},
    {0x82, 0x30},
    {0x83, 0x4a},
    {0x85, 0x06},
    {0x8d, 0x78},
    {0x8e, 0x25},
    /////////////////////////////////////////////////////
    //////////////////////   AEC   //////////////////////
    /////////////////////////////////////////////////////
    {0x90, 0x38},
    {0x92, 0x50},
    {0x9d, 0x32},
    {0x9e, 0x61},
    {0x9f, 0xf4},
    {0xa3, 0x28},
    {0xa4, 0x01},
    /////////////////////////////////////////////////////
    //////////////////////   AWB   //////////////////////
    /////////////////////////////////////////////////////
    {0xb1, 0x1e},
    {0xb3, 0x20},
    {0xbd, 0x70},
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    {0xba, 0x60},
    /////////////////////////////////////////////////////
    //////////////////////   SPI   //////////////////////
    /////////////////////////////////////////////////////
    {0xfe, 0x02},
    {0x01, 0x01},
    {0x02, 0x02},
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    {0xfe, 0x00},
    ///////////////////////////////////////////////////
    ///////////////////////output//////////////////////
    ///////////////////////////////////////////////////
    {0x22, 0xf8},
    {0xf1, 0x03},
};

//TODO use data section
//static const uint8_t addr_list[] = 
//{
//    0x21
//};

//0X6e
#define SENSOR_ADDR 0x40 // salve address
//#define VER_ADDR 0x21
#define PID_ADDR    0xf0
#define PID         0xba

int gc6133_probe(void)
{
	uint8_t id = 0;
    SCCB_Read(SENSOR_ADDR, PID_ADDR, &id, 1);
    printf("-----------camera id %02x\r\n", id);

    if (PID == id) {
        printf("ID matched\r\n");
        return 0;
    } else {
        printf("NOT matched\r\n");
        return -1;
    }
}

int gc6133_reset(void)
{
    SCCB_Write(SENSOR_ADDR, gc6133_reglist[1][0], (uint8_t*)&gc6133_reglist[1][1]);
    return 0;
}

int gc6133_setFMT(void)
{
    uint8_t value;
    for (int i = 0; i < sizeof(gc6133_reglist)/sizeof(gc6133_reglist[0]); i++){
       SCCB_Write(SENSOR_ADDR, gc6133_reglist[i][0], (uint8_t*)&gc6133_reglist[i][1]);
       if (gc6133_reglist[i][0] == 0x03) {
           SCCB_Read(SENSOR_ADDR, gc6133_reglist[i][0], &value, 1);
           printf("[0x%02x] = S:[0x%02x], R:[0x%02x]\r\n", gc6133_reglist[i][0], gc6133_reglist[i][1], value);
           platform_delay_ms(1);   
       }
#if 0
    
       SCCB_Read(SENSOR_ADDR, gc6133_reglist[i][0], &value, 1);
       if (gc6133_reglist[i][1] != value)
           printf("[0x%02x] = S:[0x%02x], R:[0x%02x]\r\n", gc6133_reglist[i][0], gc6133_reglist[i][1], value);
       platform_delay_ms(1);   
#endif
    }

    return 0;

}

const rt_camera_desc __rt_camera_gc6133_desc __attribute__((section(".camera_desc"))) =
{
    .name = "__rti_name_gc6133",
    .addr = SENSOR_ADDR,
    .frm_vld_high = 1,
    .probe = gc6133_probe,
    .reset = gc6133_reset,
    .setFMT = gc6133_setFMT,
    .width = 240,
    .height = 320,
};

