## apps/bluetooth/classic/ipro6s_bt_a2dp_sink/Kconfig
```kconfig
menu "IPRO6S A2DP sink example"

config BT_DEVICE_NAME
    string "Bluetooth device name"
    default "IPRO6S-Speaker"
    help
      Name a phone or computer shows when it searches for Bluetooth devices.

config BT_COD
    hex "Class of Device"
    default 0x240414
    help
      Class of Device sent in inquiry responses. 0x240414 is
      Audio/Video - Loudspeaker with the Audio and Rendering service bits,
      so phones list the board as a speaker.

config APP_I2S_OUTPUT
    bool "Play decoded audio on I2S"
    default y
    help
      Decode SBC and send 16-bit PCM to the I2S port (master, standard
      I2S, 16-bit slots) for an external I2S DAC or amplifier. Without it
      the app still receives and decodes the stream and reports it.

config APP_I2S_PIN_BASE
    int "First GPIO of the I2S group"
    default 0
    depends on APP_I2S_OUTPUT
    help
      The I2S signals follow the GPIO number modulo 4: BCLK on base,
      FS on base + 1, DO on base + 3. base must be a multiple of 4.
      0 puts them on the EVK's H1 header (GPIO0, GPIO1, GPIO3).

endmenu
```

## apps/bluetooth/classic/ipro6s_bt_a2dp_sink/Kconfig.app
```kconfig
mainmenu "IPRO6S Classic Bluetooth A2DP Sink Example"

source "Kconfig"
source "apps/bluetooth/classic/ipro6s_bt_a2dp_sink/Kconfig"
```

## apps/bluetooth/classic/ipro6s_bt_spp/Kconfig
```kconfig
menu "IPRO6S SPP example"

config BT_DEVICE_NAME
    string "Bluetooth device name"
    default "IPRO6S-SPP"
    help
      Name a phone or computer shows when it searches for Bluetooth devices.

config BT_COD
    hex "Class of Device"
    default 0x001f00
    help
      Class of Device sent in inquiry responses. 0x001f00 is
      "Uncategorized"; phones list the board as a generic device.

config APP_SPP_MTU
    int "RFCOMM MTU (bytes)"
    default 256
    range 23 1008
    help
      Largest payload of one RFCOMM frame in either direction.

endmenu
```

## apps/bluetooth/classic/ipro6s_bt_spp/Kconfig.app
```kconfig
mainmenu "IPRO6S Classic Bluetooth SPP Example"

source "Kconfig"
source "apps/bluetooth/classic/ipro6s_bt_spp/Kconfig"
```

## apps/networking/thread/ipro_thread_ftd_cli/Kconfig
```kconfig
config IPRO_THREAD_FTD_CLI
    bool "IPRO Thread FTD CLI Application"
    default n
    help
        Enable IPRO Thread FTD CLI application.
        This application provides a Full Thread Device with CLI interface.

if IPRO_THREAD_FTD_CLI

config THREAD_FTD_CLI_TASK_PRIORITY
    int "Thread FTD CLI task priority"
    default 5
    help
        Priority of the Thread FTD CLI task.

config THREAD_FTD_CLI_TASK_STACK_SIZE
    int "Thread FTD CLI task stack size"
    default 4096
    help
        Stack size of the Thread FTD CLI task in bytes.

config THREAD_AUTO_START
    bool "Auto start Thread network"
    default y
    help
        Automatically start the Thread network interface on boot.

config THREAD_CSL_PERIOD_US
    int "CSL receiver period at boot (us, 0 = none)"
    default 0
    depends on OPENTHREAD_MAC_CSL_RECEIVER_ENABLE
    help
        CSL period applied before Thread starts, so a synchronized sleepy
        end device (mode -) comes back from a reset as a CSL receiver: OT
        keeps the CSL period and timeout only in RAM (the `csl` CLI), so
        without this a reset SSED restores its child link as a plain SED
        while the parent still sends to it in CSL slots (Thread 1.4.1
        4.6.4: after reset an SSED re-establishes CSL synchronization).

config THREAD_CSL_TIMEOUT_S
    int "CSL synchronized timeout at boot (s, 0 = OpenThread default)"
    default 0
    depends on OPENTHREAD_MAC_CSL_RECEIVER_ENABLE

endif # IPRO_THREAD_FTD_CLI
```
